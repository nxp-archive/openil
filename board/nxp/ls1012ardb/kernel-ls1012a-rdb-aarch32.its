## board/nxp/ls1012ardb/kernel-ls1012a-rdb-aarch32.its
```
/*
 * Copyright (C) 2016, Freescale Semiconductor
 *
 * This file is licensed under the terms of the GNU General Public
 * License version 2. This program is licensed "as is" without any
 * warranty of any kind, whether express or implied.
 */

/dts-v1/;

/ {
	description = "Image file for the LS1012A Linux Kernel";
	#address-cells = <1>;

	images {
		kernel@1 {
			description = "ARM32 Linux kernel";
			data = /incbin/("./arch/arm/boot/zImage");
			type = "kernel";
			arch = "arm";
			os = "linux";
			compression = "none";
			load = <0x80008000>;
			entry = <0x80008000>;
		};
		fdt@1 {
			description = "Flattened Device Tree blob";
			data = /incbin/("./fsl-ls1012a-rdb.dtb");
			type = "flat_dt";
			arch = "arm";
			compression = "none";
			load = <0x90000000>;
		};
		ramdisk@1 {
			description = "LS1 Ramdisk";
                        data = /incbin/("./fsl-image-core-ls1012ardb-32b.ext2.gz");
			type = "ramdisk";
			arch = "arm";
			os = "linux";
			compression = "none";
		};
	};

	configurations {
		default = "config@1";
		config@1 {
			description = "Boot Linux kernel";
			kernel = "kernel@1";
			fdt = "fdt@1";
			ramdisk = "ramdisk@1";
		};
	};
};
```

## board/nxp/ls1012ardb/ls1012ardb-32b_linux_fs_defconfig
```kconfig
# Architecture
BR2_arm=y
BR2_cortex_a7=y
BR2_ARM_FPU_NEON=y

# Filesystem
BR2_TARGET_ROOTFS_CPIO=y
BR2_TARGET_ROOTFS_CPIO_GZIP=y
BR2_TARGET_ROOTFS_CPIO_UIMAGE=y
BR2_TARGET_ROOTFS_EXT2=y
BR2_TARGET_ROOTFS_EXT2_4=y
BR2_TARGET_ROOTFS_EXT2_GZIP=y

# Hostname and issue
BR2_TARGET_GENERIC_HOSTNAME="OpenIL"
BR2_TARGET_GENERIC_ISSUE="Welcome to OpenIL"

# Linux headers same as kernel
BR2_PACKAGE_HOST_LINUX_HEADERS_CUSTOM_4_14=y

# toolchain
BR2_TOOLCHAIN_EXTERNAL=y

# bootloader
BR2_TARGET_UBOOT=n

# Kernel
BR2_LINUX_KERNEL=y
BR2_LINUX_KERNEL_CUSTOM_GIT=y
BR2_LINUX_KERNEL_CUSTOM_REPO_URL="https://github.com/openil/linux.git"
BR2_LINUX_KERNEL_CUSTOM_REPO_VERSION="OpenIL-linux-202001"
BR2_LINUX_KERNEL_DEFCONFIG="multi_v7"
BR2_LINUX_KERNEL_CONFIG_FRAGMENT_FILES="$(LINUX_DIR)/arch/arm/configs/multi_v7_lpae.config $(LINUX_DIR)/arch/arm/configs/multi_v8.config $(LINUX_DIR)/arch/arm/configs/lsdk.config board/nxp/common/linux-4_9-xenomai.config"
BR2_LINUX_KERNEL_DTS_SUPPORT=n
#BR2_LINUX_KERNEL_UIMAGE=y
#BR2_LINUX_KERNEL_UIMAGE_LOADADDR="0x80008000"
# Serial port config
BR2_TARGET_GENERIC_GETTY=n
# BR2_TARGET_GENERIC_GETTY_PORT="ttyS0"

# required tools to create the microSD image
BR2_PACKAGE_HOST_DOSFSTOOLS=y
BR2_PACKAGE_HOST_GENIMAGE=y
BR2_PACKAGE_HOST_MTOOLS=y
BR2_ROOTFS_POST_IMAGE_SCRIPT="board/nxp/ls1012ardb/post-image.sh"
BR2_ROOTFS_POST_SCRIPT_ARGS="$(LINUX_DIR) $(TOPDIR)"

# packages for rcw
BR2_PACKAGE_RCW=y
BR2_PACKAGE_RCW_BIN="ls1012ardb/R_SPNH_3508/rcw_1000_default.bin"

# busybox setting
BR2_PACKAGE_BUSYBOX_CONFIG_FRAGMENT_FILES="board/nxp/common/openil-busybox.config"
BR2_PACKAGE_BUSYBOX_SHOW_OTHERS=y

# uboot-tools for mkimage
BR2_PACKAGE_HOST_UBOOT_TOOLS=y
BR2_PACKAGE_HOST_UBOOT_TOOLS_FIT_SUPPORT=y

# Add ota overlay
BR2_ROOTFS_OVERLAY="board/nxp/common/ota_overlay board/nxp/common/busybox_init_overlay"

# packages for xenomai
BR2_PACKAGE_XENOMAI=y
BR2_PACKAGE_XENOMAI_ARCH_SUPPORTS=y
BR2_PACKAGE_XENOMAI_RTCAN=y
BR2_PACKAGE_XENOMAI_ANALOGY=y
BR2_PACKAGE_XENOMAI_NATIVE_SKIN=y
BR2_PACKAGE_XENOMAI_POSIX_SKIN=y
BR2_PACKAGE_XENOMAI_TESTSUITE=y

# package for ppfe firmware
BR2_PACKAGE_PPFE=y

# basic packages and tools
BR2_PACKAGE_MTD=y
BR2_PACKAGE_MTD_MTD_DEBUG=y
BR2_PACKAGE_SYSSTAT=y
BR2_PACKAGE_E2FSPROGS=y
BR2_PACKAGE_RT_TESTS=y
BR2_PACKAGE_OPENSSH=y
BR2_PACKAGE_OPENSSL=y
BR2_PACKAGE_WGET=y

# dhcpd package
BR2_PACKAGE_DHCPCD=y

# resize2fs package
BR2_PACKAGE_E2FSPROGS_RESIZE2FS=y
```

## board/nxp/ls1021atsn/kernel-ls1021a-tsn.its
```
/*
 * Copyright 2020 NXP
 *
 * SPDX-License-Identifier: GPL-2.0+
 *
 */

/dts-v1/;

/ {
	description = "Image file for the LS1021A Linux Kernel";
	#address-cells = <1>;

	images {
		kernel@1 {
			description = "ARM32 Linux kernel";
			data = /incbin/("./arch/arm/boot/zImage");
			type = "kernel";
			arch = "arm";
			os = "linux";
			compression = "gzip";
			load = <0x80008000>;
			entry = <0x80008000>;
		};
		fdt@1 {
			description = "Flattened Device Tree blob";
			data = /incbin/("./ls1021a-tsn.dtb");
			type = "flat_dt";
			arch = "arm";
			compression = "none";
			load = <0x90000000>;
		};
		ramdisk@1 {
			description = "LS1 Ramdisk";
                        data = /incbin/("./rootfs.cpio.gz");
			type = "ramdisk";
			arch = "arm";
			os = "linux";
			compression = "gzip";
		};
	};

	configurations {
		default = "config@1";
		config@1 {
			description = "Boot Linux kernel";
			kernel = "kernel@1";
			fdt = "fdt@1";
			ramdisk = "ramdisk@1";
		};
		ls1021atsn@1 {
			description = "Boot Linux kernel";
			kernel = "kernel@1";
			fdt = "fdt@1";
			ramdisk = "ramdisk@1";
		};
	};
};
```

## board/nxp/ls1028ardb/kernel-ls1028a-rdb.its
```
/*
 * Copyright 2019 NXP
 *
 * Changming Huang <jerry.huang@nxp.com>
 *
 * SPDX-License-Identifier: GPL-2.0+
 */

/dts-v1/;

/ {
	description = "Image file for the LS1028A Linux Kernel";
	#address-cells = <1>;

	images {
		kernel@1 {
			description = "ARM64 Linux kernel";
			data = /incbin/("./arch/arm64/boot/Image.gz");
			type = "kernel";
			arch = "arm64";
			os = "linux";
			compression = "gzip";
			load = <0x80080000>;
			entry = <0x80080000>;
		};
		fdt@1 {
			description = "Flattened Device Tree blob";
			data = /incbin/("./arch/arm64/boot/dts/freescale/fsl-ls1028a-rdb.dtb");
			type = "flat_dt";
			arch = "arm64";
			compression = "none";
			load = <0x90000000>;
		};
		ramdisk@1 {
			description = "LS1028 Ramdisk";
                        data = /incbin/("./fsl-image-core-ls1028ardb.cpio.gz");
			type = "ramdisk";
			arch = "arm64";
			os = "linux";
			compression = "gzip";
		};
	};

	configurations {
		default = "config@1";
		config@1 {
			description = "Boot Linux kernel";
			kernel = "kernel@1";
			fdt = "fdt@1";
			ramdisk = "ramdisk@1";
		};
		ls1028ardb {
			description = "Boot Linux kernel";
			kernel = "kernel@1";
			fdt = "fdt@1";
			ramdisk = "ramdisk@1";
		};
	};
};
```

## board/nxp/ls1046ardb/kernel-ls1046a-rdb.its
```
/*
 * Copyright (C) 2016, Freescale Semiconductor
 *
 * Mingkai Hu <mingkai.hu@nxp.com>
 *
 * This file is licensed under the terms of the GNU General Public
 * License version 2.  This program is licensed "as is" without any
 * warranty of any kind, whether express or implied.
 */

/dts-v1/;

/ {
	description = "Image file for the LS1046A Linux Kernel";
	#address-cells = <1>;

	images {
		kernel@1 {
			description = "ARM64 Linux kernel";
			data = /incbin/("./arch/arm64/boot/Image.gz");
			type = "kernel";
			arch = "arm64";
			os = "linux";
			compression = "gzip";
			load = <0x80080000>;
			entry = <0x80080000>;
		};
		fdt@1 {
			description = "Flattened Device Tree blob";
			data = /incbin/("./arch/arm64/boot/dts/freescale/fsl-ls1046a-rdb-sdk.dtb");
			type = "flat_dt";
			arch = "arm64";
			compression = "none";
			load = <0x90000000>;
		};
		ramdisk@1 {
			description = "LS1046 Ramdisk";
                        data = /incbin/("./fsl-image-core-ls1046ardb.cpio.gz");
			type = "ramdisk";
			arch = "arm64";
			os = "linux";
			compression = "gzip";
		};
	};

	configurations {
		default = "config@1";
		config@1 {
			description = "Boot Linux kernel";
			kernel = "kernel@1";
			fdt = "fdt@1";
			ramdisk = "ramdisk@1";
		};
		ls1046ardb {
			description = "Boot Linux kernel";
			kernel = "kernel@1";
			fdt = "fdt@1";
			ramdisk = "ramdisk@1";
		};
	};
};
```

## board/nxp/ls1046ardb/ls1046ardb-32b_linux_fs_defconfig
```kconfig
# Architecture
BR2_arm=y
BR2_cortex_a7=y
BR2_ARM_FPU_NEON=y

# Filesystem
BR2_TARGET_ROOTFS_EXT2=y
BR2_TARGET_ROOTFS_EXT2_4=y
BR2_TARGET_ROOTFS_EXT2_GZIP=y

# Hostname and issue
BR2_TARGET_GENERIC_HOSTNAME="OpenIL"
BR2_TARGET_GENERIC_ISSUE="Welcome to OpenIL"

# Linux headers same as kernel
BR2_PACKAGE_HOST_LINUX_HEADERS_CUSTOM_4_14=y

# toolchain
BR2_TOOLCHAIN_EXTERNAL=y

# bootloader
BR2_TARGET_UBOOT=n

# Kernel
BR2_LINUX_KERNEL=y
BR2_LINUX_KERNEL_CUSTOM_GIT=y
BR2_LINUX_KERNEL_CUSTOM_REPO_URL="https://github.com/openil/linux.git"
BR2_LINUX_KERNEL_CUSTOM_REPO_VERSION="OpenIL-v1.7-linux-202001"
BR2_LINUX_KERNEL_DEFCONFIG="multi_v7"
BR2_LINUX_KERNEL_CONFIG_FRAGMENT_FILES="$(LINUX_DIR)/arch/arm/configs/multi_v7_lpae.config $(LINUX_DIR)/arch/arm/configs/multi_v8.config $(LINUX_DIR)/arch/arm/configs/lsdk.config board/nxp/common/linux-4_9-docker.config board/nxp/common/linux-4_9-xenomai.config"
BR2_LINUX_KERNEL_DTS_SUPPORT=n
#BR2_LINUX_KERNEL_UIMAGE=y
#BR2_LINUX_KERNEL_UIMAGE_LOADADDR="0x80008000"
# Serial port config
BR2_TARGET_GENERIC_GETTY=n
# BR2_TARGET_GENERIC_GETTY_PORT="ttyS0"

# required tools to create the microSD image
BR2_PACKAGE_HOST_DOSFSTOOLS=y
BR2_PACKAGE_HOST_GENIMAGE=y
BR2_PACKAGE_HOST_MTOOLS=y
BR2_ROOTFS_POST_IMAGE_SCRIPT="board/nxp/ls1046ardb/post-image.sh"
BR2_ROOTFS_POST_SCRIPT_ARGS="$(LINUX_DIR) $(TOPDIR)"

# extend the partition size
BR2_TARGET_ROOTFS_EXT2_EXTRA_BLOCKS=102400
BR2_TARGET_ROOTFS_EXT2_EXTRA_INODES=102400

# packages for fman and fmc
BR2_PACKAGE_FMLIB=y
BR2_PACKAGE_FMUCODE=y
BR2_PACKAGE_FMUCODE_BIN="fsl_fman_ucode_ls1046_r1.0_108_4_9.bin"
BR2_PACKAGE_FMC=y

# busybox setting
BR2_PACKAGE_BUSYBOX_CONFIG_FRAGMENT_FILES="board/nxp/common/openil-busybox.config"
BR2_PACKAGE_BUSYBOX_SHOW_OTHERS=y

# uboot-tools for mkimage
BR2_PACKAGE_HOST_UBOOT_TOOLS=y
BR2_PACKAGE_HOST_UBOOT_TOOLS_FIT_SUPPORT=y

# Add ota overlay
BR2_ROOTFS_OVERLAY="board/nxp/common/ota_overlay board/nxp/common/busybox_init_overlay"

# packages for xenomai
BR2_PACKAGE_XENOMAI=y
BR2_PACKAGE_XENOMAI_ARCH_SUPPORTS=y
BR2_PACKAGE_XENOMAI_RTCAN=y
BR2_PACKAGE_XENOMAI_ANALOGY=y
BR2_PACKAGE_XENOMAI_NATIVE_SKIN=y
BR2_PACKAGE_XENOMAI_POSIX_SKIN=y
BR2_PACKAGE_XENOMAI_TESTSUITE=y

# ptp4l package
BR2_PACKAGE_PTP4L=y

# basic packages and tools
BR2_PACKAGE_MTD=y
BR2_PACKAGE_MTD_MTD_DEBUG=y
BR2_PACKAGE_SYSSTAT=y
BR2_PACKAGE_E2FSPROGS=y
BR2_PACKAGE_RT_TESTS=y
BR2_PACKAGE_OPENSSH=y
BR2_PACKAGE_OPENSSL=y
BR2_PACKAGE_WGET=y

# docker packages
BR2_PACKAGE_DOCKER_CONTAINERD=y
BR2_PACKAGE_DOCKER_ENGINE=y
BR2_PACKAGE_DOCKER_ENGINE_DAEMON=y
BR2_PACKAGE_DOCKER_ENGINE_EXPERIMENTAL=y
BR2_PACKAGE_DOCKER_ENGINE_DRIVER_BTRFS=y
BR2_PACKAGE_DOCKER_ENGINE_DRIVER_DEVICEMAPPER=y
BR2_PACKAGE_DOCKER_ENGINE_DRIVER_VFS=y
BR2_PACKAGE_UTIL_LINUX_LIBMOUNT=y
BR2_PACKAGE_CGROUPFS_MOUNT=y
BR2_PACKAGE_LIBCGROUP=y

# ca-certs packages
BR2_PACKAGE_CA_CERTIFICATES=y

# dhcpd package
BR2_PACKAGE_DHCPCD=y

# resize2fs package
BR2_PACKAGE_E2FSPROGS_RESIZE2FS=y
```

## board/nxp/lx2160ardb/kernel-lx2160a-rdb.its
```
// SPDX-License-Identifier: GPL-2.0+
/*
 * Copyright 2019 NXP
 *
 * Changming Huang <jerry.huang@nxp.com>
 *
 */

/dts-v1/;

/ {
	description = "Image file for the LX2160A Linux Kernel";
	#address-cells = <1>;

	images {
		kernel@1 {
			description = "ARM64 Linux kernel";
			data = /incbin/("./arch/arm64/boot/Image.gz");
			type = "kernel";
			arch = "arm64";
			os = "linux";
			compression = "gzip";
			load = <0x80080000>;
			entry = <0x80080000>;
		};
		fdt@1 {
			description = "Flattened Device Tree blob";
			data = /incbin/("./arch/arm64/boot/dts/freescale/fsl-lx2160a-rdb.dtb");
			type = "flat_dt";
			arch = "arm64";
			compression = "none";
			load = <0x90000000>;
		};
		ramdisk@1 {
			description = "LX2160 Ramdisk";
                        data = /incbin/("./fsl-image-core-lx2160ardb.cpio.gz");
			type = "ramdisk";
			arch = "arm64";
			os = "linux";
			compression = "gzip";
		};
	};

	configurations {
		default = "config@1";
		config@1 {
			description = "Boot Linux kernel";
			kernel = "kernel@1";
			fdt = "fdt@1";
			ramdisk = "ramdisk@1";
		};
		lx2160ardb {
			description = "Boot Linux kernel";
			kernel = "kernel@1";
			fdt = "fdt@1";
			ramdisk = "ramdisk@1";
		};
	};
};
```
