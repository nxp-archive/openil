## configs/imx6q-sabresd_baremetal_defconfig
```kconfig
BR2_arm=y
BR2_cortex_a9=y
BR2_ARM_ENABLE_NEON=y
BR2_ARM_ENABLE_VFP=y
BR2_ARM_FPU_VFPV3=y

# System
BR2_TARGET_GENERIC_GETTY_PORT="ttymxc0"

# MAX CPUS
BR2_PACKAGE_ICC_MAX_CPUS=4

# required tools to create the SD card image
BR2_PACKAGE_HOST_DOSFSTOOLS=y
BR2_PACKAGE_HOST_GENIMAGE=y
BR2_PACKAGE_HOST_MTOOLS=y

# Filesystem
BR2_ROOTFS_POST_IMAGE_SCRIPT="board/freescale/common/imx/post-image-baremetal.sh"
BR2_TARGET_ROOTFS_EXT2=y
BR2_TARGET_ROOTFS_EXT2_4=y
BR2_TARGET_ROOTFS_EXT2_GZIP=y

# Hostname and issue
BR2_TARGET_GENERIC_HOSTNAME="OpenIL"
BR2_TARGET_GENERIC_ISSUE="Welcome to OpenIL"

# Linux headers same as kernel
BR2_PACKAGE_HOST_LINUX_HEADERS_CUSTOM_4_14=y

# toolchain
BR2_TOOLCHAIN_EXTERNAL=y

# Bootloader
BR2_TARGET_UBOOT=y
BR2_TARGET_UBOOT_BOARDNAME="mx6sabresd_baremetal"
BR2_TARGET_UBOOT_CUSTOM_GIT=y
BR2_TARGET_UBOOT_CUSTOM_REPO_URL="ssh://git@bitbucket.sw.nxp.com/dnind/industry-uboot.git"
BR2_TARGET_UBOOT_CUSTOM_REPO_VERSION="LSDK-18.06"
BR2_TARGET_UBOOT_FORMAT_IMG=y
BR2_TARGET_UBOOT_SPL=y
BR2_TARGET_UBOOT_SPL_NAME="SPL"

# Kernel
BR2_LINUX_KERNEL=y
BR2_LINUX_KERNEL_CUSTOM_GIT=y
BR2_LINUX_KERNEL_CUSTOM_REPO_URL="ssh://git@bitbucket.sw.nxp.com/dnind/industry-linux.git"
BR2_LINUX_KERNEL_CUSTOM_REPO_VERSION="LSDK-18.06-V4.14"
#BR2_LINUX_KERNEL_CUSTOM_VERSION=y
#BR2_LINUX_KERNEL_CUSTOM_VERSION_VALUE="4.9.7"
BR2_LINUX_KERNEL_DEFCONFIG="imx_v6_v7"
BR2_LINUX_KERNEL_CONFIG_FRAGMENT_FILES="board/nxp/common/linux-4_9-xenomai.config board/nxp/common/linux-4_9-baremetal.config"
BR2_LINUX_KERNEL_DTS_SUPPORT=y
BR2_LINUX_KERNEL_INTREE_DTS_NAME="imx6q-sabresd"

# linux partition size
BR2_ROOTFS_PARTITION_SIZE="500M"

# busybox setting
BR2_PACKAGE_BUSYBOX_CONFIG_FRAGMENT_FILES="board/nxp/common/openil-busybox.config"
BR2_PACKAGE_BUSYBOX_SHOW_OTHERS=y

# Baremetal u-boot package
BR2_PACKAGE_BM_UBOOT=y
BR2_PACKAGE_BM_UBOOT_DEFCONFIG="mx6sabresd_baremetal_defconfig"

# icc package for baremetal
BR2_PACKAGE_ICC=y
BR2_PACKAGE_ICC_GIC_IMX6Q=y
BR2_PACKAGE_ICC_MAX_CPUS=4

# basic packages and tools
BR2_PACKAGE_MTD=y
BR2_PACKAGE_MTD_MTD_DEBUG=y
BR2_PACKAGE_SYSSTAT=y
BR2_PACKAGE_E2FSPROGS=y
BR2_PACKAGE_RT_TESTS=y
BR2_PACKAGE_WGET=y

# packages for xenomai
BR2_PACKAGE_XENOMAI=y
BR2_PACKAGE_XENOMAI_ARCH_SUPPORTS=y
BR2_PACKAGE_XENOMAI_RTCAN=y
BR2_PACKAGE_XENOMAI_ANALOGY=y
BR2_PACKAGE_XENOMAI_NATIVE_SKIN=y
BR2_PACKAGE_XENOMAI_POSIX_SKIN=y
BR2_PACKAGE_XENOMAI_TESTSUITE=y

# ptp4l package
BR2_PACKAGE_PTP4L=y

# resize2fs package
BR2_PACKAGE_E2FSPROGS_RESIZE2FS=y

# Add for NETCONF apps and ota
#BR2_ROOTFS_OVERLAY="board/nxp/ls1021atsn/rootfs_overlay board/nxp/common/ota_overlay board/nxp/ls1021atsn/busybox_init_overlay"
BR2_TOOLCHAIN_BUILDROOT_CXX=y
BR2_INSTALL_LIBSTDCPP=y
BR2_PACKAGE_BZIP2=y
BR2_PACKAGE_ZIP=y
BR2_PACKAGE_NETPERF=y
BR2_PACKAGE_GENEXT2FS=y
BR2_PACKAGE_STRACE=y
BR2_PACKAGE_TCPDUMP=y
BR2_PACKAGE_IPUTILS=y
BR2_PACKAGE_BC=y

BR2_PACKAGE_DBUS=y
BR2_PACKAGE_DBUS_GLIB=y
BR2_PACKAGE_DBUS_PYTHON=y
BR2_PACKAGE_DBUS_TRIGGERD=y

BR2_PACKAGE_PYTHON=y
BR2_PACKAGE_PYTHON_PY_PYC=y

BR2_PACKAGE_PYTHON_READLINE=y
BR2_PACKAGE_PYTHON_SSL=y
BR2_PACKAGE_PYTHON_UNICODEDATA=y
BR2_PACKAGE_PYTHON_UCS2=y
BR2_PACKAGE_PYTHON_PYEXPAT=y
BR2_PACKAGE_PYTHON_ZLIB=y
BR2_PACKAGE_PYTHON_LIBXML2=y
BR2_PACKAGE_H_PYTHON_LIBXML2=y
BR2_PACKAGE_PYTHON_CURSES=y
BR2_PACKAGE_PYTHON_SETUPTOOLS=y
BR2_PACKAGE_RUBY=y

BR2_PACKAGE_OPKG=y
BR2_PACKAGE_OPKG_GPG_SIGN=y
BR2_PACKAGE_TAR=y
BR2_PACKAGE_CA_CERTIFICATES=y

BR2_PACKAGE_LIBARCHIVE=y
BR2_PACKAGE_LIBARCHIVE_BSDTAR=y
BR2_PACKAGE_LIBARCHIVE_BSDCAT=y
BR2_PACKAGE_LIBARCHIVE_BSDCPIO=y
BR2_PACKAGE_ZLIB=y

BR2_PACKAGE_CRYPTODEV=y
BR2_PACKAGE_CRYPTODEV_LINUX=y
BR2_PACKAGE_HAS_CRYPTODEV=y
BR2_PACKAGE_PROVIDES_CRYPTODEV="cryptodev-linux"

BR2_PACKAGE_LIBASSUAN=y
BR2_PACKAGE_LIBGCRYPT=y
BR2_PACKAGE_LIBGPG_ERROR=y
#BR2_PACKAGE_LIBGPG_ERROR_SYSCFG="arm-unknown-linux-gnueabi"
BR2_PACKAGE_LIBGPGME=y

BR2_PACKAGE_LIBSSH=y
BR2_PACKAGE_LIBSSH2=y

BR2_PACKAGE_OPENSSL=y
BR2_PACKAGE_OPENSSL_BIN=y
BR2_PACKAGE_OPENSSL_ENGINES=y

BR2_PACKAGE_EXPAT=y
BR2_PACKAGE_LIBXML2=y
BR2_PACKAGE_H_LIBXML2=y
BR2_PACKAGE_LIBXMLRPC=y
BR2_PACKAGE_LIBXSLT=y
BR2_PACKAGE_HOST_LIBXSLT=y

BR2_PACKAGE_LIBCGI=y
BR2_PACKAGE_LIBCURL=y
BR2_PACKAGE_CURL=y

BR2_PACKAGE_LIBNFNETLINK=y

BR2_PACKAGE_LIBPCAP=y

BR2_PACKAGE_APR=y
BR2_PACKAGE_APR_UTIL=y
BR2_PACKAGE_LIBDAEMON=y
BR2_PACKAGE_LIBEVENT=y
BR2_PACKAGE_LIBFFI=y
BR2_PACKAGE_LIBGLIB2=y


BR2_PACKAGE_NCURSES=y
BR2_PACKAGE_NCURSES_WCHAR=y
BR2_PACKAGE_NCURSES_TARGET_PANEL=y
BR2_PACKAGE_NCURSES_TARGET_FORM=y
BR2_PACKAGE_NCURSES_TARGET_MENU=y
BR2_PACKAGE_NCURSES_TARGET_PROGS=y

BR2_PACKAGE_PCRE=y
BR2_PACKAGE_PCRE_UTF=y
BR2_PACKAGE_PCRE_UCP=y
BR2_PACKAGE_READLINE=y

BR2_PACKAGE_AVAHI=y
BR2_PACKAGE_AVAHI_AUTOIPD=y
BR2_PACKAGE_AVAHI_DAEMON=y
BR2_PACKAGE_AVAHI_LIBDNSSD_COMPATIBILITY=y

# Net packages
BR2_PACKAGE_DHCP=y
BR2_PACKAGE_DHCP_SERVER=y
BR2_PACKAGE_DHCP_SERVER_DELAYED_ACK=y
BR2_PACKAGE_DHCP_CLIENT=y
BR2_PACKAGE_DHCPCD=y
BR2_PACKAGE_DHCPDUMP=y
BR2_PACKAGE_DHCP_RELAY=y
BR2_PACKAGE_DNSMASQ=y
BR2_PACKAGE_DNSMASQ_TFTP=y
BR2_PACKAGE_DNSMASQ_DHCP=y

BR2_PACKAGE_NETCAT_OPENBSD=y

BR2_PACKAGE_ETHTOOL=y

BR2_PACKAGE_IPERF=y
BR2_PACKAGE_IPERF3=y
BR2_PACKAGE_IPROUTE2=y
BR2_PACKAGE_IPTABLES=y

BR2_PACKAGE_OPENSSH=y

BR2_PACKAGE_PINENTRY=y
BR2_PACKAGE_PINENTRY_NCURSES=y
BR2_PACKAGE_PKGCONF=y
BR2_PACKAGE_PYANG=y
BR2_PACKAGE_LIBNETCONF=y
BR2_PACKAGE_NETOPEER=y
BR2_PACKAGE_NETOPEER_CLIENT=y

BR2_TARGET_ROOTFS_EXT2_EXTRA_BLOCKS=102400
BR2_TARGET_ROOTFS_EXT2_EXTRA_INODES=102400

BR2_PACKAGE_GNUPLOT=y
BR2_PACKAGE_PERL=y
BR2_PACKAGE_PERL_FEEDGNUPLOT=y
BR2_PACKAGE_PRL=y

BR2_PACKAGE_LIBOPEN62541=y
BR2_PACKAGE_OPEN62541_EXAMPLES=y
BR2_PACKAGE_TMUX=y

BR2_PACKAGE_IRQBALANCE=y

# Text editors
BR2_PACKAGE_NANO=y
```

## configs/imx6q-sabresd_defconfig
```kconfig
# Architecture
BR2_arm=y
BR2_cortex_a9=y
BR2_ARM_ENABLE_NEON=y
BR2_ARM_ENABLE_VFP=y
BR2_ARM_FPU_VFPV3=y

# Linux headers same as kernel, a 5.4 series
BR2_PACKAGE_HOST_LINUX_HEADERS_CUSTOM_5_4=y

# System
BR2_TARGET_GENERIC_GETTY=y
BR2_TARGET_GENERIC_GETTY_PORT="ttymxc0"

# Filesystem
BR2_ROOTFS_POST_IMAGE_SCRIPT="board/freescale/common/imx/post-image.sh"
BR2_TARGET_ROOTFS_EXT2=y
BR2_TARGET_ROOTFS_EXT2_4=y
BR2_TARGET_ROOTFS_EXT2_LABEL="root"
BR2_ROOTFS_OVERLAY="board/nxp/common/ls/busybox_rootfs_resize_overlay"

# Hostname and issue
BR2_TARGET_GENERIC_HOSTNAME="IMX6QSABRESD"
BR2_TARGET_GENERIC_ISSUE="Welcome to OpenIL"

# toolchain
BR2_TOOLCHAIN=y
BR2_TOOLCHAIN_EXTERNAL=y
BR2_TOOLCHAIN_EXTERNAL_LINARO_ARM=y
BR2_TOOLCHAIN_USES_GLIBC=y
BR2_TOOLCHAIN_EXTERNAL_GLIBC=y

# Bootloader
BR2_TARGET_UBOOT=y
BR2_TARGET_UBOOT_BOARDNAME="mx6sabresd"
BR2_TARGET_UBOOT_CUSTOM_GIT=y
BR2_TARGET_UBOOT_FORMAT_IMG=y
BR2_TARGET_UBOOT_SPL=y
BR2_TARGET_UBOOT_SPL_NAME="SPL"

# Kernel
BR2_LINUX_KERNEL=y
BR2_LINUX_KERNEL_CUSTOM_GIT=y
BR2_LINUX_KERNEL_DEFCONFIG="imx_v6_v7"
BR2_LINUX_KERNEL_DTS_SUPPORT=y
BR2_LINUX_KERNEL_INTREE_DTS_NAME="imx6q-sabresd"
BR2_LINUX_KERNEL_NEEDS_HOST_OPENSSL=y

# busybox setting
BR2_PACKAGE_BUSYBOX_CONFIG_FRAGMENT_FILES="board/nxp/common/ls/busybox.config"
BR2_PACKAGE_BUSYBOX_SHOW_OTHERS=y

# ptp4l package
BR2_PACKAGE_QORIQ_PTP4L=y

BR2_PACKAGE_QORIQ_H_LIBXML2=y
BR2_PACKAGE_QORIQ_H_PYTHON_LIBXML2=y

# required tools to create the SD card image
BR2_PACKAGE_HOST_DOSFSTOOLS=y
BR2_PACKAGE_HOST_GENIMAGE=y
BR2_PACKAGE_HOST_MTOOLS=y

# basic packages and tools
BR2_PACKAGE_MTD=y
BR2_PACKAGE_MTD_MTD_DEBUG=y
BR2_PACKAGE_SYSSTAT=y
BR2_PACKAGE_E2FSPROGS=y
BR2_PACKAGE_RT_TESTS=y
BR2_PACKAGE_WGET=y

# resize2fs package
BR2_PACKAGE_E2FSPROGS_RESIZE2FS=y

BR2_TOOLCHAIN_BUILDROOT_CXX=y
BR2_INSTALL_LIBSTDCPP=y
BR2_PACKAGE_BZIP2=y
BR2_PACKAGE_ZIP=y
BR2_PACKAGE_NETPERF=y
BR2_PACKAGE_GENEXT2FS=y
BR2_PACKAGE_STRACE=y
BR2_PACKAGE_TCPDUMP=y
BR2_PACKAGE_IPUTILS=y
BR2_PACKAGE_BC=y

BR2_PACKAGE_DBUS=y
BR2_PACKAGE_DBUS_GLIB=y
BR2_PACKAGE_DBUS_PYTHON=y
BR2_PACKAGE_DBUS_TRIGGERD=y

BR2_PACKAGE_PYTHON=y
BR2_PACKAGE_PYTHON_PY_PYC=y

BR2_PACKAGE_PYTHON_READLINE=y
BR2_PACKAGE_PYTHON_SSL=y
BR2_PACKAGE_PYTHON_UNICODEDATA=y
BR2_PACKAGE_PYTHON_UCS2=y
BR2_PACKAGE_PYTHON_PYEXPAT=y
BR2_PACKAGE_PYTHON_ZLIB=y
BR2_PACKAGE_PYTHON_LIBXML2=y
BR2_PACKAGE_PYTHON_CURSES=y
BR2_PACKAGE_PYTHON_SETUPTOOLS=y
BR2_PACKAGE_RUBY=y

BR2_PACKAGE_OPKG=y
BR2_PACKAGE_OPKG_GPG_SIGN=y
BR2_PACKAGE_TAR=y
BR2_PACKAGE_CA_CERTIFICATES=y

BR2_PACKAGE_LIBARCHIVE=y
BR2_PACKAGE_LIBARCHIVE_BSDTAR=y
BR2_PACKAGE_LIBARCHIVE_BSDCAT=y
BR2_PACKAGE_LIBARCHIVE_BSDCPIO=y
BR2_PACKAGE_ZLIB=y

BR2_PACKAGE_CRYPTODEV=y
BR2_PACKAGE_CRYPTODEV_LINUX=y
BR2_PACKAGE_HAS_CRYPTODEV=y
BR2_PACKAGE_PROVIDES_CRYPTODEV="cryptodev-linux"

BR2_PACKAGE_LIBASSUAN=y
BR2_PACKAGE_LIBGCRYPT=y
BR2_PACKAGE_LIBGPG_ERROR=y
#BR2_PACKAGE_LIBGPG_ERROR_SYSCFG="arm-unknown-linux-gnueabi"
BR2_PACKAGE_LIBGPGME=y

BR2_PACKAGE_LIBSSH=y
BR2_PACKAGE_LIBSSH2=y

BR2_PACKAGE_OPENSSL=y
BR2_PACKAGE_OPENSSL_BIN=y
BR2_PACKAGE_OPENSSL_ENGINES=y

BR2_PACKAGE_EXPAT=y
BR2_PACKAGE_LIBXML2=y
BR2_PACKAGE_LIBXMLRPC=y
BR2_PACKAGE_LIBXSLT=y
BR2_PACKAGE_HOST_LIBXSLT=y

BR2_PACKAGE_LIBCGI=y
BR2_PACKAGE_LIBCURL=y
BR2_PACKAGE_LIBCURL_CURL=y

BR2_PACKAGE_LIBNFNETLINK=y

BR2_PACKAGE_LIBPCAP=y

BR2_PACKAGE_APR=y
BR2_PACKAGE_APR_UTIL=y
BR2_PACKAGE_LIBDAEMON=y
BR2_PACKAGE_LIBEVENT=y
BR2_PACKAGE_LIBFFI=y
BR2_PACKAGE_LIBGLIB2=y


BR2_PACKAGE_NCURSES=y
BR2_PACKAGE_NCURSES_WCHAR=y
BR2_PACKAGE_NCURSES_TARGET_PANEL=y
BR2_PACKAGE_NCURSES_TARGET_FORM=y
BR2_PACKAGE_NCURSES_TARGET_MENU=y
BR2_PACKAGE_NCURSES_TARGET_PROGS=y

BR2_PACKAGE_PCRE=y
BR2_PACKAGE_PCRE_UTF=y
BR2_PACKAGE_PCRE_UCP=y
BR2_PACKAGE_READLINE=y

BR2_PACKAGE_AVAHI=y
BR2_PACKAGE_AVAHI_AUTOIPD=y
BR2_PACKAGE_AVAHI_DAEMON=y
BR2_PACKAGE_AVAHI_LIBDNSSD_COMPATIBILITY=y

# Net packages
BR2_PACKAGE_DHCP=y
BR2_PACKAGE_DHCP_SERVER=y
BR2_PACKAGE_DHCP_SERVER_DELAYED_ACK=y
BR2_PACKAGE_DHCP_CLIENT=y
BR2_PACKAGE_DHCPCD=y
BR2_PACKAGE_DHCPDUMP=y
BR2_PACKAGE_DHCP_RELAY=y
BR2_PACKAGE_DNSMASQ=y
BR2_PACKAGE_DNSMASQ_TFTP=y
BR2_PACKAGE_DNSMASQ_DHCP=y

BR2_PACKAGE_NETCAT_OPENBSD=y

BR2_PACKAGE_ETHTOOL=y

BR2_PACKAGE_IPERF=y
BR2_PACKAGE_IPERF3=y
BR2_PACKAGE_IPROUTE2=y
BR2_PACKAGE_IPTABLES=y

BR2_PACKAGE_OPENSSH=y

BR2_PACKAGE_PINENTRY=y
BR2_PACKAGE_PINENTRY_NCURSES=y
BR2_PACKAGE_PKGCONF=y
BR2_PACKAGE_PYANG=y
BR2_PACKAGE_LIBNETCONF=y
BR2_PACKAGE_NETOPEER=y
BR2_PACKAGE_NETOPEER_CLIENT=y

BR2_PACKAGE_GNUPLOT=y
BR2_PACKAGE_PERL=y
BR2_PACKAGE_PERL_FEEDGNUPLOT=y
BR2_PACKAGE_PRL=y

BR2_PACKAGE_LIBOPEN62541=y
BR2_PACKAGE_OPEN62541_EXAMPLES=y
BR2_PACKAGE_TMUX=y

BR2_PACKAGE_IRQBALANCE=y

# Text editors
BR2_PACKAGE_NANO=y

BR2_USE_MMU=y
BR2_USE_WCHAR=y
BR2_PACKAGE_VIM=y

BR2_TOOLCHAIN_HAS_THREADS=y
```

## configs/imx6q-sabresd_ubuntu_defconfig
```kconfig
# Architecture
BR2_arm=y
BR2_cortex_a9=y
BR2_ARM_ENABLE_NEON=y
BR2_ARM_ENABLE_VFP=y
BR2_ARM_FPU_VFPV3=y

# Linux headers same as kernel, a 5.4 series
BR2_PACKAGE_HOST_LINUX_HEADERS_CUSTOM_5_4=y

# System
BR2_TARGET_GENERIC_GETTY=y
BR2_TARGET_GENERIC_GETTY_PORT="ttymxc0"

# Filesystem
BR2_ROOTFS_POST_IMAGE_SCRIPT="board/freescale/common/imx/post-image.sh"
BR2_TARGET_ROOTFS_EXT2=y
BR2_TARGET_ROOTFS_EXT2_4=y

BR2_ROOTFS_OVERLAY="board/nxp/common/ls/ubuntu_rootfs_resize_overlay"

# custom skeleton
BR2_ROOTFS_SKELETON_UBUNTU=y
BR2_ROOTFS_SKELETON_CUSTOM=y
BR2_ROOTFS_SKELETON_CUSTOM_SITE="http://cdimage.ubuntu.com/ubuntu-base/releases/18.04.5/release"
BR2_ROOTFS_SKELETON_CUSTOM_SOURCE="ubuntu-base-18.04.5-base-armhf.tar.gz"
BR2_ROOTFS_SKELETON_CUSTOM_SITE_METHOD="wget"
BR2_ROOTFS_SKELETON_CUSTOM_EXTRACT="tar zxvf"
BR2_ROOTFS_SKELETON_CUSTOM_EXTRACT_IGNORE_ERROR=y
BR2_ROOTFS_POST_BUILD_SCRIPT="board/nxp/common/ls/post-custom-skeleton-ubuntu-base-18.04.sh"
BR2_INIT_NONE=y

# toolchain
BR2_TOOLCHAIN_EXTERNAL=y
BR2_TOOLCHAIN_EXTERNAL_LINARO_ARM=y
BR2_TOOLCHAIN_USES_GLIBC=y
BR2_TOOLCHAIN_EXTERNAL_GLIBC=y

# Bootloader
BR2_TARGET_UBOOT=y
BR2_TARGET_UBOOT_BOARDNAME="mx6sabresd"
BR2_TARGET_UBOOT_CUSTOM_GIT=y
BR2_TARGET_UBOOT_FORMAT_IMG=y
BR2_TARGET_UBOOT_SPL=y
BR2_TARGET_UBOOT_SPL_NAME="SPL"

# Kernel
BR2_LINUX_KERNEL=y
BR2_LINUX_KERNEL_CUSTOM_GIT=y
BR2_LINUX_KERNEL_DEFCONFIG="imx_v6_v7"
BR2_LINUX_KERNEL_CONFIG_FRAGMENT_FILES="board/freescale/common/imx/linux-selinux.config board/nxp/common/ls/linux-selinux.config board/nxp/common/ls/linux-dmcrypt.config board/freescale/common/imx/linux-rt.config"
BR2_LINUX_KERNEL_DTS_SUPPORT=y
BR2_LINUX_KERNEL_INTREE_DTS_NAME="imx6q-sabresd"
BR2_LINUX_KERNEL_NEEDS_HOST_OPENSSL=y

# required tools to create the microSD image
BR2_PACKAGE_HOST_DOSFSTOOLS=y
BR2_PACKAGE_HOST_GENIMAGE=y
BR2_PACKAGE_HOST_MTOOLS=y

# ptp4l package
BR2_PACKAGE_QORIQ_PTP4L=y

BR2_PACKAGE_QORIQ_H_LIBXML2=y
BR2_PACKAGE_QORIQ_H_PYTHON_LIBXML2=y

BR2_PACKAGE_IPROUTE2=y
BR2_PACKAGE_ETHTOOL=y

# busybox setting disable
BR2_PACKAGE_BUSYBOX=n
```
