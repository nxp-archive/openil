## configs/nxp_ls1021atsn_optee-sb_defconfig
```kconfig
# Architecture
BR2_arm=y
BR2_cortex_a7=y
BR2_ARM_FPU_NEON=y

# Filesystem
BR2_TARGET_ROOTFS_EXT2=y
BR2_TARGET_ROOTFS_EXT2_4=y
BR2_TARGET_ROOTFS_EXT2_GZIP=y

# Hostname and issue
BR2_TARGET_GENERIC_HOSTNAME="OpenIL"
BR2_TARGET_GENERIC_ISSUE="Welcome to OpenIL"

# Linux headers same as kernel
BR2_PACKAGE_HOST_LINUX_HEADERS_CUSTOM_4_14=y

# toolchain
BR2_TOOLCHAIN_EXTERNAL=y

# bootloader
BR2_TARGET_UBOOT=y
BR2_TARGET_UBOOT_BOARDNAME="ls1021atsn_sdcard_SECURE_BOOT_TEE"
BR2_TARGET_UBOOT_CUSTOM_GIT=y
BR2_TARGET_UBOOT_CUSTOM_REPO_URL="https://github.com/openil/u-boot.git"
BR2_TARGET_UBOOT_CUSTOM_REPO_VERSION="OpenIL-v1.7-u-boot-202001"
BR2_TARGET_UBOOT_NEEDS_DTC=y
BR2_TARGET_UBOOT_FORMAT_BIN=n
BR2_TARGET_UBOOT_FORMAT_CUSTOM=y
BR2_TARGET_UBOOT_FORMAT_CUSTOM_NAME="u-boot-with-spl-pbl.bin u-boot.bin u-boot-dtb.bin spl/u-boot-spl.bin"
BR2_PACKAGE_UBOOT_TOOLS_MKIMAGE=y
BR2_TARGET_UBOOT_ENVIMAGE=y
BR2_TARGET_UBOOT_ENVIMAGE_SOURCE="board/nxp/ls1021atsn/u-boot-environment.txt"
BR2_TARGET_UBOOT_ENVIMAGE_SIZE="0x20000"

# Kernel
BR2_LINUX_KERNEL=y
BR2_LINUX_KERNEL_CUSTOM_GIT=y
BR2_LINUX_KERNEL_CUSTOM_REPO_URL="https://github.com/openil/linux.git"
BR2_LINUX_KERNEL_CUSTOM_REPO_VERSION="OpenIL-v1.7-linux-202001"
BR2_LINUX_KERNEL_DEFCONFIG="multi_v7"
BR2_LINUX_KERNEL_CONFIG_FRAGMENT_FILES="$(LINUX_DIR)/arch/arm/configs/multi_v7_lpae.config $(LINUX_DIR)/arch/arm/configs/lsdk.config board/nxp/common/linux-4_9-optee.config board/nxp/ls1021atsn/linux-tsn.config board/nxp/common/linux-4_9-xenomai.config"
BR2_LINUX_KERNEL_DTS_SUPPORT=y
BR2_LINUX_KERNEL_INTREE_DTS_NAME="ls1021a-tsn"
BR2_LINUX_KERNEL_UIMAGE=y
BR2_LINUX_KERNEL_UIMAGE_LOADADDR="0x80008000"
# Serial port config
BR2_TARGET_GENERIC_GETTY=n
# BR2_TARGET_GENERIC_GETTY_PORT="ttyS0"

# required tools to create the microSD image
BR2_PACKAGE_HOST_DOSFSTOOLS=y
BR2_PACKAGE_HOST_GENIMAGE=y
BR2_PACKAGE_HOST_MTOOLS=y
BR2_ROOTFS_POST_IMAGE_SCRIPT="board/nxp/ls1021atsn/post-image-optee-sb.sh"
BR2_ROOTFS_POST_SCRIPT_ARGS="$(LINUX_DIR) $(TOPDIR)"

# linux partition size
BR2_ROOTFS_PARTITION_SIZE="500M"

# busybox setting
BR2_PACKAGE_BUSYBOX_CONFIG_FRAGMENT_FILES="board/nxp/common/openil-busybox.config"

# uboot-tools for mkimage
BR2_PACKAGE_HOST_UBOOT_TOOLS=y
BR2_PACKAGE_HOST_UBOOT_TOOLS_FIT_SUPPORT=y

# basic packages and tools
BR2_PACKAGE_MTD=y
BR2_PACKAGE_MTD_MTD_DEBUG=y
BR2_PACKAGE_SYSSTAT=y
BR2_PACKAGE_E2FSPROGS=y
BR2_PACKAGE_RT_TESTS=y
BR2_PACKAGE_WGET=y

# packages for xenomai
BR2_PACKAGE_XENOMAI=y
BR2_PACKAGE_XENOMAI_ARCH_SUPPORTS=y
BR2_PACKAGE_XENOMAI_RTCAN=y
BR2_PACKAGE_XENOMAI_ANALOGY=y
BR2_PACKAGE_XENOMAI_NATIVE_SKIN=y
BR2_PACKAGE_XENOMAI_POSIX_SKIN=y
BR2_PACKAGE_XENOMAI_TESTSUITE=y

# ptp4l package
BR2_PACKAGE_PTP4L=y

# resize2fs package
BR2_PACKAGE_E2FSPROGS_RESIZE2FS=y

# optee packages
BR2_PACKAGE_OPTEE_TEST=y
BR2_PACKAGE_HOST_CST=y
BR2_PACKAGE_HOST_CST_CORE_HOLDOFF=y

# For ping-pit-test on 3-board TSN demo
BR2_PACKAGE_WIRESHARK=y

# Add for NETCONF apps
BR2_ROOTFS_OVERLAY="board/nxp/ls1021atsn/rootfs_overlay board/nxp/ls1021atsn/busybox_init_overlay"
BR2_PACKAGE_BUSYBOX_SHOW_OTHERS=y
BR2_TOOLCHAIN_BUILDROOT_CXX=y
BR2_INSTALL_LIBSTDCPP=y
BR2_PACKAGE_BZIP2=y
BR2_PACKAGE_ZIP=y
BR2_PACKAGE_NETPERF=y
BR2_PACKAGE_GENEXT2FS=y
BR2_PACKAGE_STRACE=y
BR2_PACKAGE_TCPDUMP=y
BR2_PACKAGE_IPUTILS=y
BR2_PACKAGE_BC=y

BR2_PACKAGE_DBUS=y
BR2_PACKAGE_DBUS_GLIB=y
BR2_PACKAGE_DBUS_PYTHON=y
BR2_PACKAGE_DBUS_TRIGGERD=y

BR2_PACKAGE_PYTHON=y
BR2_PACKAGE_PYTHON_PY_PYC=y

BR2_PACKAGE_PYTHON_READLINE=y
BR2_PACKAGE_PYTHON_SSL=y
BR2_PACKAGE_PYTHON_UNICODEDATA=y
BR2_PACKAGE_PYTHON_UCS2=y
BR2_PACKAGE_PYTHON_PYEXPAT=y
BR2_PACKAGE_PYTHON_ZLIB=y
BR2_PACKAGE_PYTHON_LIBXML2=y
BR2_PACKAGE_H_PYTHON_LIBXML2=y
BR2_PACKAGE_PYTHON_CURSES=y
BR2_PACKAGE_PYTHON_SETUPTOOLS=y
BR2_PACKAGE_RUBY=y

BR2_PACKAGE_LIBARCHIVE=y
BR2_PACKAGE_ZLIB=y

BR2_PACKAGE_CRYPTODEV=y
BR2_PACKAGE_CRYPTODEV_LINUX=y
BR2_PACKAGE_HAS_CRYPTODEV=y
BR2_PACKAGE_PROVIDES_CRYPTODEV="cryptodev-linux"

BR2_PACKAGE_LIBASSUAN=y
BR2_PACKAGE_LIBGCRYPT=y
BR2_PACKAGE_LIBGPG_ERROR=y
#BR2_PACKAGE_LIBGPG_ERROR_SYSCFG="arm-unknown-linux-gnueabi"
BR2_PACKAGE_LIBGPGME=y

BR2_PACKAGE_LIBSSH=y
BR2_PACKAGE_LIBSSH2=y

BR2_PACKAGE_OPENSSL=y
BR2_PACKAGE_OPENSSL_BIN=y
BR2_PACKAGE_OPENSSL_ENGINES=y

BR2_PACKAGE_EXPAT=y
BR2_PACKAGE_LIBXML2=y
BR2_PACKAGE_H_LIBXML2=y
BR2_PACKAGE_LIBXMLRPC=y
BR2_PACKAGE_LIBXSLT=y
BR2_PACKAGE_HOST_LIBXSLT=y

BR2_PACKAGE_LIBCGI=y
BR2_PACKAGE_LIBCURL=y
BR2_PACKAGE_CURL=y

BR2_PACKAGE_LIBNFNETLINK=y

BR2_PACKAGE_LIBPCAP=y

BR2_PACKAGE_APR=y
BR2_PACKAGE_APR_UTIL=y
BR2_PACKAGE_LIBDAEMON=y
BR2_PACKAGE_LIBEVENT=y
BR2_PACKAGE_LIBFFI=y
BR2_PACKAGE_LIBGLIB2=y


BR2_PACKAGE_NCURSES=y
BR2_PACKAGE_NCURSES_WCHAR=y
BR2_PACKAGE_NCURSES_TARGET_PANEL=y
BR2_PACKAGE_NCURSES_TARGET_FORM=y
BR2_PACKAGE_NCURSES_TARGET_MENU=y
BR2_PACKAGE_NCURSES_TARGET_PROGS=y

BR2_PACKAGE_PCRE=y
BR2_PACKAGE_PCRE_UTF=y
BR2_PACKAGE_PCRE_UCP=y
BR2_PACKAGE_READLINE=y

BR2_PACKAGE_AVAHI=y
BR2_PACKAGE_AVAHI_AUTOIPD=y
BR2_PACKAGE_AVAHI_DAEMON=y
BR2_PACKAGE_AVAHI_LIBDNSSD_COMPATIBILITY=y

BR2_PACKAGE_DHCP_CLIENT=y
BR2_PACKAGE_DHCPCD=y
BR2_PACKAGE_DNSMASQ=y
BR2_PACKAGE_DNSMASQ_TFTP=y

BR2_PACKAGE_ETHTOOL=y

BR2_PACKAGE_IPERF=y
BR2_PACKAGE_IPERF3=y
BR2_PACKAGE_IPROUTE2=y
BR2_PACKAGE_IPTABLES=y

BR2_PACKAGE_OPENSSH=y

BR2_PACKAGE_PINENTRY=y
BR2_PACKAGE_PINENTRY_NCURSES=y
BR2_PACKAGE_PKGCONF=y
BR2_PACKAGE_PYANG=y
BR2_PACKAGE_LIBNETCONF=y
BR2_PACKAGE_NETOPEER=y
BR2_PACKAGE_NETOPEER_CLIENT=y
BR2_PACKAGE_YANG_SJA1105=y
BR2_PACKAGE_SJA1105_TOOL=y

BR2_TARGET_ROOTFS_EXT2_EXTRA_BLOCKS=102400
BR2_TARGET_ROOTFS_EXT2_EXTRA_INODES=102400

# Text editors
BR2_PACKAGE_NANO=y
```

## configs/nxp_ls1021atsn_ubuntu_defconfig
```kconfig
# Architecture
BR2_arm=y
BR2_cortex_a7=y
BR2_ARM_FPU_NEON=y

# Filesystem
BR2_TARGET_ROOTFS_EXT2=y
BR2_TARGET_ROOTFS_EXT2_4=y

# custom skeleton
BR2_ROOTFS_SKELETON_UBUNTU=y
BR2_ROOTFS_SKELETON_CUSTOM=y
BR2_ROOTFS_SKELETON_CUSTOM_SITE="http://cdimage.ubuntu.com/ubuntu-base/releases/18.04.5/release"
BR2_ROOTFS_SKELETON_CUSTOM_SOURCE="ubuntu-base-18.04.5-base-armhf.tar.gz"
BR2_ROOTFS_SKELETON_CUSTOM_SITE_METHOD="wget"
BR2_ROOTFS_SKELETON_CUSTOM_EXTRACT="tar zxvf"
BR2_ROOTFS_SKELETON_CUSTOM_EXTRACT_IGNORE_ERROR=y
BR2_ROOTFS_POST_BUILD_SCRIPT="board/nxp/common/ls/post-custom-skeleton-ubuntu-base-18.04.sh"
BR2_INIT_NONE=y

BR2_ROOTFS_OVERLAY="board/nxp/common/ls/ubuntu_rootfs_resize_overlay"

# toolchain
BR2_TOOLCHAIN_EXTERNAL=y
BR2_TOOLCHAIN_EXTERNAL_LINARO_ARM=y
BR2_TOOLCHAIN_USES_GLIBC=y
BR2_TOOLCHAIN_EXTERNAL_GLIBC=y

# Linux headers same as kernel
BR2_PACKAGE_HOST_LINUX_HEADERS_CUSTOM_5_4=y

# bootloader
BR2_TARGET_UBOOT=y
BR2_TARGET_UBOOT_BOARDNAME="ls1021atsn_sdcard"
BR2_TARGET_UBOOT_CUSTOM_GIT=y
BR2_TARGET_UBOOT_NEEDS_DTC=y
BR2_TARGET_UBOOT_FORMAT_BIN=n
BR2_TARGET_UBOOT_FORMAT_CUSTOM=y
BR2_TARGET_UBOOT_FORMAT_CUSTOM_NAME="u-boot-with-spl-pbl.bin"
BR2_PACKAGE_UBOOT_TOOLS_MKIMAGE=y
BR2_TARGET_UBOOT_ENVIMAGE=y
BR2_TARGET_UBOOT_ENVIMAGE_SOURCE="board/nxp/ls1021atsn/u-boot-environment.txt"
BR2_TARGET_UBOOT_ENVIMAGE_SIZE="0x20000"

# Kernel
BR2_LINUX_KERNEL=y
BR2_LINUX_KERNEL_CUSTOM_GIT=y
BR2_LINUX_KERNEL_DEFCONFIG="multi_v7"
BR2_LINUX_KERNEL_CONFIG_FRAGMENT_FILES="$(LINUX_DIR)/arch/arm/configs/multi_v7_lpae.config $(LINUX_DIR)/arch/arm/configs/lsdk.config"
BR2_LINUX_KERNEL_DTS_SUPPORT=y
BR2_LINUX_KERNEL_INTREE_DTS_NAME="ls1021a-tsn"
BR2_LINUX_KERNEL_UIMAGE=y
BR2_LINUX_KERNEL_UIMAGE_LOADADDR="0x80008000"
BR2_LINUX_KERNEL_NEEDS_HOST_OPENSSL=y

# Serial port config
BR2_TARGET_GENERIC_GETTY=y
BR2_TARGET_GENERIC_GETTY_PORT="ttyS0"

# required tools to create the microSD image
BR2_PACKAGE_HOST_DOSFSTOOLS=y
BR2_PACKAGE_HOST_GENIMAGE=y
BR2_PACKAGE_HOST_MTOOLS=y
BR2_ROOTFS_POST_IMAGE_SCRIPT="board/nxp/ls1021atsn/post-image.sh"
BR2_ROOTFS_POST_SCRIPT_ARGS="$(LINUX_DIR) $(TOPDIR) $(UBOOT_DIR)"

# qoriq-ptp4l package
BR2_PACKAGE_QORIQ_PTP4L=y

BR2_PACKAGE_QORIQ_H_LIBXML2=y
BR2_PACKAGE_QORIQ_H_PYTHON_LIBXML2=y

BR2_PACKAGE_GNUPLOT=y
BR2_PACKAGE_PERL=y
BR2_PACKAGE_QORIQ_PERL_FEEDGNUPLOT=y
BR2_PACKAGE_QORIQ_PRL=y
BR2_PACKAGE_QORIQ_NODEJS_LBT=y
BR2_PACKAGE_QORIQ_TSN_SCRIPTS=y

BR2_PACKAGE_IPROUTE2=y
BR2_PACKAGE_ETHTOOL=y

# busybox setting disable
BR2_PACKAGE_BUSYBOX=n
```

## configs/nxp_ls1028ardb-64b-emmc_defconfig
```kconfig
# Architecture
BR2_aarch64=y
BR2_cortex_a72=y

# Filesystem
BR2_TARGET_ROOTFS_EXT2=y
BR2_TARGET_ROOTFS_EXT2_4=y
BR2_TARGET_ROOTFS_EXT2_LABEL="root"

# Hostname and issue
BR2_TARGET_GENERIC_HOSTNAME="LS1028ARDB"
BR2_TARGET_GENERIC_ISSUE="Welcome to OpenIL"

# toolchain
BR2_TOOLCHAIN_BUILDROOT=y
BR2_TOOLCHAIN_BUILDROOT_GLIBC=y
BR2_BINUTILS_VERSION_2_33_X=y
BR2_GCC_VERSION_9_X=y
BR2_PACKAGE_GLIBC_UTILS=y
BR2_TOOLCHAIN_BUILDROOT_CXX=y

# Linux headers same as kernel
BR2_PACKAGE_HOST_LINUX_HEADERS_CUSTOM_5_4=y

# bootloader
BR2_TARGET_UBOOT=y
BR2_TARGET_UBOOT_FORMAT_DTB_BIN=y
BR2_TARGET_UBOOT_BOARDNAME="ls1028ardb_tfa"
BR2_TARGET_UBOOT_CUSTOM_GIT=y
BR2_TARGET_UBOOT_NEEDS_DTC=y
BR2_TARGET_UBOOT_FORMAT_BIN=n
BR2_TARGET_UBOOT_FORMAT_CUSTOM=y
BR2_TARGET_UBOOT_FORMAT_CUSTOM_NAME="u-boot-dtb.bin"
BR2_PACKAGE_UBOOT_TOOLS_MKIMAGE=y
BR2_TARGET_UBOOT_ENVIMAGE=y
BR2_TARGET_UBOOT_ENVIMAGE_SOURCE="board/nxp/ls1028ardb/u-boot-environment-emmc.txt"
BR2_TARGET_UBOOT_ENVIMAGE_SIZE="0x2000"

# Kernel
BR2_LINUX_KERNEL=y
BR2_LINUX_KERNEL_CUSTOM_GIT=y
BR2_LINUX_KERNEL_USE_ARCH_DEFAULT_CONFIG=y
BR2_LINUX_KERNEL_CONFIG_FRAGMENT_FILES="$(LINUX_DIR)/arch/arm64/configs/lsdk.config board/nxp/ls1028ardb/linux.config "
BR2_LINUX_KERNEL_DTS_SUPPORT=y
BR2_LINUX_KERNEL_INTREE_DTS_NAME="freescale/fsl-ls1028a-rdb"
BR2_LINUX_KERNEL_IMAGE_TARGET_CUSTOM=y
BR2_LINUX_KERNEL_IMAGE_TARGET_NAME="Image"
BR2_LINUX_KERNEL_NEEDS_HOST_OPENSSL=y

# Serial port config
BR2_TARGET_GENERIC_GETTY=y
BR2_TARGET_GENERIC_GETTY_PORT="ttyS0"

# required tools to create the microSD image
BR2_PACKAGE_HOST_DOSFSTOOLS=y
BR2_PACKAGE_HOST_GENIMAGE=y
BR2_PACKAGE_HOST_MTOOLS=y
BR2_ROOTFS_POST_IMAGE_SCRIPT="board/nxp/ls1028ardb/post-image.sh"
BR2_ROOTFS_POST_SCRIPT_ARGS="$(LINUX_DIR) $(TOPDIR) $(UBOOT_DIR)"

# busybox setting
BR2_PACKAGE_BUSYBOX_SHOW_OTHERS=y
BR2_PACKAGE_BUSYBOX_CONFIG_FRAGMENT_FILES="board/nxp/common/ls/busybox.config"

# packages for rcw
BR2_PACKAGE_HOST_QORIQ_RCW=y
BR2_PACKAGE_HOST_QORIQ_RCW_BOOT_MODE="emmc"
BR2_PACKAGE_HOST_QORIQ_RCW_BIN="ls1028ardb/R_SQPP_0x85bb/rcw_1300_emmcboot.bin"

#eudev support
BR2_ROOTFS_DEVICE_CREATION_DYNAMIC_EUDEV=y
BR2_ROOTFS_OVERLAY="board/nxp/common/ls/busybox_rootfs_resize_overlay board/nxp/ls1028ardb/rootfs_overlay board/nxp/common/ls/busybox_init_overlay"

# Arm-Trusted-Firmware
BR2_TARGET_ARM_TRUSTED_FIRMWARE=y
BR2_TARGET_ARM_TRUSTED_FIRMWARE_FIP=y
BR2_TARGET_ARM_TRUSTED_FIRMWARE_UBOOT_AS_BL33=y
BR2_TARGET_ARM_TRUSTED_FIRMWARE_UBOOT_BL33_IMAGE="u-boot-dtb.bin"
BR2_TARGET_ARM_TRUSTED_FIRMWARE_CUSTOM_GIT=y
BR2_TARGET_ARM_TRUSTED_FIRMWARE_CUSTOM_REPO_URL="https://source.codeaurora.org/external/qoriq/qoriq-components/atf"
BR2_TARGET_ARM_TRUSTED_FIRMWARE_PLATFORM="ls1028ardb"
BR2_TARGET_ARM_TRUSTED_FIRMWARE_IMAGES="fip.bin bl2_emmc.pbl"
BR2_TARGET_ARM_TRUSTED_FIRMWARE_ADDITIONAL_TARGETS="pbl"
BR2_TARGET_ARM_TRUSTED_FIRMWARE_ADDITIONAL_DEPENDENCIES="host-qoriq-rcw"
BR2_TARGET_ARM_TRUSTED_FIRMWARE_ADDITIONAL_VARIABLES="BOOT_MODE=emmc RCW=$(BINARIES_DIR)/rcw_1300_emmcboot.bin"

#Display port firmware
BR2_PACKAGE_QORIQ_CADENCE_DP_FIRMWARE=y

# qoriq-ptp4l package
BR2_PACKAGE_QORIQ_PTP4L=y

# qoriq-tsntool
BR2_PACKAGE_CJSON=y
BR2_PACKAGE_QORIQ_TSNTOOL=y
BR2_PACKAGE_QORIQ_TSN_SCRIPTS=y

# qoriq-libnfc support for MikroBus
BR2_PACKAGE_QORIQ_LIBNFC_NCI=y

# qoriq-libblep support for MikroBus
BR2_PACKAGE_QORIQ_LIBBLEP=y

# qoriqi-libbee support for MikroBus
BR2_PACKAGE_QORIQ_LIBBEE=y

# sysrepo-tsn
BR2_PACKAGE_QORIQ_SYSREPO_TSN=y

BR2_PACKAGE_FREESCALE_IMX=y
BR2_PACKAGE_FREESCALE_IMX_PLATFORM_IMX8MP=y
BR2_PACKAGE_FIRMWARE_IMX=y
BR2_PACKAGE_FREESCALE_IMX_HAS_VIV_GPU=y
BR2_PACKAGE_IMX_GPU_VIV=y
BR2_PACKAGE_IMX_GPU_VIV_OUTPUT_WL=y
BR2_PACKAGE_IMX_GPU_VIV_EXAMPLES=y
BR2_PACKAGE_IMX_GPU_VIV_GMEM_INFO=y
BR2_PACKAGE_WAYLAND=y
BR2_PACKAGE_LIBDRM_IMX=y
BR2_PACKAGE_WAYLAND_PROTOCOLS_IMX=y

#weston-imx with wayland
BR2_PACKAGE_WESTON_IMX=y
BR2_PACKAGE_WESTON_IMX_DEFAULT_DRM=y

BR2_PACKAGE_LINUX_PAM=y
BR2_PACKAGE_IMX_GPU_G2D=y
BR2_PACKAGE_PANGO=y
BR2_PACKAGE_XORG7=y
BR2_PACKAGE_KMSCUBE=y

# basic packages and tools
BR2_PACKAGE_MTD=y
BR2_PACKAGE_MTD_MTD_DEBUG=y
BR2_PACKAGE_SYSSTAT=y
BR2_PACKAGE_E2FSPROGS=y
BR2_PACKAGE_RT_TESTS=y
BR2_PACKAGE_OPENSSH=y
BR2_PACKAGE_OPENSSL=y
BR2_PACKAGE_WGET=y

# ca-certs packages
BR2_PACKAGE_CA_CERTIFICATES=y

# dhcpd package
BR2_PACKAGE_DHCPCD=y

# resize2fs package
BR2_PACKAGE_E2FSPROGS_RESIZE2FS=y

# Text editors
BR2_PACKAGE_NANO=y

# IGH ETHERCAT
BR2_PACKAGE_IGH_ETHERCAT=y

#iproute2
BR2_PACKAGE_IPROUTE2=y

#netperf
BR2_PACKAGE_NETPERF=y

BR2_PACKAGE_ETHTOOL=y
BR2_PACKAGE_COLLECTD_CURL=y
BR2_PACKAGE_COLLECTD_CURL_JSON=y
BR2_PACKAGE_COLLECTD_CURL_XML=y
BR2_PACKAGE_LIBCURL=y
BR2_PACKAGE_LIBCURL_CURL
BR2_PACKAGE_LIBCURL_VERBOSE=y
BR2_PACKAGE_FLICKCURL=y
BR2_PACKAGE_FLICKCURL_UTILS=y
BR2_PACKAGE_BASH=y
BR2_SYSTEM_BIN_SH_BASH=y
BR2_SYSTEM_BIN_SH="bash"

# i2c-tools
BR2_PACKAGE_I2C_TOOLS=y

# haveged
BR2_PACKAGE_HAVEGED=y

BR2_USE_MMU=y
BR2_USE_WCHAR=y
BR2_PACKAGE_VIM=y

BR2_INSTALL_LIBSTDCPP=y
BR2_PACKAGE_IPERF=y

BR2_TOOLCHAIN_HAS_THREADS=y
BR2_PACKAGE_IPERF3=y
BR2_PACKAGE_TCPDUMP=y
BR2_PACKAGE_DROPWATCH=y
```
