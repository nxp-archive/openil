## configs/nxp_ls1021aiot_baremetal_defconfig
```kconfig
# Architecture
BR2_arm=y
BR2_cortex_a7=y
BR2_ARM_FPU_NEON=y

# Filesystem
BR2_TARGET_ROOTFS_EXT2=y
BR2_TARGET_ROOTFS_EXT2_4=y
BR2_ROOTFS_RESIZE=y

# Hostname and issue
BR2_TARGET_GENERIC_HOSTNAME="LS1021AIOT"
BR2_TARGET_GENERIC_ISSUE="Welcome to OpenIL"

# toolchain
BR2_TOOLCHAIN_EXTERNAL=y
BR2_TOOLCHAIN_EXTERNAL_ARM_ARM=y
BR2_TOOLCHAIN_USES_GLIBC=y
BR2_TOOLCHAIN_EXTERNAL_GLIBC=y

# Linux headers same as kernel
BR2_PACKAGE_HOST_LINUX_HEADERS_CUSTOM_5_4=y

# bootloader
BR2_TARGET_UBOOT=y
BR2_TARGET_UBOOT_BOARDNAME="ls1021aiot_sdcard_baremetal"
BR2_TARGET_UBOOT_CUSTOM_GIT=y
BR2_TARGET_UBOOT_NEEDS_DTC=y
BR2_TARGET_UBOOT_FORMAT_BIN=n
BR2_TARGET_UBOOT_FORMAT_CUSTOM=y
BR2_TARGET_UBOOT_FORMAT_CUSTOM_NAME="u-boot-with-spl-pbl.bin"
BR2_PACKAGE_UBOOT_TOOLS_MKIMAGE=y
BR2_TARGET_UBOOT_ENVIMAGE=y
BR2_TARGET_UBOOT_ENVIMAGE_SOURCE="board/nxp/ls1021aiot/u-boot-environment-baremetal.txt"
BR2_TARGET_UBOOT_ENVIMAGE_SIZE="0x2000"

# Kernel
BR2_LINUX_KERNEL=y
BR2_LINUX_KERNEL_CUSTOM_GIT=y
BR2_LINUX_KERNEL_DEFCONFIG="multi_v7"
BR2_LINUX_KERNEL_CONFIG_FRAGMENT_FILES="$(LINUX_DIR)/arch/arm/configs/multi_v7_lpae.config $(LINUX_DIR)/arch/arm/configs/lsdk.config board/nxp/common/ls/linux-wifi.config board/nxp/ls1021aiot/linux-baremetal.config board/nxp/common/ls/linux-rt.config"
BR2_LINUX_KERNEL_DTS_SUPPORT=y
BR2_LINUX_KERNEL_INTREE_DTS_NAME="ls1021a-iot-bm"
BR2_LINUX_KERNEL_UIMAGE=y
BR2_LINUX_KERNEL_UIMAGE_LOADADDR="0x80008000"
BR2_LINUX_KERNEL_NEEDS_HOST_OPENSSL=y

# Serial port config
BR2_TARGET_GENERIC_GETTY=y
BR2_TARGET_GENERIC_GETTY_PORT="ttyS0"

# required tools to create the microSD image
BR2_PACKAGE_HOST_DOSFSTOOLS=y
BR2_PACKAGE_HOST_GENIMAGE=y
BR2_PACKAGE_HOST_MTOOLS=y
BR2_ROOTFS_POST_IMAGE_SCRIPT="board/nxp/ls1021aiot/post-image-baremetal.sh"
BR2_ROOTFS_POST_SCRIPT_ARGS="$(LINUX_DIR) $(TOPDIR) $(UBOOT_DIR)"

# busybox setting
BR2_PACKAGE_BUSYBOX_CONFIG_FRAGMENT_FILES="board/nxp/common/ls/busybox.config"
BR2_PACKAGE_BUSYBOX_SHOW_OTHERS=y

#eudev support
BR2_ROOTFS_DEVICE_CREATION_DYNAMIC_EUDEV=y
BR2_ROOTFS_OVERLAY="board/nxp/common/ls/busybox_init_overlay board/nxp/ls1021aiot/rootfs_overlay/"

# Baremetal u-boot package
BR2_PACKAGE_QORIQ_BM_UBOOT=y
BR2_PACKAGE_QORIQ_BM_UBOOT_VERSION="OpenIL-v1.11-Baremetal-202104"
BR2_PACKAGE_QORIQ_BM_UBOOT_DEFCONFIG="ls1021aiot_baremetal_defconfig"

# icc package for baremetal
BR2_PACKAGE_QORIQ_ICC=y
BR2_PACKAGE_QORIQ_ICC_MAX_CPUS=2

# qoriq-ptp4l package
BR2_PACKAGE_QORIQ_PTP4L=y

# basic packages and tools
BR2_PACKAGE_MTD=y
BR2_PACKAGE_MTD_MTD_DEBUG=y
BR2_PACKAGE_SYSSTAT=y
BR2_PACKAGE_E2FSPROGS=y
BR2_PACKAGE_RT_TESTS=y
BR2_PACKAGE_OPENSSH=y
BR2_PACKAGE_OPENSSL=y
BR2_PACKAGE_WGET=y

# networking packages
BR2_PACKAGE_LIBSOCKETCAN=y

# ca-certs packages
BR2_PACKAGE_CA_CERTIFICATES=y

# dhcpd package
BR2_PACKAGE_DHCPCD=y

# wifi feature packages
BR2_PACKAGE_DHCP=y
BR2_PACKAGE_DHCP_SERVER=y
BR2_PACKAGE_DHCP_SERVER_DELAYED_ACK=y
BR2_PACKAGE_DNSMASQ=y
BR2_PACKAGE_HOSTAPD=y
BR2_PACKAGE_WIRELESS_TOOLS=y

# resize2fs package
BR2_PACKAGE_E2FSPROGS_RESIZE2FS=y

# Text editors
BR2_PACKAGE_NANO=y

# IGH ETHERCAT
BR2_PACKAGE_IGH_ETHERCAT=y

# can packages
BR2_PACKAGE_CAN_UTILS=y
BR2_PACKAGE_CANFESTIVAL=y
BR2_PACKAGE_CANFESTIVAL_ARCH_SUPPORTS=y

#iproute2
BR2_PACKAGE_IPROUTE2=y

#netperf
BR2_PACKAGE_NETPERF=y

BR2_PACKAGE_ETHTOOL=y
BR2_PACKAGE_COLLECTD_CURL=y
BR2_PACKAGE_COLLECTD_CURL_JSON=y
BR2_PACKAGE_COLLECTD_CURL_XML=y
BR2_PACKAGE_LIBCURL=y
BR2_PACKAGE_LIBCURL_CURL=y
BR2_PACKAGE_LIBCURL_VERBOSE=y
BR2_PACKAGE_FLICKCURL=y
BR2_PACKAGE_FLICKCURL_UTILS=y
BR2_PACKAGE_BASH=y
BR2_SYSTEM_BIN_SH_BASH=y
BR2_SYSTEM_BIN_SH="bash"

# haveged
BR2_PACKAGE_HAVEGED=y

#avahi
BR2_PACKAGE_AVAHI=y
BR2_PACKAGE_AVAHI_AUTOIPD=y
BR2_PACKAGE_AVAHI_DAEMON=y
BR2_PACKAGE_AVAHI_LIBDNSSD_COMPATIBILITY=y
BR2_PACKAGE_NSS_MDNS=y

# i2c-tools
BR2_PACKAGE_I2C_TOOLS=y

BR2_USE_MMU=y
BR2_USE_WCHAR=y
BR2_PACKAGE_VIM=y

BR2_INSTALL_LIBSTDCPP=y
BR2_PACKAGE_IPERF=y

BR2_TOOLCHAIN_HAS_THREADS=y
BR2_PACKAGE_IPERF3=y
BR2_PACKAGE_TCPDUMP=y

# OPC UA tools
BR2_PACKAGE_LIBOPEN62541=y
BR2_PACKAGE_LIBOPEN62541_BUILD_EXAMPLES=y
```

## configs/nxp_ls1021aiot_optee_defconfig
```kconfig
# Architecture
BR2_arm=y
BR2_cortex_a7=y
BR2_ARM_FPU_NEON=y

# Filesystem
BR2_TARGET_ROOTFS_EXT2=y
BR2_TARGET_ROOTFS_EXT2_4=y
BR2_TARGET_ROOTFS_EXT2_GZIP=y

# Hostname and issue
BR2_TARGET_GENERIC_HOSTNAME="OpenIL"
BR2_TARGET_GENERIC_ISSUE="Welcome to OpenIL"

# Linux headers same as kernel
BR2_PACKAGE_HOST_LINUX_HEADERS_CUSTOM_4_14=y

# toolchain
BR2_TOOLCHAIN_EXTERNAL=y

# bootloader
BR2_TARGET_UBOOT=y
BR2_TARGET_UBOOT_BOARDNAME="ls1021aiot_sdcard_tee"
BR2_TARGET_UBOOT_CUSTOM_GIT=y
BR2_TARGET_UBOOT_CUSTOM_REPO_URL="https://github.com/openil/u-boot.git"
BR2_TARGET_UBOOT_CUSTOM_REPO_VERSION="OpenIL-v1.7-u-boot-202001"
BR2_TARGET_UBOOT_NEEDS_DTC=y
BR2_TARGET_UBOOT_FORMAT_BIN=n
BR2_TARGET_UBOOT_FORMAT_CUSTOM=y
BR2_TARGET_UBOOT_FORMAT_CUSTOM_NAME="u-boot-with-spl-pbl.bin"
BR2_PACKAGE_UBOOT_TOOLS_MKIMAGE=y
BR2_TARGET_UBOOT_ENVIMAGE=y
BR2_TARGET_UBOOT_ENVIMAGE_SOURCE="board/nxp/ls1021aiot/u-boot-environment.txt"
BR2_TARGET_UBOOT_ENVIMAGE_SIZE="0x2000"

# Kernel
BR2_LINUX_KERNEL=y
BR2_LINUX_KERNEL_CUSTOM_GIT=y
BR2_LINUX_KERNEL_CUSTOM_REPO_URL="https://github.com/openil/linux.git"
BR2_LINUX_KERNEL_CUSTOM_REPO_VERSION="OpenIL-v1.7-linux-202001"
BR2_LINUX_KERNEL_DEFCONFIG="multi_v7"
BR2_LINUX_KERNEL_CONFIG_FRAGMENT_FILES="$(LINUX_DIR)/arch/arm/configs/multi_v7_lpae.config $(LINUX_DIR)/arch/arm/configs/lsdk.config board/nxp/common/linux-4_9-optee.config board/nxp/common/linux-4_9-docker.config board/nxp/common/linux-4_9-xenomai.config"
BR2_LINUX_KERNEL_DTS_SUPPORT=y
BR2_LINUX_KERNEL_INTREE_DTS_NAME="ls1021a-iot"
BR2_LINUX_KERNEL_UIMAGE=y
BR2_LINUX_KERNEL_UIMAGE_LOADADDR="0x80008000"
# Serial port config
BR2_TARGET_GENERIC_GETTY=n
# BR2_TARGET_GENERIC_GETTY_PORT="ttyS0"

# required tools to create the microSD image
BR2_PACKAGE_HOST_DOSFSTOOLS=y
BR2_PACKAGE_HOST_GENIMAGE=y
BR2_PACKAGE_HOST_MTOOLS=y
BR2_ROOTFS_POST_IMAGE_SCRIPT="board/nxp/ls1021aiot/post-image-optee.sh"

# extend the partition size
BR2_TARGET_ROOTFS_EXT2_EXTRA_BLOCKS=102400
BR2_TARGET_ROOTFS_EXT2_EXTRA_INODES=102400

# busybox setting
BR2_PACKAGE_BUSYBOX_CONFIG_FRAGMENT_FILES="board/nxp/common/openil-busybox.config"
BR2_PACKAGE_BUSYBOX_SHOW_OTHERS=y

# uboot-tools for mkimage
BR2_PACKAGE_HOST_UBOOT_TOOLS=y
BR2_PACKAGE_HOST_UBOOT_TOOLS_FIT_SUPPORT=y

# Add ota overlay
BR2_ROOTFS_OVERLAY="board/nxp/common/ota_overlay board/nxp/common/busybox_init_overlay"

# basic packages and tools
BR2_PACKAGE_MTD=y
BR2_PACKAGE_MTD_MTD_DEBUG=y
BR2_PACKAGE_SYSSTAT=y
BR2_PACKAGE_E2FSPROGS=y
BR2_PACKAGE_RT_TESTS=y
BR2_PACKAGE_OPENSSH=y
BR2_PACKAGE_OPENSSL=y
BR2_PACKAGE_WGET=y

# packages for xenomai
BR2_PACKAGE_XENOMAI=y
BR2_PACKAGE_XENOMAI_ARCH_SUPPORTS=y
BR2_PACKAGE_XENOMAI_RTCAN=y
BR2_PACKAGE_XENOMAI_ANALOGY=y
BR2_PACKAGE_XENOMAI_NATIVE_SKIN=y
BR2_PACKAGE_XENOMAI_POSIX_SKIN=y
BR2_PACKAGE_XENOMAI_TESTSUITE=y

# ptp4l package
BR2_PACKAGE_PTP4L=y

# docker packages
BR2_PACKAGE_DOCKER_CONTAINERD=y
BR2_PACKAGE_DOCKER_ENGINE=y
BR2_PACKAGE_DOCKER_ENGINE_DAEMON=y
BR2_PACKAGE_DOCKER_ENGINE_EXPERIMENTAL=y
BR2_PACKAGE_DOCKER_ENGINE_DRIVER_BTRFS=y
BR2_PACKAGE_DOCKER_ENGINE_DRIVER_DEVICEMAPPER=y
BR2_PACKAGE_DOCKER_ENGINE_DRIVER_VFS=y
BR2_PACKAGE_UTIL_LINUX_LIBMOUNT=y
BR2_PACKAGE_CGROUPFS_MOUNT=y
BR2_PACKAGE_LIBCGROUP=y

# ca-certs packages
BR2_PACKAGE_CA_CERTIFICATES=y

# dhcpd package
BR2_PACKAGE_DHCPCD=y

# resize2fs package
BR2_PACKAGE_E2FSPROGS_RESIZE2FS=y

# optee packages
BR2_PACKAGE_OPTEE_TEST=y

# Text editors
BR2_PACKAGE_NANO=y

# IGH ETHERCAT
BR2_PACKAGE_IGH_ETHERCAT=y
```

## configs/nxp_ls1021atsn_defconfig
```kconfig
# Architecture
BR2_arm=y
BR2_cortex_a7=y
BR2_ARM_FPU_NEON=y

# Filesystem
BR2_TARGET_ROOTFS_EXT2=y
BR2_TARGET_ROOTFS_EXT2_4=y
BR2_TARGET_ROOTFS_EXT2_LABEL="root"
BR2_ROOTFS_RESIZE=y

# Hostname and issue
BR2_TARGET_GENERIC_HOSTNAME="LS1021ATSN"
BR2_TARGET_GENERIC_ISSUE="Welcome to OpenIL"

# toolchain
BR2_TOOLCHAIN_EXTERNAL=y
BR2_TOOLCHAIN_EXTERNAL_ARM_ARM=y
BR2_TOOLCHAIN_USES_GLIBC=y
BR2_TOOLCHAIN_EXTERNAL_GLIBC=y

# Linux headers same as kernel
BR2_PACKAGE_HOST_LINUX_HEADERS_CUSTOM_5_4=y

# bootloader
BR2_TARGET_UBOOT=y
BR2_TARGET_UBOOT_BOARDNAME="ls1021atsn_sdcard"
BR2_TARGET_UBOOT_CUSTOM_GIT=y
BR2_TARGET_UBOOT_NEEDS_DTC=y
BR2_TARGET_UBOOT_FORMAT_BIN=n
BR2_TARGET_UBOOT_FORMAT_CUSTOM=y
BR2_TARGET_UBOOT_FORMAT_CUSTOM_NAME="u-boot-with-spl-pbl.bin"
BR2_PACKAGE_UBOOT_TOOLS_MKIMAGE=y
BR2_TARGET_UBOOT_ENVIMAGE=y
BR2_TARGET_UBOOT_ENVIMAGE_SOURCE="board/nxp/ls1021atsn/u-boot-environment.txt"
BR2_TARGET_UBOOT_ENVIMAGE_SIZE="0x20000"

# Kernel
BR2_LINUX_KERNEL=y
BR2_LINUX_KERNEL_CUSTOM_GIT=y
BR2_LINUX_KERNEL_DEFCONFIG="multi_v7"
BR2_LINUX_KERNEL_CONFIG_FRAGMENT_FILES="$(LINUX_DIR)/arch/arm/configs/multi_v7_lpae.config $(LINUX_DIR)/arch/arm/configs/lsdk.config"
BR2_LINUX_KERNEL_DTS_SUPPORT=y
BR2_LINUX_KERNEL_INTREE_DTS_NAME="ls1021a-tsn"
BR2_LINUX_KERNEL_UIMAGE=y
BR2_LINUX_KERNEL_UIMAGE_LOADADDR="0x80008000"
BR2_LINUX_KERNEL_NEEDS_HOST_OPENSSL=y

# Serial port config
BR2_TARGET_GENERIC_GETTY=y
BR2_TARGET_GENERIC_GETTY_PORT="ttyS0"

# required tools to create the microSD image
BR2_PACKAGE_HOST_DOSFSTOOLS=y
BR2_PACKAGE_HOST_GENIMAGE=y
BR2_PACKAGE_HOST_MTOOLS=y
BR2_ROOTFS_POST_IMAGE_SCRIPT="board/nxp/ls1021atsn/post-image.sh"
BR2_ROOTFS_POST_SCRIPT_ARGS="$(LINUX_DIR) $(TOPDIR) $(UBOOT_DIR)"

BR2_INIT_SYSTEMD=y
BR2_PACKAGE_SYSTEMD_LOCALED=y

# busybox setting
BR2_PACKAGE_BUSYBOX_CONFIG_FRAGMENT_FILES="board/nxp/common/ls/busybox.config"
BR2_PACKAGE_BUSYBOX_SHOW_OTHERS=y

#eudev support
BR2_ROOTFS_DEVICE_CREATION_DYNAMIC_EUDEV=y
BR2_ROOTFS_OVERLAY="board/nxp/ls1021atsn/rootfs_overlay"

# qoriq-ptp4l package
BR2_PACKAGE_QORIQ_PTP4L=y

BR2_PACKAGE_QORIQ_H_LIBXML2=y
BR2_PACKAGE_QORIQ_H_PYTHON_LIBXML2=y

BR2_PACKAGE_GNUPLOT=y
BR2_PACKAGE_PERL=y
BR2_PACKAGE_QORIQ_PERL_FEEDGNUPLOT=y
BR2_PACKAGE_QORIQ_PRL=y
BR2_PACKAGE_QORIQ_NODEJS_LBT=y
BR2_PACKAGE_QORIQ_TSN_SCRIPTS=y

# sysrepo-tsn
BR2_PACKAGE_QORIQ_SYSREPO_TSN=y

# basic packages and tools
BR2_PACKAGE_MTD=y
BR2_PACKAGE_MTD_MTD_DEBUG=y
BR2_PACKAGE_SYSSTAT=y
BR2_PACKAGE_E2FSPROGS=y
BR2_PACKAGE_RT_TESTS=y
BR2_PACKAGE_WGET=y

# ca-certs packages
BR2_PACKAGE_CA_CERTIFICATES=y

# resize2fs package
BR2_PACKAGE_E2FSPROGS_RESIZE2FS=y

# Text editors
BR2_PACKAGE_NANO=y

# IGH ETHERCAT
BR2_PACKAGE_IGH_ETHERCAT=y

BR2_PACKAGE_ETHTOOL=y
BR2_PACKAGE_COLLECTD_CURL=y
BR2_PACKAGE_COLLECTD_CURL_JSON=y
BR2_PACKAGE_COLLECTD_CURL_XML=y
BR2_PACKAGE_LIBCURL=y
BR2_PACKAGE_LIBCURL_CURL=y
BR2_PACKAGE_LIBCURL_VERBOSE=y
BR2_PACKAGE_FLICKCURL=y
BR2_PACKAGE_FLICKCURL_UTILS=y
BR2_PACKAGE_BASH=y
BR2_PACKAGE_BASH_COMPLETION=y
BR2_SYSTEM_BIN_SH_BASH=y
BR2_SYSTEM_BIN_SH="bash"

# haveged
BR2_PACKAGE_HAVEGED=y

#avahi
BR2_PACKAGE_AVAHI=y
BR2_PACKAGE_AVAHI_AUTOIPD=y
BR2_PACKAGE_AVAHI_DAEMON=y
BR2_PACKAGE_AVAHI_LIBDNSSD_COMPATIBILITY=y
BR2_PACKAGE_NSS_MDNS=y

BR2_TOOLCHAIN_BUILDROOT_CXX=y
BR2_INSTALL_LIBSTDCPP=y
BR2_PACKAGE_BZIP2=y
BR2_PACKAGE_ZIP=y
BR2_PACKAGE_NETPERF=y
BR2_PACKAGE_GENEXT2FS=y
BR2_PACKAGE_STRACE=y
BR2_PACKAGE_TCPDUMP=y
BR2_PACKAGE_DROPWATCH=y
BR2_PACKAGE_IPUTILS=y
BR2_PACKAGE_BC=y

BR2_PACKAGE_DBUS=y
BR2_PACKAGE_DBUS_GLIB=y
BR2_PACKAGE_DBUS_PYTHON=y
BR2_PACKAGE_DBUS_TRIGGERD=y

BR2_PACKAGE_PYTHON=y
BR2_PACKAGE_PYTHON_PY_PYC=y

BR2_PACKAGE_PYTHON_READLINE=y
BR2_PACKAGE_PYTHON_SSL=y
BR2_PACKAGE_PYTHON_UNICODEDATA=y
BR2_PACKAGE_PYTHON_UCS2=y
BR2_PACKAGE_PYTHON_PYEXPAT=y
BR2_PACKAGE_PYTHON_ZLIB=y
BR2_PACKAGE_PYTHON_LIBXML2=y
BR2_PACKAGE_PYTHON_CURSES=y
BR2_PACKAGE_PYTHON_SETUPTOOLS=y
BR2_PACKAGE_RUBY=y

BR2_PACKAGE_OPKG=y
BR2_PACKAGE_OPKG_GPG_SIGN=y
BR2_PACKAGE_TAR=y

BR2_PACKAGE_LIBARCHIVE=y
BR2_PACKAGE_LIBARCHIVE_BSDTAR=y
BR2_PACKAGE_LIBARCHIVE_BSDCAT=y
BR2_PACKAGE_LIBARCHIVE_BSDCPIO=y
BR2_PACKAGE_ZLIB=y

BR2_PACKAGE_CRYPTODEV=y
BR2_PACKAGE_CRYPTODEV_LINUX=y
BR2_PACKAGE_HAS_CRYPTODEV=y
BR2_PACKAGE_PROVIDES_CRYPTODEV="cryptodev-linux"

BR2_PACKAGE_LIBASSUAN=y
BR2_PACKAGE_LIBGCRYPT=y
BR2_PACKAGE_LIBGPG_ERROR=y
BR2_PACKAGE_LIBGPGME=y

BR2_PACKAGE_LIBSSH=y
BR2_PACKAGE_LIBSSH2=y

BR2_PACKAGE_OPENSSL=y
BR2_PACKAGE_OPENSSL_BIN=y
BR2_PACKAGE_OPENSSL_ENGINES=y
BR2_PACKAGE_OPENSSH=y

BR2_PACKAGE_EXPAT=y
BR2_PACKAGE_LIBXML2=y
BR2_PACKAGE_LIBXMLRPC=y
BR2_PACKAGE_LIBXSLT=y

BR2_PACKAGE_LIBCGI=y

BR2_PACKAGE_LIBNFNETLINK=y

BR2_PACKAGE_LIBPCAP=y

BR2_PACKAGE_APR=y
BR2_PACKAGE_APR_UTIL=y
BR2_PACKAGE_LIBDAEMON=y
BR2_PACKAGE_LIBEVENT=y
BR2_PACKAGE_LIBFFI=y
BR2_PACKAGE_LIBGLIB2=y

BR2_PACKAGE_NCURSES=y
BR2_PACKAGE_NCURSES_WCHAR=y
BR2_PACKAGE_NCURSES_TARGET_PANEL=y
BR2_PACKAGE_NCURSES_TARGET_FORM=y
BR2_PACKAGE_NCURSES_TARGET_MENU=y
BR2_PACKAGE_NCURSES_TARGET_PROGS=y

BR2_PACKAGE_PCRE=y
BR2_PACKAGE_PCRE_UTF=y
BR2_PACKAGE_PCRE_UCP=y
BR2_PACKAGE_READLINE=y

BR2_PACKAGE_DNSMASQ=y
BR2_PACKAGE_DNSMASQ_TFTP=y

BR2_PACKAGE_IPERF=y
BR2_PACKAGE_IPERF3=y
BR2_PACKAGE_IPROUTE2=y
BR2_PACKAGE_IPTABLES=y
BR2_PACKAGE_LIBMNL=y

BR2_PACKAGE_PINENTRY=y
BR2_PACKAGE_PINENTRY_NCURSES=y
BR2_PACKAGE_PKGCONF=y

BR2_PACKAGE_TMUX=y
BR2_PACKAGE_IRQBALANCE=y

BR2_USE_MMU=y
BR2_USE_WCHAR=y
BR2_PACKAGE_VIM=y

BR2_TOOLCHAIN_HAS_THREADS=y
```
