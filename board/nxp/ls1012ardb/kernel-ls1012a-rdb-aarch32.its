## configs/imx8mmevk_revb_ubuntu_defconfig
```kconfig
BR2_aarch64=y
BR2_cortex_a53=y
BR2_ARM_FPU_VFPV3=y

BR2_TARGET_ROOTFS_EXT2=y
BR2_TARGET_ROOTFS_EXT2_4=y

# custom skeleton
BR2_ROOTFS_SKELETON_UBUNTU=y
BR2_ROOTFS_SKELETON_CUSTOM=y
BR2_ROOTFS_SKELETON_CUSTOM_SITE="http://cdimage.ubuntu.com/ubuntu-base/releases/18.04.5/release"
BR2_ROOTFS_SKELETON_CUSTOM_SOURCE="ubuntu-base-18.04.5-base-arm64.tar.gz"
BR2_ROOTFS_SKELETON_CUSTOM_SITE_METHOD="wget"
BR2_ROOTFS_SKELETON_CUSTOM_EXTRACT="tar zxvf"
BR2_ROOTFS_SKELETON_CUSTOM_EXTRACT_IGNORE_ERROR=y
BR2_ROOTFS_POST_BUILD_SCRIPT="board/nxp/common/ls/post-custom-skeleton-ubuntu-base-18.04.sh"
BR2_INIT_NONE=y

BR2_ROOTFS_OVERLAY="board/nxp/common/ls/ubuntu_rootfs_resize_overlay"

# toolchain
BR2_TOOLCHAIN_EXTERNAL=y
BR2_TOOLCHAIN_EXTERNAL_ARM_AARCH64=y
BR2_TOOLCHAIN_USES_GLIBC=y
BR2_TOOLCHAIN_EXTERNAL_GLIBC=y

BR2_TARGET_UBOOT=y
BR2_TARGET_UBOOT_BUILD_SYSTEM_KCONFIG=y
BR2_TARGET_UBOOT_CUSTOM_GIT=y
BR2_TARGET_UBOOT_CUSTOM_REPO_URL="https://github.com/openil/u-boot.git"
BR2_TARGET_UBOOT_CUSTOM_REPO_VERSION="OpenIL-v1.10-u-boot-imx-202012"
BR2_TARGET_UBOOT_BOARD_DEFCONFIG="imx8mm_evk_revb"
BR2_TARGET_UBOOT_NEEDS_DTC=y
BR2_TARGET_UBOOT_FORMAT_CUSTOM=y
BR2_TARGET_UBOOT_FORMAT_CUSTOM_NAME="u-boot-nodtb.bin"
BR2_TARGET_UBOOT_SPL=y
#BR2_TARGET_UBOOT_PATCH="board/freescale/imx8mmevk/patches/uboot"
BR2_PACKAGE_HOST_DOSFSTOOLS=y
BR2_PACKAGE_HOST_GENIMAGE=y
BR2_PACKAGE_HOST_IMX_MKIMAGE=y
BR2_PACKAGE_HOST_MTOOLS=y
BR2_PACKAGE_HOST_UBOOT_TOOLS=y
BR2_PACKAGE_HOST_UBOOT_TOOLS_FIT_SUPPORT=y

BR2_PACKAGE_HOST_LINUX_HEADERS_CUSTOM_5_4=y
BR2_TARGET_GENERIC_GETTY_PORT="ttymxc1"
BR2_ROOTFS_POST_IMAGE_SCRIPT="board/freescale/common/imx/imx8-bootloader-prepare.sh board/freescale/common/imx/post-image.sh"
BR2_ROOTFS_POST_SCRIPT_ARGS="${UBOOT_DIR}/arch/arm/dts/imx8mm-evk.dtb"

BR2_LINUX_KERNEL=y
BR2_LINUX_KERNEL_CUSTOM_GIT=y
BR2_LINUX_KERNEL_USE_ARCH_DEFAULT_CONFIG=y
BR2_LINUX_KERNEL_CUSTOM_REPO_VERSION="OpenIL-v1.10-linux-imx8-202012"
BR2_LINUX_KERNEL_CONFIG_FRAGMENT_FILES="$(LINUX_DIR)/arch/arm64/configs/imx_v8_defconfig board/freescale/imx8mpevk/linux.config board/nxp/common/ls/linux-rt.config"
BR2_LINUX_KERNEL_DTS_SUPPORT=y
BR2_LINUX_KERNEL_INTREE_DTS_NAME="freescale/imx8mm-evk-revb"
#BR2_LINUX_KERNEL_IMAGE=y
#BR2_LINUX_KERNEL_IMAGE_TARGET_CUSTOM=y
#BR2_LINUX_KERNEL_IMAGE_TARGET_NAME="Image"
BR2_LINUX_KERNEL_NEEDS_HOST_OPENSSL=y

BR2_PACKAGE_FREESCALE_IMX=y
BR2_PACKAGE_FREESCALE_IMX_PLATFORM_IMX8MM=y
BR2_PACKAGE_FIRMWARE_IMX=y
BR2_PACKAGE_FREESCALE_IMX_HAS_VIV_GPU=y
BR2_PACKAGE_IMX_GPU_VIV=y
BR2_PACKAGE_IMX_GPU_VIV_OUTPUT_WL=y
BR2_PACKAGE_IMX_GPU_VIV_EXAMPLES=y
BR2_PACKAGE_IMX_GPU_VIV_GMEM_INFO=y
BR2_PACKAGE_WAYLAND=y
BR2_PACKAGE_LIBDRM_IMX=y
BR2_PACKAGE_WAYLAND_PROTOCOLS_IMX=y

#weston-imx with wayland
BR2_PACKAGE_WESTON_IMX=y
BR2_PACKAGE_WESTON_IMX_DEFAULT_DRM=y

BR2_PACKAGE_LINUX_PAM=y
BR2_PACKAGE_IMX_GPU_G2D=y
BR2_PACKAGE_PANGO=y
BR2_PACKAGE_XORG7=y
BR2_PACKAGE_KMSCUBE=y

BR2_ROOTFS_DEVICE_CREATION_DYNAMIC_EUDEV=y
BR2_PACKAGE_EUDEV=y

# qoriq-ptp4l package
BR2_PACKAGE_QORIQ_PTP4L=y

BR2_PACKAGE_CJSON=y
BR2_PACKAGE_QORIQ_TSNTOOL=y

BR2_TARGET_ARM_TRUSTED_FIRMWARE=y
BR2_TARGET_ARM_TRUSTED_FIRMWARE_CUSTOM_GIT=y
BR2_TARGET_ARM_TRUSTED_FIRMWARE_CUSTOM_REPO_URL="https://source.codeaurora.org/external/imx/imx-atf"
BR2_TARGET_ARM_TRUSTED_FIRMWARE_CUSTOM_REPO_VERSION="rel_imx_5.4.24_2.1.0"
BR2_TARGET_ARM_TRUSTED_FIRMWARE_PLATFORM="imx8mm"
BR2_TARGET_ARM_TRUSTED_FIRMWARE_BL31=y

BR2_PACKAGE_IMX_CODEC=y
BR2_PACKAGE_IMX_PARSER=y

BR2_PACKAGE_GSTREAMER_IMX=y
BR2_PACKAGE_GST_PLUGIN_IMX=y
BR2_PACKAGE_GST_PLUGINS_BASE_IMX=y
BR2_PACKAGE_GST_PLUGINS_BASE_IMX_PLUGIN_VIDEOTESTSRC=y
BR2_PACKAGE_GST_PLUGINS_BASE_IMX_PLUGIN_VIDEOCONVERT=y
BR2_PACKAGE_GST_PLUGINS_BAD_IMX=y
BR2_PACKAGE_GST_PLUGINS_BAD_IMX_PLUGIN_WAYLAND=y
BR2_PACKAGE_GST_PLUGINS_BAD_IMX_PLUGIN_FBDEV=y
BR2_PACKAGE_GST_PLUGINS_GOOD_IMX=y
BR2_PACKAGE_GST_PLUGINS_GOOD_IMX_PLUGIN_AUTODETECT=y
BR2_PACKAGE_GST_PLUGINS_GOOD_IMX_PLUGIN_V4L2=y

BR2_COMPILER_PARANOID_UNSAFE_PATH=n

BR2_PACKAGE_IPROUTE2=y
BR2_PACKAGE_ETHTOOL=y

# busybox setting disable
BR2_PACKAGE_BUSYBOX=n
```

## configs/imx8mpevk_defconfig
```kconfig
BR2_aarch64=y
BR2_cortex_a53=y
BR2_ARM_FPU_VFPV3=y

BR2_TARGET_ROOTFS_EXT2=y
BR2_TARGET_ROOTFS_EXT2_4=y
BR2_ROOTFS_RESIZE=y

# Hostname and issue
BR2_TARGET_GENERIC_HOSTNAME="IMX8MPEVK"
BR2_TARGET_GENERIC_ISSUE="Welcome to OpenIL"

# toolchain
BR2_TOOLCHAIN_EXTERNAL=y
BR2_TOOLCHAIN_EXTERNAL_ARM_AARCH64=y
BR2_TOOLCHAIN_USES_GLIBC=y
BR2_TOOLCHAIN_EXTERNAL_GLIBC=y

BR2_TARGET_UBOOT=y
BR2_TARGET_UBOOT_BUILD_SYSTEM_KCONFIG=y
BR2_TARGET_UBOOT_CUSTOM_GIT=y
BR2_TARGET_UBOOT_CUSTOM_REPO_URL="https://source.codeaurora.org/external/imx/uboot-imx"
BR2_TARGET_UBOOT_CUSTOM_REPO_VERSION="rel_imx_5.4.24_2.1.0"
BR2_TARGET_UBOOT_BOARD_DEFCONFIG="imx8mp_evk"
BR2_TARGET_UBOOT_NEEDS_DTC=y
BR2_TARGET_UBOOT_FORMAT_CUSTOM=y
BR2_TARGET_UBOOT_FORMAT_CUSTOM_NAME="u-boot-nodtb.bin"
BR2_TARGET_UBOOT_SPL=y
BR2_PACKAGE_HOST_DOSFSTOOLS=y
BR2_PACKAGE_HOST_GENIMAGE=y
BR2_PACKAGE_HOST_IMX_MKIMAGE=y
BR2_PACKAGE_HOST_MTOOLS=y
BR2_PACKAGE_HOST_UBOOT_TOOLS=y
BR2_PACKAGE_HOST_UBOOT_TOOLS_FIT_SUPPORT=y

BR2_PACKAGE_HOST_LINUX_HEADERS_CUSTOM_5_4=y
BR2_TARGET_GENERIC_GETTY_PORT="ttymxc1"
BR2_ROOTFS_POST_IMAGE_SCRIPT="board/freescale/common/imx/imx8-bootloader-prepare.sh board/freescale/common/imx/post-image.sh"
BR2_ROOTFS_POST_SCRIPT_ARGS="${UBOOT_DIR}/arch/arm/dts/imx8mp-evk.dtb"

BR2_LINUX_KERNEL=y
BR2_LINUX_KERNEL_CUSTOM_GIT=y
BR2_LINUX_KERNEL_USE_ARCH_DEFAULT_CONFIG=y
BR2_LINUX_KERNEL_CUSTOM_REPO_VERSION="OpenIL-v1.9-linux-imx8-202009"
BR2_LINUX_KERNEL_CONFIG_FRAGMENT_FILES="$(LINUX_DIR)/arch/arm64/configs/imx_v8_defconfig board/freescale/imx8mpevk/linux.config"
BR2_LINUX_KERNEL_DTS_SUPPORT=y
BR2_LINUX_KERNEL_INTREE_DTS_NAME="freescale/imx8mp-evk"
#BR2_LINUX_KERNEL_IMAGE=y
#BR2_LINUX_KERNEL_IMAGE_TARGET_CUSTOM=y
#BR2_LINUX_KERNEL_IMAGE_TARGET_NAME="Image"
BR2_LINUX_KERNEL_NEEDS_HOST_OPENSSL=y

BR2_PACKAGE_FREESCALE_IMX=y
BR2_PACKAGE_FREESCALE_IMX_PLATFORM_IMX8MP=y
BR2_PACKAGE_FIRMWARE_IMX=y
BR2_PACKAGE_FREESCALE_IMX_HAS_VIV_GPU=y
BR2_PACKAGE_IMX_GPU_VIV=y
BR2_PACKAGE_IMX_GPU_VIV_OUTPUT_WL=y
BR2_PACKAGE_IMX_GPU_VIV_EXAMPLES=y
BR2_PACKAGE_IMX_GPU_VIV_GMEM_INFO=y
BR2_PACKAGE_WAYLAND=y
BR2_PACKAGE_LIBDRM_IMX=y
BR2_PACKAGE_WAYLAND_PROTOCOLS_IMX=y

#weston-imx with wayland
BR2_PACKAGE_WESTON_IMX=y
BR2_PACKAGE_WESTON_IMX_DEFAULT_DRM=y

BR2_PACKAGE_LINUX_PAM=y
BR2_PACKAGE_IMX_GPU_G2D=y
BR2_PACKAGE_PANGO=y
BR2_PACKAGE_XORG7=y
BR2_PACKAGE_KMSCUBE=y

# sysrepo-tsn
# BR2_PACKAGE_OPENSSH=y # Already set in basic packages
BR2_PACKAGE_LIBSSH=y
BR2_PACKAGE_LIBSSH_SERVER=y
BR2_PACKAGE_QORIQ_SYSREPO_TSN=y

# qoriq-ptp4l package
BR2_PACKAGE_QORIQ_PTP4L=y

BR2_PACKAGE_CJSON=y
BR2_PACKAGE_QORIQ_TSNTOOL=y

BR2_TARGET_ARM_TRUSTED_FIRMWARE=y
BR2_TARGET_ARM_TRUSTED_FIRMWARE_CUSTOM_GIT=y
BR2_TARGET_ARM_TRUSTED_FIRMWARE_CUSTOM_REPO_URL="https://source.codeaurora.org/external/imx/imx-atf"
BR2_TARGET_ARM_TRUSTED_FIRMWARE_CUSTOM_REPO_VERSION="rel_imx_5.4.24_2.1.0"
BR2_TARGET_ARM_TRUSTED_FIRMWARE_PLATFORM="imx8mp"
BR2_TARGET_ARM_TRUSTED_FIRMWARE_BL31=y

# basic packages and tools
BR2_PACKAGE_MTD=y
BR2_PACKAGE_MTD_MTD_DEBUG=y
BR2_PACKAGE_SYSSTAT=y
BR2_PACKAGE_E2FSPROGS=y
BR2_PACKAGE_RT_TESTS=y
BR2_PACKAGE_OPENSSH=y
BR2_PACKAGE_OPENSSL=y
BR2_PACKAGE_WGET=y

# ca-certs packages
BR2_PACKAGE_CA_CERTIFICATES=y

# dhcpd package
BR2_PACKAGE_DHCPCD=y

# resize2fs package
BR2_PACKAGE_E2FSPROGS_RESIZE2FS=y

# Text editors
BR2_PACKAGE_NANO=y

#iproute2
BR2_PACKAGE_IPROUTE2=y
BR2_PACKAGE_LIBMNL=y

#netperf
BR2_PACKAGE_NETPERF=y

BR2_PACKAGE_ETHTOOL=y
BR2_PACKAGE_COLLECTD_CURL=y
BR2_PACKAGE_COLLECTD_CURL_JSON=y
BR2_PACKAGE_COLLECTD_CURL_XML=y
BR2_PACKAGE_LIBCURL=y
BR2_PACKAGE_LIBCURL_CURL=y
BR2_PACKAGE_LIBCURL_VERBOSE=y
BR2_PACKAGE_FLICKCURL=y
BR2_PACKAGE_FLICKCURL_UTILS=y

# haveged
BR2_PACKAGE_HAVEGED=y

#avahi
BR2_PACKAGE_AVAHI=y
BR2_PACKAGE_AVAHI_AUTOIPD=y
BR2_PACKAGE_AVAHI_DAEMON=y
BR2_PACKAGE_AVAHI_LIBDNSSD_COMPATIBILITY=y
BR2_PACKAGE_NSS_MDNS=y

# i2c-tools
BR2_PACKAGE_I2C_TOOLS=y

BR2_ROOTFS_DEVICE_CREATION_DYNAMIC_EUDEV=y
BR2_PACKAGE_EUDEV=y

BR2_USE_MMU=y
BR2_USE_WCHAR=y
BR2_PACKAGE_VIM=y

BR2_INSTALL_LIBSTDCPP=y
BR2_PACKAGE_IPERF=y

BR2_TOOLCHAIN_HAS_THREADS=y
BR2_PACKAGE_IPERF3=y
BR2_PACKAGE_TCPDUMP=y

BR2_PACKAGE_BUSYBOX_SHOW_OTHERS=y
BR2_PACKAGE_BASH=y
BR2_SYSTEM_BIN_SH_BASH=y
BR2_SYSTEM_BIN_SH="bash"
```

## configs/imx8mpevk_ubuntu_defconfig
```kconfig
BR2_aarch64=y
BR2_cortex_a53=y
BR2_ARM_FPU_VFPV3=y

BR2_TARGET_ROOTFS_EXT2=y
BR2_TARGET_ROOTFS_EXT2_4=y

# custom skeleton
BR2_ROOTFS_SKELETON_UBUNTU=y
BR2_ROOTFS_SKELETON_CUSTOM=y
BR2_ROOTFS_SKELETON_CUSTOM_SITE="http://cdimage.ubuntu.com/ubuntu-base/releases/bionic/release"
BR2_ROOTFS_SKELETON_CUSTOM_SOURCE="ubuntu-base-18.04.4-base-arm64.tar.gz"
BR2_ROOTFS_SKELETON_CUSTOM_SITE_METHOD="wget"
BR2_ROOTFS_SKELETON_CUSTOM_EXTRACT="tar zxvf"
BR2_ROOTFS_SKELETON_CUSTOM_EXTRACT_IGNORE_ERROR=y
BR2_ROOTFS_POST_BUILD_SCRIPT="board/nxp/common/ls/post-custom-skeleton-ubuntu-base-18.04.sh"
BR2_INIT_NONE=y

BR2_ROOTFS_OVERLAY="board/nxp/common/ls/ubuntu_rootfs_resize_overlay"

# toolchain
BR2_TOOLCHAIN_EXTERNAL=y
BR2_TOOLCHAIN_EXTERNAL_ARM_AARCH64=y
BR2_TOOLCHAIN_USES_GLIBC=y
BR2_TOOLCHAIN_EXTERNAL_GLIBC=y

BR2_TARGET_UBOOT=y
BR2_TARGET_UBOOT_BUILD_SYSTEM_KCONFIG=y
BR2_TARGET_UBOOT_CUSTOM_GIT=y
BR2_TARGET_UBOOT_CUSTOM_REPO_URL="https://source.codeaurora.org/external/imx/uboot-imx"
BR2_TARGET_UBOOT_CUSTOM_REPO_VERSION="rel_imx_5.4.24_2.1.0"
BR2_TARGET_UBOOT_BOARD_DEFCONFIG="imx8mp_evk"
BR2_TARGET_UBOOT_NEEDS_DTC=y
BR2_TARGET_UBOOT_FORMAT_CUSTOM=y
BR2_TARGET_UBOOT_FORMAT_CUSTOM_NAME="u-boot-nodtb.bin"
BR2_TARGET_UBOOT_SPL=y
BR2_PACKAGE_HOST_DOSFSTOOLS=y
BR2_PACKAGE_HOST_GENIMAGE=y
BR2_PACKAGE_HOST_IMX_MKIMAGE=y
BR2_PACKAGE_HOST_MTOOLS=y
BR2_PACKAGE_HOST_UBOOT_TOOLS=y
BR2_PACKAGE_HOST_UBOOT_TOOLS_FIT_SUPPORT=y

BR2_PACKAGE_HOST_LINUX_HEADERS_CUSTOM_5_4=y
BR2_TARGET_GENERIC_GETTY_PORT="ttymxc1"
BR2_ROOTFS_POST_IMAGE_SCRIPT="board/freescale/common/imx/imx8-bootloader-prepare.sh board/freescale/common/imx/post-image.sh"
BR2_ROOTFS_POST_SCRIPT_ARGS="${UBOOT_DIR}/arch/arm/dts/imx8mp-evk.dtb"

BR2_LINUX_KERNEL=y
BR2_LINUX_KERNEL_CUSTOM_GIT=y
BR2_LINUX_KERNEL_USE_ARCH_DEFAULT_CONFIG=y
BR2_LINUX_KERNEL_CUSTOM_REPO_VERSION="OpenIL-v1.9-linux-imx8-202009"
BR2_LINUX_KERNEL_CONFIG_FRAGMENT_FILES="$(LINUX_DIR)/arch/arm64/configs/imx_v8_defconfig board/freescale/imx8mpevk/linux.config"
BR2_LINUX_KERNEL_DTS_SUPPORT=y
BR2_LINUX_KERNEL_INTREE_DTS_NAME="freescale/imx8mp-evk"
#BR2_LINUX_KERNEL_IMAGE=y
#BR2_LINUX_KERNEL_IMAGE_TARGET_CUSTOM=y
#BR2_LINUX_KERNEL_IMAGE_TARGET_NAME="Image"
BR2_LINUX_KERNEL_NEEDS_HOST_OPENSSL=y

BR2_PACKAGE_FREESCALE_IMX=y
BR2_PACKAGE_FREESCALE_IMX_PLATFORM_IMX8MP=y
BR2_PACKAGE_FIRMWARE_IMX=y
BR2_PACKAGE_FREESCALE_IMX_HAS_VIV_GPU=y
BR2_PACKAGE_IMX_GPU_VIV=y
BR2_PACKAGE_IMX_GPU_VIV_OUTPUT_WL=y
BR2_PACKAGE_IMX_GPU_VIV_EXAMPLES=y
BR2_PACKAGE_IMX_GPU_VIV_GMEM_INFO=y
BR2_PACKAGE_WAYLAND=y
BR2_PACKAGE_LIBDRM_IMX=y
BR2_PACKAGE_WAYLAND_PROTOCOLS_IMX=y

#weston-imx with wayland
BR2_PACKAGE_WESTON_IMX=y
BR2_PACKAGE_WESTON_IMX_DEFAULT_DRM=y

BR2_PACKAGE_LINUX_PAM=y
BR2_PACKAGE_IMX_GPU_G2D=y
BR2_PACKAGE_PANGO=y
BR2_PACKAGE_XORG7=y
BR2_PACKAGE_KMSCUBE=y

BR2_ROOTFS_DEVICE_CREATION_DYNAMIC_EUDEV=y
BR2_PACKAGE_EUDEV=y

# qoriq-ptp4l package
BR2_PACKAGE_QORIQ_PTP4L=y

BR2_PACKAGE_CJSON=y
BR2_PACKAGE_QORIQ_TSNTOOL=y

BR2_TARGET_ARM_TRUSTED_FIRMWARE=y
BR2_TARGET_ARM_TRUSTED_FIRMWARE_CUSTOM_GIT=y
BR2_TARGET_ARM_TRUSTED_FIRMWARE_CUSTOM_REPO_URL="https://source.codeaurora.org/external/imx/imx-atf"
BR2_TARGET_ARM_TRUSTED_FIRMWARE_CUSTOM_REPO_VERSION="rel_imx_5.4.24_2.1.0"
BR2_TARGET_ARM_TRUSTED_FIRMWARE_PLATFORM="imx8mp"
BR2_TARGET_ARM_TRUSTED_FIRMWARE_BL31=y

BR2_PACKAGE_IPROUTE2=y
BR2_PACKAGE_ETHTOOL=y

# busybox setting disable
BR2_PACKAGE_BUSYBOX=n
```

## configs/nxp_imx8mmevk_revb_defconfig
```kconfig
BR2_aarch64=y
BR2_ARM_FPU_VFPV3=y
BR2_PACKAGE_HOST_LINUX_HEADERS_CUSTOM_5_4=y
BR2_TARGET_GENERIC_GETTY_PORT="ttymxc1"
BR2_ROOTFS_POST_IMAGE_SCRIPT="board/freescale/common/imx/imx8-bootloader-prepare.sh board/freescale/common/imx/post-image.sh"
BR2_ROOTFS_POST_SCRIPT_ARGS="${UBOOT_DIR}/arch/arm/dts/fsl-imx8mm-evk.dtb"

# toolchain
BR2_TOOLCHAIN_BUILDROOT=y
BR2_TOOLCHAIN_BUILDROOT_GLIBC=y
BR2_BINUTILS_VERSION_2_33_X=y
BR2_GCC_VERSION_9_X=y
BR2_PACKAGE_GLIBC_UTILS=y
BR2_TOOLCHAIN_BUILDROOT_CXX=y

# Hostname and issue
BR2_TARGET_GENERIC_HOSTNAME="IMX8MMEVK"
BR2_TARGET_GENERIC_ISSUE="Welcome to OpenIL"
BR2_LINUX_KERNEL=y
BR2_LINUX_KERNEL_CUSTOM_GIT=y
BR2_LINUX_KERNEL_USE_ARCH_DEFAULT_CONFIG=y
BR2_LINUX_KERNEL_CONFIG_FRAGMENT_FILES="$(LINUX_DIR)/arch/arm64/configs/lsdk.config"
BR2_LINUX_KERNEL_DTS_SUPPORT=y
BR2_LINUX_KERNEL_INTREE_DTS_NAME="freescale/imx8mm-evk-revb"
BR2_LINUX_KERNEL_NEEDS_HOST_OPENSSL=y
BR2_PACKAGE_FREESCALE_IMX=y
BR2_PACKAGE_FREESCALE_IMX_PLATFORM_IMX8MM=y
BR2_PACKAGE_FIRMWARE_IMX=y
BR2_TARGET_ROOTFS_EXT2=y
BR2_TARGET_ROOTFS_EXT2_4=y
BR2_TARGET_ROOTFS_EXT2_SIZE="120M"
BR2_TARGET_ARM_TRUSTED_FIRMWARE=y
BR2_TARGET_ARM_TRUSTED_FIRMWARE_CUSTOM_GIT=y
BR2_TARGET_ARM_TRUSTED_FIRMWARE_CUSTOM_REPO_URL="https://source.codeaurora.org/external/imx/imx-atf"
BR2_TARGET_ARM_TRUSTED_FIRMWARE_CUSTOM_REPO_VERSION="rel_imx_4.19.35_1.1.0"
BR2_TARGET_ARM_TRUSTED_FIRMWARE_PLATFORM="imx8mm"
BR2_TARGET_ARM_TRUSTED_FIRMWARE_BL31=y
BR2_TARGET_UBOOT=y
BR2_TARGET_UBOOT_BUILD_SYSTEM_KCONFIG=y
BR2_TARGET_UBOOT_CUSTOM_GIT=y
BR2_TARGET_UBOOT_CUSTOM_REPO_URL="https://source.codeaurora.org/external/imx/uboot-imx"
BR2_TARGET_UBOOT_CUSTOM_REPO_VERSION="rel_imx_4.19.35_1.1.0"
BR2_TARGET_UBOOT_BOARD_DEFCONFIG="imx8mm_evk_revb"
BR2_TARGET_UBOOT_NEEDS_DTC=y
BR2_TARGET_UBOOT_FORMAT_CUSTOM=y
BR2_TARGET_UBOOT_FORMAT_CUSTOM_NAME="u-boot-nodtb.bin"
BR2_TARGET_UBOOT_SPL=y
BR2_TARGET_UBOOT_PATCH="board/freescale/imx8mmevk/patches/uboot"
BR2_PACKAGE_HOST_DOSFSTOOLS=y
BR2_PACKAGE_HOST_GENIMAGE=y
BR2_PACKAGE_HOST_IMX_MKIMAGE=y
BR2_PACKAGE_HOST_MTOOLS=y
BR2_PACKAGE_HOST_UBOOT_TOOLS=y
BR2_PACKAGE_HOST_UBOOT_TOOLS_FIT_SUPPORT=y
```
