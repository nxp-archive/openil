## configs/nxp_ls1028ardb_defconfig
```kconfig
# Architecture
BR2_aarch64=y
BR2_cortex_a72=y

# Init system
BR2_INIT_SYSTEMD=y
BR2_PACKAGE_SYSTEMD_BOOTCHART=y
BR2_PACKAGE_SYSTEMD_JOURNAL_GATEWAY=y
BR2_PACKAGE_SYSTEMD_JOURNAL_REMOTE=y
BR2_PACKAGE_SYSTEMD_COREDUMP=y
BR2_PACKAGE_SYSTEMD_FIRSTBOOT=y
BR2_PACKAGE_SYSTEMD_HIBERNATE=y
BR2_PACKAGE_SYSTEMD_LOCALED=y
BR2_PACKAGE_SYSTEMD_SYSUSERS=y

# Filesystem
BR2_TARGET_ROOTFS_EXT2=y
BR2_TARGET_ROOTFS_EXT2_4=y
BR2_TARGET_ROOTFS_EXT2_GZIP=y
BR2_TARGET_ROOTFS_EXT2_SIZE="1G"

# Hostname and issue
BR2_TARGET_GENERIC_HOSTNAME="OpenIL"
BR2_TARGET_GENERIC_ISSUE="Welcome to OpenIL"

# Linux headers same as kernel
BR2_PACKAGE_HOST_LINUX_HEADERS_CUSTOM_4_14=y

BR2_GLOBAL_PATCH_DIR="board/nxp/common/patches/"

# toolchain
BR2_TOOLCHAIN_EXTERNAL=y

# bootloader
BR2_TARGET_UBOOT=y
BR2_TARGET_UBOOT_BOARDNAME="ls1028ardb_sdcard"
BR2_TARGET_UBOOT_CUSTOM_GIT=y
BR2_TARGET_UBOOT_CUSTOM_REPO_URL="https://github.com/openil/u-boot.git"
BR2_TARGET_UBOOT_CUSTOM_REPO_VERSION="OpenIL-u-boot-201908"
BR2_TARGET_UBOOT_NEEDS_DTC=y
BR2_TARGET_UBOOT_FORMAT_BIN=n
BR2_TARGET_UBOOT_FORMAT_CUSTOM=y
BR2_TARGET_UBOOT_FORMAT_CUSTOM_NAME="u-boot-with-spl.bin"
BR2_PACKAGE_UBOOT_TOOLS_MKIMAGE=y
BR2_TARGET_UBOOT_ENVIMAGE=y
BR2_TARGET_UBOOT_ENVIMAGE_SOURCE="board/nxp/ls1028ardb/u-boot-environment-64b.txt"
BR2_TARGET_UBOOT_ENVIMAGE_SIZE="0x2000"

# Kernel
BR2_LINUX_KERNEL=y
BR2_LINUX_KERNEL_CUSTOM_GIT=y
BR2_LINUX_KERNEL_CUSTOM_REPO_URL="https://source.codeaurora.org/external/qoriq/qoriq-components/linux"
BR2_LINUX_KERNEL_CUSTOM_REPO_VERSION="LSDK-19.09-update-291119-V4.19"
BR2_LINUX_KERNEL_USE_ARCH_DEFAULT_CONFIG=y
BR2_LINUX_KERNEL_CONFIG_FRAGMENT_FILES="$(LINUX_DIR)/arch/arm64/configs/lsdk.config board/nxp/common/linux-4_9-docker.config board/nxp/ls1028ardb/linux.config"
BR2_LINUX_KERNEL_DTS_SUPPORT=y
BR2_LINUX_KERNEL_INTREE_DTS_NAME="freescale/fsl-ls1028a-rdb"
BR2_LINUX_KERNEL_IMAGE_TARGET_CUSTOM=y
BR2_LINUX_KERNEL_IMAGE_TARGET_NAME="Image"
# Serial port config
BR2_TARGET_GENERIC_GETTY=n

BR2_PACKAGE_UTIL_LINUX_SCHEDUTILS=y
BR2_PACKAGE_LINUX_TOOLS_PERF=y
BR2_PACKAGE_TRACE_CMD=y
BR2_PACKAGE_AUDIT=y
BR2_PACKAGE_STRACE=y

# required tools to create the microSD image
BR2_PACKAGE_HOST_DOSFSTOOLS=y
BR2_PACKAGE_HOST_GENIMAGE=y
BR2_PACKAGE_HOST_MTOOLS=y
BR2_ROOTFS_POST_IMAGE_SCRIPT="board/nxp/ls1028ardb/post-image-64b.sh"
BR2_ROOTFS_POST_SCRIPT_ARGS="$(LINUX_DIR) $(TOPDIR) $(UBOOT_DIR) $(BR2_PACKAGE_OPENIL_RCW_BIN)"

# Shell tools
BR2_GENERATE_LOCALE="en_US.UTF-8"
BR2_PACKAGE_BUSYBOX_CONFIG_FRAGMENT_FILES="board/nxp/common/openil-busybox.config"
BR2_PACKAGE_BUSYBOX_SHOW_OTHERS=y
BR2_PACKAGE_BASH_COMPLETION=y
BR2_PACKAGE_BASH=y
BR2_SYSTEM_BIN_SH_BASH=y
BR2_SYSTEM_BIN_SH="bash"
BR2_PACKAGE_TMUX=y
BR2_PACKAGE_MTD=y
BR2_PACKAGE_MTD_MTD_DEBUG=y
BR2_PACKAGE_SYSSTAT=y
BR2_PACKAGE_E2FSPROGS=y
BR2_PACKAGE_RT_TESTS=y
BR2_PACKAGE_OPENSSL=y
BR2_PACKAGE_BINUTILS=y
BR2_PACKAGE_FINDUTILS=y
BR2_PACKAGE_GAWK=y
BR2_PACKAGE_FILE=y
BR2_PACKAGE_WHICH=y
BR2_PACKAGE_COREUTILS=y
BR2_PACKAGE_HTOP=y
BR2_PACKAGE_SUDO=y
BR2_PACKAGE_LESS=y
BR2_PACKAGE_NANO=y
BR2_PACKAGE_VIM=y

# Add ota overlay
BR2_ROOTFS_OVERLAY="board/nxp/common/ota_overlay board/nxp/common/systemd_init_overlay board/nxp/ls1028ardb/rootfs_overlay"

# packages for rcw
BR2_PACKAGE_OPENIL_RCW=y
BR2_PACKAGE_OPENIL_RCW_BIN="ls1028ardb/R_SQPP_85bb/rcw_1300_sd.bin"

# ppa firmware
BR2_PACKAGE_PPA=y

#Display port firmware
BR2_PACKAGE_DP=y
BR2_PACKAGE_DP_BIN="mhdp_fw_1_0_51-dptx-hdcp-mcu2.bin"

# packages for xenomai
BR2_PACKAGE_XENOMAI=y
BR2_PACKAGE_XENOMAI_ARCH_SUPPORTS=y
BR2_PACKAGE_XENOMAI_RTCAN=y
BR2_PACKAGE_XENOMAI_ANALOGY=y
BR2_PACKAGE_XENOMAI_NATIVE_SKIN=y
BR2_PACKAGE_XENOMAI_POSIX_SKIN=y
BR2_PACKAGE_XENOMAI_TESTSUITE=y

# docker packages
BR2_PACKAGE_DOCKER_CONTAINERD=y
BR2_PACKAGE_DOCKER_ENGINE=y
BR2_PACKAGE_DOCKER_ENGINE_DAEMON=y
BR2_PACKAGE_DOCKER_ENGINE_EXPERIMENTAL=y
BR2_PACKAGE_DOCKER_ENGINE_DRIVER_BTRFS=y
BR2_PACKAGE_DOCKER_ENGINE_DRIVER_DEVICEMAPPER=y
BR2_PACKAGE_DOCKER_ENGINE_DRIVER_VFS=y
BR2_PACKAGE_UTIL_LINUX_LIBMOUNT=y
BR2_PACKAGE_CGROUPFS_MOUNT=y

# Virtualization
BR2_PACKAGE_QEMU=y
BR2_PACKAGE_QEMU_TOOLS=y
BR2_PACKAGE_QEMU_SYSTEM=y

# ca-certs packages
BR2_PACKAGE_CA_CERTIFICATES=y

# resize2fs package
BR2_PACKAGE_E2FSPROGS_RESIZE2FS=y

# Networking
BR2_PACKAGE_TSNTOOL=y
BR2_PACKAGE_IPUTILS=y
BR2_PACKAGE_NETPERF=y
BR2_PACKAGE_TCPDUMP=y
BR2_PACKAGE_ETHTOOL=y
BR2_PACKAGE_LLDPD=y
BR2_PACKAGE_IPERF=y
BR2_PACKAGE_IPERF3=y
BR2_PACKAGE_IPROUTE2_NEXT=y
BR2_PACKAGE_IPTABLES=y
BR2_PACKAGE_IPTABLES_NFTABLES=y
BR2_PACKAGE_XTABLES_ADDONS=y
BR2_PACKAGE_NFTABLES=y
BR2_PACKAGE_EBTABLES=y
BR2_PACKAGE_OPENSSH=y
BR2_PACKAGE_RSYNC=y
BR2_PACKAGE_LINUXPTP=y
BR2_PACKAGE_CHRONY=y
BR2_PACKAGE_NTP=y
BR2_PACKAGE_NTP_NTPD_ATOM_PPS=y
BR2_PACKAGE_NTP_NTPDATE=y
BR2_PACKAGE_NTP_NTPQ=y
BR2_PACKAGE_NTP_NTPTIME=y
BR2_PACKAGE_NTP_NTPTRACE=y
BR2_PACKAGE_AVAHI=y
BR2_PACKAGE_AVAHI_AUTOIPD=y
BR2_PACKAGE_AVAHI_DAEMON=y
BR2_PACKAGE_AVAHI_LIBDNSSD_COMPATIBILITY=y
BR2_PACKAGE_NSS_MDNS=y
BR2_PACKAGE_WGET=y
BR2_PACKAGE_GPSD=y
BR2_PACKAGE_GPSD_PPS=y
BR2_PACKAGE_GPSD_UBX=y
BR2_PACKAGE_GPSD_DEVICES="/dev/ttyAMA0"

#
# Edge-scale service
#
BR2_PACKAGE_QORIQ_EDGESCALE_EDS=y
BR2_PACKAGE_QORIQ_EDS_KUBELET=y
BR2_PACKAGE_QORIQ_EDS_BOOTSTRAP=y

BR2_PACKAGE_COLLECTD_CURL=y
BR2_PACKAGE_COLLECTD_CURL_JSON=y
BR2_PACKAGE_COLLECTD_CURL_XML=y
BR2_PACKAGE_CURL=y
BR2_PACKAGE_FLICKCURL=y
BR2_PACKAGE_FLICKCURL_UTILS=y

# i2c-tools
BR2_PACKAGE_I2C_TOOLS=y

# haveged
BR2_PACKAGE_HAVEGED=y

# Language runtimes
BR2_PACKAGE_PYTHON3=y
```

## configs/nxp_ls1043ardb-32b_defconfig
```kconfig
# Architecture
BR2_aarch64=y

# toolchain
BR2_TOOLCHAIN_EXTERNAL=y

# bootloader
BR2_TARGET_UBOOT=y
BR2_TARGET_UBOOT_BOARDNAME="ls1043ardb_tfa"
BR2_TARGET_UBOOT_CUSTOM_GIT=y
BR2_TARGET_UBOOT_CUSTOM_REPO_URL="https://github.com/openil/u-boot.git"
BR2_TARGET_UBOOT_CUSTOM_REPO_VERSION="OpenIL-v1.7-u-boot-202001"
BR2_TARGET_UBOOT_NEEDS_DTC=y
BR2_TARGET_UBOOT_FORMAT_BIN=n
BR2_TARGET_UBOOT_FORMAT_CUSTOM=y
BR2_TARGET_UBOOT_FORMAT_CUSTOM_NAME="u-boot-dtb.bin"
BR2_PACKAGE_UBOOT_TOOLS_MKIMAGE=y
BR2_TARGET_UBOOT_ENVIMAGE=y
BR2_TARGET_UBOOT_ENVIMAGE_SOURCE="board/nxp/ls1043ardb/u-boot-environment.txt"
BR2_TARGET_UBOOT_ENVIMAGE_SIZE="0x2000"

# Kernel
BR2_LINUX_KERNEL=y
BR2_LINUX_KERNEL_CUSTOM_GIT=y
BR2_LINUX_KERNEL_CUSTOM_REPO_URL="https://github.com/openil/linux.git"
BR2_LINUX_KERNEL_CUSTOM_REPO_VERSION="OpenIL-v1.7-linux-202001"
BR2_LINUX_KERNEL_USE_ARCH_DEFAULT_CONFIG=y
BR2_LINUX_KERNEL_CONFIG_FRAGMENT_FILES="$(LINUX_DIR)/arch/arm64/configs/lsdk.config"
BR2_LINUX_KERNEL_DTS_SUPPORT=y
BR2_LINUX_KERNEL_INTREE_DTS_NAME="freescale/fsl-ls1043a-rdb-sdk"
# Linux headers same as kernel
BR2_PACKAGE_HOST_LINUX_HEADERS_CUSTOM_4_14=y

# RCW
BR2_PACKAGE_RCW=y
BR2_PACKAGE_RCW_BIN="ls1043ardb/RR_FQPP_1455/rcw_1600_sdboot.bin"

BR2_INIT_NONE=n
BR2_PACKAGE_BUSYBOX=n
BR2_TARGET_ROOTFS_TAR=n

BR2_ROOTFS_POST_IMAGE_SCRIPT="board/nxp/ls1043ardb/ls1043ardb-32b.sh"
BR2_ROOTFS_POST_SCRIPT_ARGS="$(UBOOT_DIR) $(TOPDIR)"

# Text editors
BR2_PACKAGE_NANO=y

# TFA support
BR2_PACKAGE_TFA=y
```
