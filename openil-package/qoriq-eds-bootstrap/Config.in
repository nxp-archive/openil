## openil-package/qoriq-eds-bootstrap/Config.in
```kconfig
config BR2_PACKAGE_QORIQ_EDS_BOOTSTRAP
	bool "qorio eds bootstrap"
	help
	  The qoriq eds bootstrap.

	  https://bitbucket.sw.nxp.com/projects/DCCA/repos/qoriq-eds-bootstrap/browse
```

## openil-package/qoriq-eds-kubelet/Config.in
```kconfig
config BR2_PACKAGE_QORIQ_EDS_KUBELET
	bool "qorio eds kubelet"
	help
	  The edgescale kubelet. 

	  https://bitbucket.sw.nxp.com/projects/DCCA/repos/qoriq-eds-kubelet/browse
```

## openil-package/ua-nodeset/Config.in
```kconfig
config BR2_PACKAGE_UA_NODESET
	bool "ua-nodeset"
	help
	  OPC UA NodeSets and Other Supporting Files

	  This repository contains UANodeSets and other normative files which
	  are released with a specification. Any change to a specification
	  (release of a new version or errata) may require a change to the
	  files in this repository.

	  https://github.com/OPCFoundation/UA-Nodeset
```

## package/cst/Config.in.host
```kconfig
config BR2_PACKAGE_HOST_CST
	bool "host cst tool"
	help
	  CST tool providing the following tools:

	  1. Key Generation
		- gen_keys
		- gen_drv_drbg
		- gen_otpmk_drbg
	  2. Header Creation
		- create_hdr_pbi
		- create_hdr_isbc
		- create_hdr_esbc
		- create_hdr_cf
	  3. Signature Geneartion
		- gen_sign
		- sign_embed

	  Wrapper scripts for invoking the Header creation tools have also been provided:
	  1. uni_pbi (create_hdr_pbi)
	  2. uni_sign (create_hdr_isbc and create_hdr_esbc)
	  3. uni_cfsign (creat_hdr_cf)
```

## package/ddr-phy/Config.in
```kconfig
config BR2_PACKAGE_DDR_PHY
        bool "prebuild DDR PHY binaries"
        help
	  DDR PHY firmware for qoriq platforms
```

## package/eth-phy/Config.in
```kconfig
config BR2_PACKAGE_ETH_PHY
        bool "prebuild ETH PHY binaries"
        help
	  The Prebuid ETH PHY binary
```

## package/fmlib/Config.in
```kconfig
comment "fmlib needs a Linux kernel to be built"
	depends on BR2_powerpc_e500mc || BR2_powerpc_e6500 || BR2_cortex_a7 || BR2_aarch64
	depends on !BR2_LINUX_KERNEL

config BR2_PACKAGE_FMLIB
	bool "fmlib"
	depends on BR2_powerpc_e500mc || BR2_powerpc_e6500 || BR2_cortex_a7 || BR2_aarch64
	depends on BR2_LINUX_KERNEL
	help
	  The Frame Manager library provides Freescale PowerPC platforms an
	  API on top of the Frame Manager driver ioctl calls, that provides
	  a user space application with a simple way to configure driver
	  parameters and PCD (parse - classify - distribute) rules.
```

## package/fmucode/Config.in
```kconfig
config BR2_PACKAGE_FMUCODE
	bool "fmucode"
	help
	These are the microcode families of the Frame Manager
	hardware block in QorIQ products. Specific platforms
	require specific binaries, and those also have to
	further match specific software versions.

	IPACC IRAM Package Alpha Release 106_x_18 
	DSAR IRAM Package Alpha Release 107_x_2
	IPACC + Next Generation CAPWAP  108_x_5

if BR2_PACKAGE_FMUCODE

config BR2_PACKAGE_FMUCODE_BIN
	string "Custom Fmucode binary file"
	help
	  The fmucode tarball just includes the binaries of
	  each platform. So the fmucode binary with specific
	  version must be specified.
endif
```

## package/freescale-imx/gstreamer-imx/Config.in
```kconfig
# Gstreamer 1.x & Plugins
source "package/freescale-imx/gstreamer-imx/gstreamer-imx/Config.in"

if BR2_PACKAGE_GSTREAMER_IMX
source "package/freescale-imx/gstreamer-imx/gst-plugin-imx/Config.in"
source "package/freescale-imx/gstreamer-imx/gst-plugins-base-imx/Config.in"
source "package/freescale-imx/gstreamer-imx/gst-plugins-good-imx/Config.in"
source "package/freescale-imx/gstreamer-imx/gst-plugins-bad-imx/Config.in"
endif
```

## package/freescale-imx/gstreamer-imx/gst-plugin-imx/Config.in
```kconfig
comment "gst-plugin-imx needs a toolchain w/ dynamic library"
	depends on BR2_arm || BR2_aarch64
	depends on BR2_STATIC_LIBS

menuconfig BR2_PACKAGE_GST_PLUGIN_IMX
	bool "gst-plugin-imx"
	depends on BR2_arm || BR2_aarch64 # Only relevant for i.MX
	depends on !BR2_STATIC_LIBS
	select BR2_PACKAGE_GST_PLUGINS_BASE_IMX
	select BR2_PACKAGE_GST_PLUGINS_BAD_IMX
	select BR2_PACKAGE_GST_PLUGINS_BOOD_IMX
	select BR2_PACKAGE_IMX_CODEC
	select BR2_PACKAGE_IMX_PARSER
	help
	  This is a set of GStreamer 1.0 plugins for plugins for
	  Freescale's i.MX platforms, which make use of the i.MX
	  multimedia capabilities.

	  https://github.com/Freescale/gstreamer-imx
```

## package/freescale-imx/libdrm-imx/Config.in
```kconfig
config BR2_PACKAGE_LIBDRM_IMX
	bool "libdrm-imx"
	help
	  Userspace interface to the kernel DRM services.
	  The runtime library for accessing the kernel DRM services.
	  DRM stands for "Direct Rendering Manager", which is the kernel
	  portion of the Direct Rendering Infrastructure" (DRI).
	  DRI is required for many hardware accelerated OpenGL drivers.
```

## package/freescale-imx/wayland-protocols-imx/Config.in
```kconfig
config BR2_PACKAGE_WAYLAND_PROTOCOLS_IMX
	bool "wayland-protocols-imx"
	# Not really... but useless otherwise
	depends on BR2_PACKAGE_WAYLAND
	help
	  Wayland protocols that adds functionality not available in
	  the Wayland core protocol.
```

## package/h-libxml2/Config.in.host
```kconfig
config BR2_PACKAGE_H_LIBXML2
	bool "h-libxml2"
	help
	  XML C Parser

	  http://xmlsoft.org/
```

## package/icc/Config.in
```kconfig
config BR2_PACKAGE_ICC
bool "Inter-core communication with baremetal"
help
	The ICC is a verification application for
	Inter-core communication between Linux and
	baremetal on different cores.
```

## package/kmscube/Config.in
```kconfig
config BR2_PACKAGE_KMSCUBE
	bool "kmscube"
	# requires libgbm from mesa3d or IMX_GPU_VIV
	depends on BR2_PACKAGE_MESA3D_OPENGL_EGL && BR2_PACKAGE_MESA3D_OPENGL_ES || BR2_PACKAGE_IMX_GPU_VIV

	help
	  kmscube is an application to test kms/drm drivers.

	  https://cgit.freedesktop.org/mesa/kmscube/
```

## package/libbee/Config.in
```kconfig
config BR2_PACKAGE_LIBBEE
	bool "libbee"
	default n
	help
	  MikroBUS: bee click board(MRF24J40MA)
```

## package/libblep/Config.in
```kconfig
config BR2_PACKAGE_LIBBLEP
	bool "libblep"
	default n
	help
	  MikroBUS: blep click board(nRF8001)
```

## package/libest/Config.in
```kconfig
config BR2_PACKAGE_LIBEST
	bool "libest"
	depends on BR2_PACKAGE_OPENSSL
	depends on BR2_PACKAGE_OPENSSL_BIN

	help
	  libest is a library that implements RFC 7030 (Enrollment over Secure Transport).
	  EST is used to provision certificates from a CA or RA. EST is a replacement for
	  SCEP, providing several security enhancements and support for ECC certificates.
	  Libest is written in C and uses OpenSSL 1.0.1. The following flows defined in RFC
	  7030 for both server and client operation have been implemented:

	  /getcacerts /csrattrs /simpleenroll /simplereenroll

	  Also of interest, a EST test server running this library has been setup at
	  http://testrfc7030.cisco.com/ and can be used for interop testing the EST protocol.
```

## package/libnetconf/Config.in
```kconfig
config BR2_PACKAGE_LIBNETCONF
bool "libnetconf"
	select BR2_PACKAGE_HOST_PYTHON_LIBXML2
help
	this is comment that support libnetconf

	  https://github.com/CESNET
```

## package/libnfc-nci/Config.in
```kconfig
config BR2_PACKAGE_LIBNFC_NCI
	bool "libnfc-nci"
	default n
	help
	  Linux NFC stack for NCI based NXP NFC Controllers.

	  https://www.nxp.com/products/identification-and-security/nfc/nfc-reader-ics:NFC-READER
```

## package/libopen62541/Config.in
```kconfig
config BR2_PACKAGE_LIBOPEN62541
	bool "libopen62541"
	help
	  open62541 is an open source and free implementation of OPC UA (OPC
	  Unified Architecture) written in the common subset of the C99 and
	  C++98 languages.open62541 implements the OPC UA binary protocol
	  stack as well as a client and server SDK.

	  http://open62541.org

if BR2_PACKAGE_LIBOPEN62541

menu "Main Build Options"
choice
	bool "cmake build type"
	default BR2_PACKAGE_LIBOPEN62541_CMAKE_BUILD_TYPE_DEBUG
	help

config BR2_PACKAGE_LIBOPEN62541_CMAKE_BUILD_TYPE_RELWITHDEBINFO
	bool "RelWithDebInfo"
	help
	  -O2 optimization with debug symbols

config BR2_PACKAGE_LIBOPEN62541_CMAKE_BUILD_TYPE_RELEASE
	bool "Release"
	help
	  -O2 optimization without debug symbols

config BR2_PACKAGE_LIBOPEN62541_CMAKE_BUILD_TYPE_DEBUG
	bool "Debug"
	help
	  -O0 optimization with debug symbols

config BR2_PACKAGE_LIBOPEN62541_CMAKE_BUILD_TYPE_MINSIZEREL
	bool "MinSizeRel"
	help
	  -Os optimization without debug symbols
endchoice

choice
	bool "loglevel"
	default BR2_PACKAGE_LIBOPEN62541_LOG_INFO
	help
	  The SDK logs events of the level
config BR2_PACKAGE_LIBOPEN62541_LOG_FATAL
	bool "Fatal"

config BR2_PACKAGE_LIBOPEN62541_LOG_ERROR
	bool "Error"

config BR2_PACKAGE_LIBOPEN62541_LOG_WARNING
	bool "Warning"

config BR2_PACKAGE_LIBOPEN62541_LOG_INFO
	bool "Info"

config BR2_PACKAGE_LIBOPEN62541_LOG_DEBUG
	bool "Debug"

config BR2_PACKAGE_LIBOPEN62541_LOG_TRACE
	bool "Trace"
endchoice

config BR2_PACKAGE_LIBOPEN62541_MULTITHREADING
	string "Level of multi-threading support"
	default "0"
	help
	  0-199: Multithreading support disabled.
	  100-199: API functions marked with the UA_THREADSAFE-macro
	    are protected internally with mutexes. Multiple threads
		are allowed to call these functions of the SDK at the same
		time without causing race conditions. Furthermore, this
		level support the handling of asynchronous method calls
		from external worker threads.
	  >=200: Work is distributed to a number of internal worker
	    threads. Those worker threads are created within the SDK.
endmenu

menu "Select build artefacts"

config BR2_PACKAGE_LIBOPEN62541_BUILD_EXAMPLES
	bool "Build example servers and clients"
	depends on ! BR2_PACKAGE_ENABLE_AMALGAMATION
	help
	  Compile example servers and clients from examples/*.c

config BR2_PACKAGE_LIBOPEN62541_BUILD_UNIT_TESTS
	bool "Build unit tests"
	help
	  Compile unit tests. The tests can be executed with make test

config BR2_PACKAGE_LIBOPEN62541_BUILD_SELFSIGNED_CERTIFICATE
	bool "Generate a self-signed certificate"
	depends on BR2_PACKAGE_OPENSSL
	help
	  Generate a self-signed certificate for the server
endmenu

config BR2_PACKAGE_LIBOPEN62541_ENABLE_SUBSCRIPTIONS
	bool "Enable subscriptions"
	default y
	help
	  Enable subscriptions

config BR2_PACKAGE_LIBOPEN62541_ENABLE_SUBSCRIPTIONS_EVENTS
	bool "Enable event subscription(experimental)"
	help
	  Enable the use of events for subscriptions.

config BR2_PACKAGE_LIBOPEN62541_ENABLE_ALARMS_CONDITION
	bool "Enable alarms conditions subscription(experimental)"
	depends on BR2_PACKAGE_LIBOPEN62541_NAMESPACE_ZERO_FULL \
		&& BR2_PACKAGE_LIBOPEN62541_ENABLE_SUBSCRIPTIONS_EVENTS
	help
	  Enable the use of A&C for subscriptions.

config BR2_PACKAGE_LIBOPEN62541_ENABLE_METHODCALLS
	bool "Enable Method service"
	default y
	help
	  Enable the Method service set

config BR2_PACKAGE_LIBOPEN62541_ENABLE_PARSING
	bool "Enable parsing"
	default y
	help
	  Enable parsing human readable formats of builtin data types (Guid, NodeId,
	  etc.). Utility functions that are not essential to the SDK.

config BR2_PACKAGE_LIBOPEN62541_ENABLE_NODEMANAGEMENT
	bool "Enable nodemanagement"
	default y
	help
	  Enable dynamic addition and removal of nodes at runtime

comment "Examples cannot be built with source amalgamation enabled"

config BR2_PACKAGE_LIBOPEN62541_ENABLE_AMALGAMATION
	bool "Enable amalgamation"
	help
	  Compile a single-file release into the files open62541.c and open62541.h.
	  Not recommended for installation.

config BR2_PACKAGE_LIBOPEN62541_ENABLE_IMMUTABLE_NODES
	bool "Enable immutable nodes"
	help
	  Nodes in the information model are not edited but copied and replaced.
	  The replacement is done with atomic operations so that the information
	  model is always consistent and can be accessed from an interrupt or parallel
	  thread (depends on the node storage plugin implementation).

config BR2_PACKAGE_LIBOPEN62541_ENABLE_COVERAGE
	bool "Enable coverage"
	help
	  Measure the coverage of unit tests

config BR2_PACKAGE_LIBOPEN62541_ENABLE_DISCOVERY
	bool "Enable Discovery Service (LDS)"
	default y
	help
	  Enable Discovery Service (LDS)

config BR2_PACKAGE_LIBOPEN62541_ENABLE_DISCOVERY_MULTICAST
	bool "Enable Discovery Service with multicast support (LDS-ME)"
	depends on BR2_PACKAGE_LIBOPEN62541_ENABLE_DISCOVERY
	help
	  Enable Discovery Service with multicast support (LDS-ME)

config BR2_PACKAGE_LIBOPEN62541_ENABLE_DISCOVERY_SEMAPHORE
	bool "Enable Discovery Semaphore support"
	default y
	help
	  Enable Discovery Semaphore support
choice
	bool "Set namespace zero"
	default BR2_PACKAGE_LIBOPEN62541_NAMESPACE_ZERO_REDUCED

config BR2_PACKAGE_LIBOPEN62541_NAMESPACE_ZERO_MINIMAL
	bool "MINIMAL"
	help
	  A barebones namespace zero that is compatible with most clients.
	  But this namespace 0 is so small that it does not pass the CTT
	  (Conformance Testing Tools of the OPC Foundation).

config BR2_PACKAGE_LIBOPEN62541_NAMESPACE_ZERO_REDUCED
	bool "REDUCED"
	help
	  Small namespace zero that passes the CTT.

config BR2_PACKAGE_LIBOPEN62541_NAMESPACE_ZERO_FULL
	bool "FULL"
	help
	  Full namespace zero generated from the official XML definitions.

endchoice

config BR2_PACKAGE_LIBOPEN62541_UA_FILE_NS0
	string "Override the official XML file"
	depends on BR2_PACKAGE_LIBOPEN62541_NAMESPACE_ZERO_FULL
	help
	   Be used to override the XML file used for namespace zero generation.

config BR2_PACKAGE_LIBOPEN62541_ENABLE_TYPEDESCRIPTION
	bool "Enable typedescription"
	default y
	help
	  Add the type and member names to the UA_DataType structure.

config BR2_PACKAGE_LIBOPEN62541_ENABLE_STATUSCODE_DESCRIPTIONS
	bool "Enable statuscode descriptions"
	default y
	help
	  Compile the human-readable name of the StatusCodes into the binary.
config BR2_PACKAGE_LIBOPEN62541_BUILD_SHARED_LIBS
	bool "Build shared libs"
	help
	  Build libopen62541 as shared libs

menu "Debug"
config BR2_PACKAGE_LIBOPEN62541_UA_DEBUG
	bool "Enable debug"
	help
	  Enable assertions and additional definitions not intended for production builds

config BR2_PACKAGE_LIBOPEN62541_UA_DEBUG_DUMP_PKGS
	bool "Dump pkgs"
	help
	  Dump every package received by the server as hexdump format
endmenu
endif
```

## package/mc-fw/Config.in
```kconfig
config BR2_PACKAGE_MC_FW
        bool "prebuild MC firmware binaries"
        help
	  The Prebuidl MC binaries for Management Complex (MC) of DPAA2 (Data Path
	  Acceleration Architecture, second version).
```

## package/mc-utils/Config.in
```kconfig
config BR2_PACKAGE_MC_UTILS
        bool "MC utils"
        help
	  The Management Complex (MC) is a key component of DPAA2 (Data Path
	  Acceleration Architecture, second version).
	  MC runs an NXP-supplied firmware image that abstracts and simplifies the
	  allocation and configuration of the other hardware elements using DPAA2
	  “objects”.
```

## package/netopeer-client/Config.in
```kconfig
config BR2_PACKAGE_NETOPEER_CLIENT
bool "netopeer-client"
	select BR2_PACKAGE_NETOPEER
help
	netopeer client for NETCONF test
```

## package/netopeer/Config.in
```kconfig
config BR2_PACKAGE_NETOPEER
	bool "netopeer-server"
	select BR2_PACKAGE_PYANG
	select BR2_PACKAGE_LIBNETCONF
	select BR2_PACKAGE_PYTHON_CURSES
	select BR2_PACKAGE_PYTHON_PYEXPAT
	select BR2_PACKAGE_PYTHON_LIBXML2
	select BR2_PACKAGE_OPENSSH
	help
	  Netopeer is a set of NETCONF tools built on the libnetconf library.
	  It allows operators to connect to their NETCONF-enabled devices as
	  well as developers to allow control their devices via NETCONF. More
	  information about NETCONF protocol can be found at NETCONF WG.

	  With the experiences from Netopeer, we have moved our activities to
	  work on next generation of this NETCONF toolset based on libyang
	  library. Netopeer2 is mature enough to be used as a replacement of
	  the original Netopeer tools. Therefore, the Netopeer is no more
	  developed neither maintained.

	  https://github.com/CESNET/netopeer
```
