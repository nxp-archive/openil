## package/nxp/qoriq-nodejs-lbt/Config.in
```kconfig
config BR2_PACKAGE_QORIQ_NODEJS_LBT
	bool "qoriq-nodejs-lbt"
	depends on BR2_PACKAGE_NODEJS
	select BR2_PACKAGE_QORIQ_PERL_FEEDGNUPLOT
	select BR2_PACKAGE_QORIQ_PRL
	help
	  Latency and Bandwidth Tester is a web application for generating and
	  plotting iPerf and ping traffic, used for the NXP LS1021A-TSN demos.
```

## package/nxp/qoriq-perl-exporter-tiny/Config.in
```kconfig
config BR2_PACKAGE_QORIQ_PERL_EXPORTER_TINY
	bool "qoriq-perl-exporter-tiny"
	select BR2_PACKAGE_PERL
	help
	  Exporter::Tiny - an exporter with the features of Sub::Exporter
	  but only core dependencies

	  https://metacpan.org/release/Exporter-Tiny

if BR2_PACKAGE_QORIQ_PERL_EXPORTER_TINY

config BR2_PACKAGE_QORIQ_PERL_EXPORTER_TINY_VERSION
	string "qoriq-perl-exporter-tiny version"
	default "1.000000"

endif
```

## package/nxp/qoriq-perl-feedgnuplot/Config.in
```kconfig
config BR2_PACKAGE_QORIQ_PERL_FEEDGNUPLOT
	bool "qoriq-perl-feedgnuplot"
	depends on !BR2_STATIC_LIBS
	select BR2_PACKAGE_GNUPLOT
	select BR2_PACKAGE_QORIQ_PERL_LIST_MOREUTILS
	select BR2_PACKAGE_QORIQ_PERL_EXPORTER_TINY
	help
	  General purpose pipe-oriented plotting tool

	  https://github.com/dkogan/feedgnuplot

comment "qoriq-perl-feedgnuplot needs a toolchain w/ dynamic library"
	depends on BR2_STATIC_LIBS
```

## package/nxp/qoriq-ppfe/Config.in
```kconfig
config BR2_PACKAGE_QORIQ_PPFE
	bool "qoriq-ppfe"
	help
	ls1012a/slow_path : This folder contains pfe firmware
	binaries which supports slow path only.

if BR2_PACKAGE_QORIQ_PPFE

config BR2_PACKAGE_QORIQ_PPFE_VERSION
	string "ppfe version"

endif
```

## package/nxp/qoriq-ptp4l/Config.in
```kconfig
config BR2_PACKAGE_QORIQ_PTP4L
	bool "qoriq-ptp4l"
	help
	  This software is an implementation of the Precision Time
	  Protocol (PTP) according to IEEE standard 1588 for Linux.
	  The dual design goals are to provide a robust implementation
	  of the standard and to use the most relevant and modern
	  Application Programming Interfaces (API) offered by the
	  Linux kernel. Supporting legacy APIs and other platforms
	  is not a goal.

if BR2_PACKAGE_QORIQ_PTP4L

config BR2_PACKAGE_QORIQ_PTP4L_SITE
	string "qoriq-ptp4l site"
	default "https://github.com/openil/linuxptp.git"

config BR2_PACKAGE_QORIQ_PTP4L_VERSION
	string "qoriq-pto4l version"
	default "25bbcabf05600b0cac18136c05c2d2bf3d538232"

endif
```

## package/nxp/qoriq-python-libxml2/Config.in
```kconfig
config BR2_PACKAGE_QORIQ_PYTHON_LIBXML2
	bool "qoriq-python-libxml2"
	select BR2_PACKAGE_LIBXML2
	select BR2_PACKAGE_LIBXSLT
	select BR2_PACKAGE_ZLIB
	help
	  This is the libxml2 python module, providing access to the
	  libxml2 and libxslt (if available) libraries. For general
	  informationss on those XML and XSLT libraries check their
	  web pages at :
	  http://xmlsoft.org/
	  and
	  http://xmlsoft.org/XSLT/

	  The latest version of the sources for this module and the
	  associated libraries can be found at:
	  ftp://xmlsoft.org/
```

## package/nxp/qoriq-restool/Config.in
```kconfig
config BR2_PACKAGE_QORIQ_RESTOOL
        bool "qoriq-restool"
        help
	  qoriq-restool is a user space application providing the ability to
	  dynamically create and manage DPAA2 containers and objects from Linux.

if BR2_PACKAGE_QORIQ_RESTOOL

config BR2_PACKAGE_QORIQ_RESTOOL_VERSION
	string "qoriq-restool version"

endif
```

## package/nxp/qoriq-servo/Config.in
```kconfig
config BR2_PACKAGE_QORIQ_SERVO
        bool "qoriq-servo"
        default y
          depends on BR2_PACKAGE_IGH_ETHERCAT && BR2_PACKAGE_LIBXML2

if BR2_PACKAGE_QORIQ_SERVO

config BR2_PACKAGE_QORIQ_SERVO_VERSION
	string "qoriq-servo version"
	default "v1.0"

config BR2_PACKAGE_QORIQ_SERVO_SITE
	string "qoriq-servo version"
	default "https://github.com/openil/nxp-servo.git"

endif
```

## package/nxp/qoriq-sysrepo-tsn/Config.in
```kconfig
config BR2_PACKAGE_QORIQ_SYSREPO_TSN
	bool "qoriq-sysrepo-tsn"
	select BR2_PACKAGE_QORIQ_TSNTOOL
	select BR2_PACKAGE_QORIQ_NETOPEER2_SERVER
	select BR2_PACKAGE_QORIQ_YANG_MODEL
	help
	  application to configure tsn feature based on sysrepo.

if BR2_PACKAGE_QORIQ_SYSREPO_TSN

config BR2_PACKAGE_QORIQ_SYSREPO_TSN_VERSION
	string "qoriq-sysrepo-tsn version"
	default "v0.4"

config BR2_PACKAGE_QORIQ_SYSREPO_TSN_SITE
	string "qoriq-sysrepo-tsn site"
	default "https://github.com/openil/sysrepo-tsn.git"

config BR2_PACKAGE_QORIQ_SYSREPO_TSN_TC
	bool "enable tc command to configure tsn"

endif
```

## package/nxp/qoriq-tsn-scripts/Config.in
```kconfig
config BR2_PACKAGE_QORIQ_TSN_SCRIPTS
	bool "qoriq-tsn-scripts"
	depends on BR2_LINUX_KERNEL
	select BR2_PACKAGE_JQ
	help
	  tsn-scripts is a repository for showcasing and testing IEEE 802.1 TSN
	  hardware features on NXP LS1028A-RDB and NXP LS1021A-TSN boards. The
	  repo provides an 'isochron' binary for generating isochronous traffic
	  which is latency-sensitive and helps measure propagation delay across
	  a TSN network.
```

## package/nxp/qoriq-tsntool/Config.in
```kconfig
config BR2_PACKAGE_QORIQ_TSNTOOL
	bool "qoriq-tsntool"
	depends on BR2_LINUX_KERNEL
	select BR2_PACKAGE_LIBNL
	select BR2_PACKAGE_READLINE
	select BR2_PACKAGE_NCURSES
	select BR2_PACKAGE_CJSON
	help
	 tsntool is a tool to configure the tsn capability ethernet port.
	 The kernel need to configure the tsn protocol.

comment "tsntool needs the linux kernel sources"
	depends on !BR2_LINUX_KERNEL

if BR2_PACKAGE_QORIQ_TSNTOOL

config BR2_PACKAGE_QORIQ_TSNTOOL_VERSION
	string "qoriq-tsntool version"
	default "OpenIL-v1.8-202005"

config BR2_PACKAGE_QORIQ_TSNTOOL_SITE
	string "qoriq-tsntool site"
	default "https://github.com/openil/tsntool.git"

endif
```

## package/nxp/qoriq-yang-model/Config.in
```kconfig
config BR2_PACKAGE_QORIQ_YANG_MODEL
	bool "qoriq-yang-model"
	help
	  YANG models

if BR2_PACKAGE_QORIQ_YANG_MODEL

config BR2_PACKAGE_QORIQ_YANG_MODEL_VERSION
	string "qoriq-yang-model version"
	default "b1df41d72ecbfb38c13e96eff42d8f027997baed"

endif
```

## package/opc-motor-status/Config.in
```kconfig
config BR2_PACKAGE_OPC_MOTOR_STATUS
bool "opc-motor-status"
	depends on BR2_PACKAGE_LIBOPEN62541
	select BR2_PACKAGE_JSMN
help
	Example OPC UA server application (using open62541) that relays
	JSON-encoded UDP packets received from an NXP i.MX RT motor control
	board, and exposes their contents into read-only OPC nodes.
```

## package/opc-sja1105/Config.in
```kconfig
config BR2_PACKAGE_OPC_SJA1105
bool "opc-sja1105"
	select BR2_PACKAGE_SJA1105_TOOL
	depends on BR2_PACKAGE_LIBOPEN62541
help
	Example OPC UA server application (using open62541) that exposes
	per-port traffic counters of the SJA1105 TSN switch as objects in
	its address space.
```

## package/optee_client/Config.in
```kconfig
comment "optee_client works on the arm architecture"
	depends on BR2_arm

config BR2_PACKAGE_OPTEE_CLIENT
	bool "optee_client"
	help
	  The optee-client, containing the source code
	  for the TEE client library in Linux.
	  This component provides the TEE Client API as
	  defined by the GlobalPlatform TEE standard.
```

## package/optee_os/Config.in
```kconfig
comment "optee_os works on arm platform"
	depends on BR2_arm

config BR2_PACKAGE_OPTEE_OS
	bool "optee_os"
	help
	  The optee_os git, contains the source code for
	  the TEE in Linux using the ARM® TrustZone®
	  technology. This component meets the GlobalPlatform
	  TEE System Architecture specification. It also
	  provides the TEE Internal core API v1.1 as defined
	  by the GlobalPlatform TEE Standard for the development
	  of Trusted Applications. For a general overview of
	  OP-TEE and to find out how to contribute, please
	  see the Notice.md file.
```

## package/optee_test/Config.in
```kconfig
comment "optee_test works on arm platform"
	depends on BR2_arm

config BR2_PACKAGE_OPTEE_TEST
	bool "optee_test"
	select BR2_PACKAGE_OPTEE_CLIENT
	select BR2_PACKAGE_OPTEE_OS
	help
	  The optee_test git contains the source code
	  for the TEE sanity testsuite in Linux using
	  the ARM(R) TrustZone(R) technology. It is
	  distributed under the GPLv2 and BSD 2-clause
	  open-source licenses. For a general overview
	  of OP-TEE, please see the Notice.md file.
```

## package/phytool/Config.in
```kconfig
config BR2_PACKAGE_PHYTOOL
bool "phytool"
help
	Linux MDIO register access
	  https://github.com/wkz/phytool
```

## package/ppa/Config.in
```kconfig
config BR2_PACKAGE_PPA
	bool "ppa"
	help
	Primary Protected Application (PPA), a resident EL3 firmware.

	Services provided:
		EL3 initialization
			v8 cores
			GIC
			Interconnect
			SoC
		Secure Monitor gateway
		PSCI v0.2
		Aarch32 kernel support

	Devices Supported:
		LS1012A
		LS1028A
		LS1043A, incl v1.1
		LS1046A
		LS1088A
		LS2080A/2085A
		LS2088A
		UA
```

## package/ppfe/Config.in
```kconfig
config BR2_PACKAGE_PPFE
	bool "ppfe firmware for NXP ls1012a platform"
	help
	ls1012a/slow_path : This folder contains pfe firmware
	binaries which supports slow path only.
```

## package/ptp4l/Config.in
```kconfig
config BR2_PACKAGE_PTP4L
	bool "ptp4l"
	help
	This software is an implementation of the Precision Time Protocol
	(PTP) according to IEEE standard 1588 for Linux. The dual design
	goals are to provide a robust implementation of the standard and to
	use the most relevant and modern Application Programming Interfaces
	(API) offered by the Linux kernel. Supporting legacy APIs and other
	platforms is not a goal.

	Features

	- Supports hardware and software time stamping via the Linux
	  SO_TIMESTAMPING socket option.

	- Supports the Linux PTP Hardware Clock (PHC) subsystem by using the
	  clock_gettime family of calls, including the new clock_adjtimex
	  system call.

	- Implements Boundary Clock (BC) and Ordinary Clock (OC).

	- Transport over UDP/IPv4, UDP/IPv6, and raw Ethernet (Layer 2).

	- Supports IEEE 802.1AS-2011 in the role of end station.

	- Modular design allowing painless addition of new transports and
	  clock servos.
```

## package/pyang/Config.in
```kconfig
config BR2_PACKAGE_PYANG
	select BR2_PACKAGE_PYTHON
	select BR2_PACKAGE_PYTHON_LXML
	bool "pyang"
	help
	  YANG (RFC 7950) is a data modeling language for NETCONF (RFC 6241),
	  developed by the IETF NETMOD WG.

	  pyang is a YANG validator, transformator and code generator,
	  written in python. It can be used to validate YANG modules for
	  correctness, to transform YANG modules into other formats, and to
	  generate code from the modules.
	  Compatibility

	  pyang is compatible with the following IETF RFCs:

	      RFC 6020
	      RFC 6087
	      RFC 6110
	      RFC 6643
	      RFC 7950
	      RFC 7952

	  Features

	    - Validate YANG modules.
	    - Convert YANG modules to YIN, and YIN to YANG.
	    - Translate YANG data models to DSDL schemas, which can be used for
	      validating various XML instance documents. See InstanceValidation.
	    - Translate YANG data models to XSD.
	    - Generate UML diagrams from YANG models. See UMLOutput
	      for an example.
	    - Generate compact tree representation of YANG models for quick
	      visualization. See TreeOutput for an example.
	    - Generate a skeleton XML instance document from the data model.
	    - Schema-aware translation of instance documents encoded in XML
	      to JSON and vice-versa. See XmlJson.
	    - Plugin framework for simple development of other outputs, such
	      as code generation.
```

## package/python-wand/Config.in
```kconfig
config BR2_PACKAGE_PYTHON_WAND
	bool "python-wand"
	help
	  Wand is a ctypes-based simple ImageMagick binding for Python.
	  It doesn't cover all functionalities of MagickWand API currently.
	  It works on Python 2.6, 2.7, 3.2--3.5, and PyPy.
```

## package/rcw/Config.in
```kconfig
config BR2_PACKAGE_RCW
	bool "rcw image"
	help
	The reset configuration word for NXP Layerscape platforms

if BR2_PACKAGE_RCW
config BR2_PACKAGE_RCW_BIN
	string "Custom RCW"
endif
```

## package/restool/Config.in
```kconfig
config BR2_PACKAGE_RESTOOL
        bool "NXP restool support"
        help
	  restool is a user space application providing the ability to
	  dynamically create and manage DPAA2 containers and objects from Linux.
```
