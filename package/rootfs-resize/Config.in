## package/rootfs-resize/Config.in
```kconfig
config BR2_PACKAGE_ROOTFS_RESIZE
        bool "rootfs_resize"
        select BR2_PACKAGE_E2FSPROGS
        select BR2_PACKAGE_E2FSPROGS_RESIZE2FS
        select BR2_PACKAGE_UTIL_LINUX_BINARIES
```

## package/sja1105-ptp/Config.in
```kconfig
config BR2_PACKAGE_SJA1105_PTP
	bool "sja1105-ptp"
	depends on BR2_PACKAGE_SJA1105_TOOL
	help
	  This software implements a IEEE 1588 2-step End-to-End
	  transparent clock on SJA1105 switch.
```

## package/sja1105-tool-helpers/Config.in
```kconfig
config BR2_PACKAGE_SJA1105_TOOL_HELPERS
bool "sja1105-tool-helpers"
depends on BR2_PACKAGE_SJA1105_TOOL
select BR2_PACKAGE_BASH
select BR2_PACKAGE_JQ
help
	  This package provides a set of wrapper scripts over sja1105-tool
	  that make it easier to configure the 802.1Qbv engine.

	  https://github.com/openil/sja1105-tool/tree/master/src/helpers
```

## package/sja1105-tool/Config.in
```kconfig
config BR2_PACKAGE_SJA1105_TOOL
bool "sja1105-tool"
select BR2_PACKAGE_IOMEM
help
	The sja1105-tool is a Linux userspace application for configuring the
	NXP SJA1105 Automotive Ethernet L2 switch. The tool supports:

	 * Importing a configuration for the SJA1105 switch from an XML file
	 * Exporting the current SJA1105 configuration as an XML file
	 * Uploading the current SJA1105 configuration to the switch through
	   its SPI interface
	 * Inspecting the current SJA1105 configuration
	 * On-the-fly modification of the current SJA1105 configuration through
	   command line or scripting interface

	https://github.com/openil/sja1105-tool
```

## package/sysrepo-tsn/Config.in
```kconfig
config BR2_PACKAGE_SYSREPO_TSN
bool "sysrepo-tsn"
depends on !BR2_PACKAGE_TRANSAPI
select BR2_PACKAGE_TSNTOOL
select BR2_PACKAGE_NETOPEER2_SERVER
select BR2_PACKAGE_YANG_MODEL

help
	application to configure tsn feature based on sysrepo.
```

## package/tfa/Config.in
```kconfig
config BR2_PACKAGE_TFA
	bool "Trusted Firmware-A (TFA) support"
	help
	  Trusted Firmware-A (TF-A) provides a reference implementation of
	  secure world software for `Armv7-A and Armv8-A`_, including a
	  `Secure Monitor`_ executing at Exception Level 3 (EL3).
	  It implements various Arm interface standards,
```

## package/transapi/Config.in
```kconfig
config BR2_PACKAGE_TRANSAPI
bool "transapi"
depends on !BR2_PACKAGE_YANG_CFGINTERFACES
select BR2_PACKAGE_TSNTOOL
select BR2_PACKAGE_NETOPEER
select BR2_PACKAGE_YANG_MODEL

help
	configue tsn feature based on netopeer project.
if BR2_PACKAGE_TRANSAPI
choice
prompt "platform"

config BR2_PACKAGE_TRANSAPI_LS1028ARDB
	bool "LS1028ARDB"
endchoice
endif
```

## package/tsntool/Config.in
```kconfig
config BR2_PACKAGE_TSNTOOL
	bool "tsntool"
	depends on BR2_LINUX_KERNEL
	select BR2_PACKAGE_LIBNL
	select BR2_PACKAGE_READLINE
	select BR2_PACKAGE_NCURSES
	select BR2_PACKAGE_CJSON
	help
	 tsntool is a tool to configure the tsn capability ethernet port.
	 The kernel need to configure the tsn protocol.

comment "tsntool needs the linux kernel sources"
	depends on !BR2_LINUX_KERNEL
```

## package/weston-imx/Config.in
```kconfig
comment "weston-imx needs udev and a toolchain w/ locale, threads, dynamic library, headers >= 3.0"
	depends on !BR2_PACKAGE_HAS_UDEV || !BR2_TOOLCHAIN_HAS_THREADS || \
		!BR2_TOOLCHAIN_HEADERS_AT_LEAST_3_0 || BR2_STATIC_LIBS || \
		!BR2_ENABLE_LOCALE
	depends on BR2_PACKAGE_IMX_GPU_VIV_OUTPUT_WL
	depends on !BR2_PACKAGE_WESTON

comment "weston-imx needs imx-gpu-viv with wayland output"
	depends on (BR2_arm && BR2_ARM_EABIHF) || BR2_aarch64 # imx-gpu-viv
	depends on !BR2_PACKAGE_IMX_GPU_VIV_OUTPUT_WL
	depends on !BR2_PACKAGE_WESTON

config BR2_PACKAGE_WESTON_IMX
	bool "weston-imx"
	depends on !BR2_STATIC_LIBS # wayland
	depends on BR2_TOOLCHAIN_HAS_THREADS # wayland
	depends on BR2_TOOLCHAIN_HEADERS_AT_LEAST_3_0
	depends on BR2_PACKAGE_HAS_UDEV
	depends on BR2_PACKAGE_IMX_GPU_VIV_OUTPUT_WL
	depends on !BR2_PACKAGE_WESTON
	select BR2_PACKAGE_WAYLAND
	select BR2_PACKAGE_WAYLAND_PROTOCOLS_IMX
	select BR2_PACKAGE_LIBXKBCOMMON
	select BR2_PACKAGE_CAIRO
	select BR2_PACKAGE_CAIRO_PNG
	select BR2_PACKAGE_LIBPNG
	select BR2_PACKAGE_JPEG
	select BR2_PACKAGE_LIBINPUT
	select BR2_PACKAGE_LIBDRM_IMX
	# Runtime dependency
	select BR2_PACKAGE_XKEYBOARD_CONFIG
	# Make sure at least one compositor is selected.
	help
	  Weston is the reference implementation of a Wayland
	  compositor, and a useful compositor in its own right.
	  Weston has various backends that lets it run on Linux kernel
	  modesetting and evdev input as well as under X11.

	  http://wayland.freedesktop.org/
```

## package/yang-cfginterfaces/Config.in
```kconfig
config BR2_PACKAGE_YANG_CFGINTERFACES
bool "yang-cfginterfaces"
	select BR2_PACKAGE_NETOPEER
help
	netopeer yang model CFGINTERFACES
```

## package/yang-sja1105/Config.in
```kconfig
config BR2_PACKAGE_YANG_SJA1105
select BR2_PACKAGE_SJA1105_TOOL
bool "yang-sja1105"
	select BR2_PACKAGE_NETOPEER
help
	netopeer yang model NXP sja1105
```

## package/yang-tsn/Config.in
```kconfig
config BR2_PACKAGE_YANG_TSN
select BR2_PACKAGE_TSNTOOL
select BR2_PACKAGE_NETOPEER
bool "yang-tsn"
help
	config tsn by netopeer
```
