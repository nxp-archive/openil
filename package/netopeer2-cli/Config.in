## package/netopeer2-cli/Config.in
```kconfig
config BR2_PACKAGE_NETOPEER2_CLI
	bool "netopeer2-cli"
	select BR2_PACKAGE_LIBYANG
	select BR2_PACKAGE_LIBNETCONF2
	help
	  A CLI utility for talking to NETCONF servers

	  https://github.com/CESNET/Netopeer2
```

## package/netopeer2-keystored/Config.in
```kconfig
config BR2_PACKAGE_NETOPEER2_KEYSTORED
	bool "netopeer2-keystored"
	select BR2_PACKAGE_OPENSSH
	select BR2_PACKAGE_SYSREPO
	help
	  Management of SSH keys for Netopeer2, a NETCONF server. NETCONF is an
	  Internet protocol for remote management of network devices.

	  https://github.com/CESNET/Netopeer2
```

## package/netopeer2-server/Config.in
```kconfig
config BR2_PACKAGE_NETOPEER2_SERVER
	bool "netopeer2-server"
	select BR2_PACKAGE_LIBYANG
	select BR2_PACKAGE_LIBNETCONF2
	select BR2_PACKAGE_SYSREPO
	select BR2_PACKAGE_NETOPEER2_KEYSTORED
	help
	  A NETCONF server with a modular datastore allowing interconnection
	  and control of various applications. NETCONF is an Internet protocol
	  for remote management of network devices.

	  https://github.com/CESNET/Netopeer2
```

## package/nxp-servo/Config.in
```kconfig
config BR2_PACKAGE_NXP_SERVO
        bool "nxp-servo"
        default y
        depends on BR2_PACKAGE_IGH_ETHERCAT && BR2_PACKAGE_LIBXML2
```

## package/nxp/Config.in
```kconfig
menu "NXP QorIQ libraries"
	depends on BR2_aarch64 || BR2_arm || BR2_powerpc64 || BR2_powerpc

source "package/nxp/qoriq-cadence-dp-firmware/Config.in"
source "package/nxp/qoriq-bm-uboot/Config.in"
source "package/nxp/qoriq-ddr-phy/Config.in"
source "package/nxp/qoriq-eth-phy/Config.in"
source "package/nxp/qoriq-fmucode/Config.in"
source "package/nxp/qoriq-libbee/Config.in"
source "package/nxp/qoriq-libblep/Config.in"
source "package/nxp/qoriq-libnfc-nci/Config.in"
source "package/nxp/qoriq-mc-fw/Config.in"
source "package/nxp/qoriq-mc-utils/Config.in"
source "package/nxp/qoriq-nodejs-lbt/Config.in"
source "package/nxp/qoriq-perl-exporter-tiny/Config.in"
source "package/nxp/qoriq-perl-feedgnuplot/Config.in"
source "package/nxp/qoriq-perl-list-moreutils/Config.in"
source "package/nxp/qoriq-ppfe/Config.in"
source "package/nxp/qoriq-prl/Config.in"
source "package/nxp/qoriq-ptp4l/Config.in"
source "package/nxp/qoriq-python-libxml2/Config.in"
source "package/nxp/qoriq-servo/Config.in"
source "package/nxp/qoriq-yang-model/Config.in"

endmenu
```

## package/nxp/qoriq-cadence-dp-firmware/Config.in
```kconfig
config BR2_PACKAGE_QORIQ_CADENCE_DP_FIRMWARE
	bool "qoriq-cadence-dp-firmware"
	help
	  NXP QorIQ cadence DP firmware, a resident EL3 firmware.

if BR2_PACKAGE_QORIQ_CADENCE_DP_FIRMWARE

config BR2_PACKAGE_QORIQ_CADENCE_DP_FIRMWARE_VERSION
	string "qoriq-cadence-dp-firmware version"
	default "lsdk2004"

endif
```

## package/nxp/qoriq-ddr-phy/Config.in
```kconfig
config BR2_PACKAGE_QORIQ_DDR_PHY
	bool "qoriq-ddr-phy"
	help
	  DDR PHY firmware for qoriq platforms

if BR2_PACKAGE_QORIQ_DDR_PHY

config BR2_PACKAGE_QORIQ_DDR_PHY_VERSION
	string "qoriq-ddr-phy version"

endif
```

## package/nxp/qoriq-edgescale-eds/Config.in
```kconfig
config BR2_PACKAGE_QORIQ_EDGESCALE_EDS
	bool "qorio-edgescale-eds"
	help
	  The qoriq edgescale eds. 

	  https://bitbucket.sw.nxp.com/projects/DCCA/repos/qoriq-edgescale-eds/browse

if BR2_PACKAGE_QORIQ_EDGESCALE_EDS

config BR2_PACKAGE_QORIQ_EDGESCALE_EDS_VERSION
	string "qorio-edgescale-eds version"
	default "7d70a8767941aed135d609300a0594dfdc60e5ea"

endif
```

## package/nxp/qoriq-eds-bootstrap/Config.in
```kconfig
config BR2_PACKAGE_QORIQ_EDS_BOOTSTRAP
	bool "qoriq-eds-bootstrap"
	help
	  The qoriq eds bootstrap.

	  https://bitbucket.sw.nxp.com/projects/DCCA/repos/qoriq-eds-bootstrap/browse

if BR2_PACKAGE_QORIQ_EDS_BOOTSTRAP

config BR2_PACKAGE_QORIQ_EDS_BOOTSTRAP_VERSION
	string "qoriq-eds-bootstrap version"
	default "72abfd9b61cc8a6d10e4808a87ff4ce1e2b99020"

endif
```

## package/nxp/qoriq-eds-kubelet/Config.in
```kconfig
config BR2_PACKAGE_QORIQ_EDS_KUBELET
	bool "qoriq-eds-kubelet"
	help
	  The edgescale kubelet. 

	  https://bitbucket.sw.nxp.com/projects/DCCA/repos/qoriq-eds-kubelet/browse

if BR2_PACKAGE_QORIQ_EDS_KUBELET

config BR2_PACKAGE_QORIQ_EDS_KUBELET_VERSION
	string "qoriq-eds-kubelet version"
	default "cf5175b3186e1308cc29a6295fb7bd012b614a22"

endif
```

## package/nxp/qoriq-eth-phy/Config.in
```kconfig
config BR2_PACKAGE_QORIQ_ETH_PHY
        bool "qoriq-eth-phy"
        help
	  The Prebuid ETH PHY binary

if BR2_PACKAGE_QORIQ_ETH_PHY

config BR2_PACKAGE_QORIQ_ETH_PHY_VERSION
	string "eth-phy version"

endif
```

## package/nxp/qoriq-genavb-tsn-bridge/Config.in
```kconfig
config BR2_PACKAGE_QORIQ_GENAVB_TSN_BRIDGE
	bool "qoriq-genavb-tsn-bridge"
	depends on BR2_LINUX_KERNEL
	help
	 install GenAVB/TSN binaries and kernel module

comment "GenAVB/TSN needs the linux kernel sources"
	depends on !BR2_LINUX_KERNEL

if	BR2_PACKAGE_QORIQ_GENAVB_TSN_BRIDGE

config BR2_PACKAGE_QORIQ_GENAVB_TSN_BRIDGE_VERSION
	string "GenAVB/TSN SDK Version"
	default "dev/bridge_3_4_0_cand20210226"

config BR2_PACKAGE_QORIQ_GENAVB_TSN_BRIDGE_SITE
	string "GenAVB/TSN SDK Site"
	default "ssh://git@bitbucket.sw.nxp.com/mss/gen_avb_sdk.git"

endif
```

## package/nxp/qoriq-genavb-tsn-endpoint-tsn/Config.in
```kconfig
config BR2_PACKAGE_QORIQ_GENAVB_TSN_ENDPOINT_TSN
	bool "qoriq-genavb-tsn-endpoint-tsn"
	depends on BR2_LINUX_KERNEL
	help
	 install GenAVB/TSN binaries and kernel module

comment "GenAVB/TSN needs the linux kernel sources"
	depends on !BR2_LINUX_KERNEL

if	BR2_PACKAGE_QORIQ_GENAVB_TSN_ENDPOINT_TSN

config BR2_PACKAGE_QORIQ_GENAVB_TSN_ENDPOINT_TSN_VERSION
	string "GenAVB/TSN SDK Version"
	default "dev/endpoint_tsn_3_4_0_cand20210226"

config BR2_PACKAGE_QORIQ_GENAVB_TSN_ENDPOINT_TSN_SITE
	string "GenAVB/TSN SDK Site"
	default "ssh://git@bitbucket.sw.nxp.com/mss/gen_avb_sdk.git"

endif
```

## package/nxp/qoriq-h-libxml2/Config.in.host
```kconfig
config BR2_PACKAGE_QORIQ_H_LIBXML2
	bool "qoriq-h-libxml2"
	help
	  XML C Parser

	  http://xmlsoft.org/
```

## package/nxp/qoriq-h-python-libxml2/Config.in.host
```kconfig
config BR2_PACKAGE_QORIQ_H_PYTHON_LIBXML2
	bool "qoriq-h-python-libxml2"
	select BR2_PACKAGE_LIBXML2
	help
	  This is the libxml2 python module, providing access to the
	  libxml2 and libxslt (if available) libraries. For general
	  informationss on those XML and XSLT libraries check their
	  web pages at :
	  http://xmlsoft.org/
	  and
	  http://xmlsoft.org/XSLT/

	  The latest version of the sources for this module and the
	  associated libraries can be found at:
	  ftp://xmlsoft.org/
```

## package/nxp/qoriq-icc/Config.in
```kconfig
config BR2_PACKAGE_QORIQ_ICC
	bool "Inter-core communication with baremetal"
	help
	  The ICC is a verification application for
	  Inter-core communication between Linux and
	  baremetal on different cores.

if BR2_PACKAGE_QORIQ_ICC

config BR2_PACKAGE_QORIQ_ICC_GIC_OFFSET_ALIGN
	bool "Set GIC offset aligin to 64K"
	help
	  Set GIC offset aligin to 64K, support on rev1.1 of ls1043a.

config BR2_PACKAGE_QORIQ_ICC_GIC_IMX6Q
	bool "Set GIC support i.mx6q"
	help
	  Set GIC support i.mx6q.

config BR2_PACKAGE_QORIQ_ICC_GIC_LX2160A
	bool "Set ICC support LX2160A"
	help
	  Set GIC support LX2160A.

config BR2_PACKAGE_QORIQ_ICC_MAX_CPUS
	int "Max cpus on platform"
	default 2
	help
	  Set the number of cpus on platform.

endif
```

## package/nxp/qoriq-iomem/Config.in
```kconfig
config BR2_PACKAGE_QORIQ_IOMEM
	bool "qoriq-iomem"
	select BR2_PACKAGE_READLINE
	help
	  iomem is a tool that allows direct access to memory-mapped registers.
	  In embedded systems, this can be very handy if you do not have to write
	  a driver for simple tasks but can tamper with iomem directly in the memory.

	  For example, to read out the 32 bit register at the address 0x12345678
	  call "iomem r32 0x12345678". To read out the four 16 bit registers at
	  the io address 0x100 one would execute "iomem r16-port: 4 0x100".
	  There are modes to read and write on register blocks and to make several
	  read or write accesses to a FIFO register.

	  There is also an option to wait polling for a register to accept a
	  certain bit pattern.

	  http://svn.clifford.at/tools/trunk/iomem.c
	  http://www.clifford.at/frame.cgi?blog/index.php?/archives/117-rpn.html
```

## package/nxp/qoriq-libbee/Config.in
```kconfig
config BR2_PACKAGE_QORIQ_LIBBEE
	bool "qoriq-libbee"
	default n
	help
	  MikroBUS: bee click board(MRF24J40MA)
```

## package/nxp/qoriq-libblep/Config.in
```kconfig
config BR2_PACKAGE_QORIQ_LIBBLEP
	bool "qoriq-libblep"
	default n
	help
	  MikroBUS: blep click board(nRF8001)
```

## package/nxp/qoriq-libnfc-nci/Config.in
```kconfig
config BR2_PACKAGE_QORIQ_LIBNFC_NCI
	bool "qoriq-libnfc-nci"
	default n
	help
	  Linux NFC stack for NCI based NXP NFC Controllers.

	  https://www.nxp.com/products/identification-and-security/nfc/nfc-reader-ics:NFC-READER

if BR2_PACKAGE_QORIQ_LIBNFC_NCI

config BR2_PACKAGE_QORIQ_LIBNFC_NCI_VERSION
	string "qoriq-libnfc-nci version"
	default "R2.4"

endif
```

## package/nxp/qoriq-mc-fw/Config.in
```kconfig
config BR2_PACKAGE_QORIQ_MC_FW
        bool "qoriq-mc-fw"
        help
	  The Prebuidl MC binaries for Management Complex (MC) of DPAA2 (Data Path
	  Acceleration Architecture, second version).

if BR2_PACKAGE_QORIQ_MC_FW

config BR2_PACKAGE_QORIQ_MC_FW_VERSION
	string "mc-fw version"
	default "LSDK-20.04"

config BR2_PACKAGE_QORIQ_MC_FW_BIN
	string "mc-fw binary"
	default "mc_10.20.4_lx2160a.itb"

endif
```

## package/nxp/qoriq-mc-utils/Config.in
```kconfig
config BR2_PACKAGE_QORIQ_MC_UTILS
        bool "qoriq-mc-utils"
        help
	  The Management Complex (MC) is a key component of DPAA2 (Data Path
	  Acceleration Architecture, second version).
	  MC runs an NXP-supplied firmware image that abstracts and simplifies the
	  allocation and configuration of the other hardware elements using DPAA2
	  “objects”.

if BR2_PACKAGE_QORIQ_MC_UTILS

config BR2_PACKAGE_QORIQ_MC_UTILS_VERSION
	string "mc-utils version"

endif
```

## package/nxp/qoriq-netopeer2-cli/Config.in
```kconfig
config BR2_PACKAGE_QORIQ_NETOPEER2_CLI
	bool "qoriq-netopeer2-cli"
	select BR2_PACKAGE_LIBYANG
	select BR2_PACKAGE_LIBNETCONF2
	help
	  A CLI utility for talking to NETCONF servers

	  https://github.com/CESNET/Netopeer2

if BR2_PACKAGE_QORIQ_NETOPEER2_CLI

config BR2_PACKAGE_QORIQ_NETOPEER2_CLI_VERSION
	string "qoriq-netopeer2-cli version"
	default "0.7-r2"

endif
```

## package/nxp/qoriq-netopeer2-keystored/Config.in
```kconfig
config BR2_PACKAGE_QORIQ_NETOPEER2_KEYSTORED
	bool "qoriq-netopeer2-keystored"
	select BR2_PACKAGE_SYSREPO
	select BR2_PACKAGE_LIBNETCONF2
	help
	  Management of SSH keys for Netopeer2, a NETCONF server. NETCONF is an
	  Internet protocol for remote management of network devices.


	  https://github.com/CESNET/Netopeer2

if BR2_PACKAGE_QORIQ_NETOPEER2_KEYSTORED

config BR2_PACKAGE_QORIQ_NETOPEER2_KEYSTORED_VERSION
       string "qoriq-netopeer2-keystored version"
	default "0.7-r2"

endif
```

## package/nxp/qoriq-netopeer2-server/Config.in
```kconfig
config BR2_PACKAGE_QORIQ_NETOPEER2_SERVER
	bool "qoriq-netopeer2-server"
	select BR2_PACKAGE_QORIQ_NETOPEER2_KEYSTORED
	select BR2_PACKAGE_LIBYANG
	select BR2_PACKAGE_LIBNETCONF2
	select BR2_PACKAGE_SYSREPO
	help
	  A NETCONF server with a modular datastore allowing interconnection
	  and control of various applications. NETCONF is an Internet protocol
	  for remote management of network devices.

	  https://github.com/CESNET/Netopeer2

if BR2_PACKAGE_QORIQ_NETOPEER2_SERVER

config BR2_PACKAGE_QORIQ_NETOPEER2_SERVER_VERSION
	string "qoriq-netopeer2-server version"
	default "0.7-r2"

endif
```
