## openil-package/bm-uboot/Config.in
```kconfig
config BR2_PACKAGE_BM_UBOOT
	bool "Baremetal OS framework based on Uboot"
	select BR2_PACKAGE_HOST_DTC
	help
	Baremetal OS framework running on a single
	physical processor. It's built based on Uboot
	and includs Hardware resource assignment,
	Interrupt, Inter-processor communication and
	other features. And the baremetal OS framework
	also provides APIs for customer development.

if BR2_PACKAGE_BM_UBOOT
config BR2_PACKAGE_BM_UBOOT_DEFCONFIG
	string "The defconfig to build baremetal Uboot"
endif
```

## openil-package/dp/Config.in
```kconfig
config BR2_PACKAGE_DP
	bool "display port firmware"
	help
	Display Port, a resident EL3 firmware.

if BR2_PACKAGE_DP
config BR2_PACKAGE_DP_BIN
	string "Custom Firmware BIN"
endif
```

## openil-package/icc/Config.in
```kconfig
config BR2_PACKAGE_ICC
bool "Inter-core communication with baremetal"
help
	The ICC is a verification application for
	Inter-core communication between Linux and
	baremetal on different cores.

config BR2_PACKAGE_ICC_GIC_OFFSET_ALIGN
bool "Set GIC offset aligin to 64K"
help
	Set GIC offset aligin to 64K, support on rev1.1 of ls1043a.

config BR2_PACKAGE_ICC_MAX_CPUS
int "Max cpus on platform"
default 2
help
	Set the number of cpus on platform.
```

## openil-package/iproute2-next/Config.in
```kconfig
config BR2_PACKAGE_IPROUTE2_NEXT
	bool "iproute2-next"
	depends on !BR2_PACKAGE_IPROUTE2
	depends on BR2_USE_MMU # fork()
	depends on BR2_TOOLCHAIN_HEADERS_AT_LEAST_3_4 # __kernel_{u,}long_t
	help
	  David Ahern's -next iproute2 tree

	  https://git.kernel.org/pub/scm/network/iproute2/iproute2-next.git/

comment "iproute2-next needs a toolchain w/ headers >= 3.4"
	depends on BR2_USE_MMU
	depends on !BR2_TOOLCHAIN_HEADERS_AT_LEAST_3_4
```

## openil-package/libnetconf/Config.in
```kconfig
config BR2_PACKAGE_LIBNETCONF
	bool "libnetconf"
	select BR2_PACKAGE_OPENSSL
	select BR2_PACKAGE_LIBGCRYPT
	select BR2_PACKAGE_LIBSSH
	select BR2_PACKAGE_LIBXSLT
	select BR2_PACKAGE_NCURSES
	select BR2_PACKAGE_READLINE
	select BR2_PACKAGE_DBUS
	select BR2_PACKAGE_HOST-PYANG
	select BR2_PACKAGE_PYTHON-LIBXML2
	select BR2_PACKAGE_H-PYTHON-LIBXML2
	select BR2_PACKAGE_LIBCURL

	help
	  libnetconf is a NETCONF library in C intended for building NETCONF
	  clients and servers. It provides basic functions to connect NETCONF
	  client and server to each other via SSH, to send and receive NETCONF
	  messages and to store and work with the configuration data in a
	  datastore.

	  With the experiences from libnetconf, we have moved our activities
	  to work on next generation of this library based on libyang library.
	  libnetconf2 is mature enough to be used as a replacement of the
	  original libnetconf. Therefore, the libnetconf is no more developed
	  neither maintained. Note, that while libnetconf2 does not include
	  NETCONF datastore implementation, this particular functionality can
	  be implemented via sysrepo project. Similarly, the NETCONF
	  server/client implementation Netopeer is deprecated and replaced by
	  Netopeer2 which can be also used as a reference tool using
	  libnetconf2 functions.

	  libnetconf was developed by the Tools for Monitoring and
	  Configuration department of CESNET. It implements the NETCONF
	  protocol introduced by IETF - more information about NETCONF
	  protocol can be found at NETCONF WG.

	  https://github.com/CESNET/libnetconf
```

## openil-package/libopen62541/Config.in
```kconfig
config BR2_PACKAGE_LIBOPEN62541
	bool "libopen62541"
	select BR2_PACKAGE_UA_NODESET
	help
	  open62541 is an open source and free implementation of OPC UA (OPC
	  Unified Architecture). open62541 is a C-based library (linking with
	  C++ projects is possible) with all necessary tools to implement
	  dedicated OPC UA clients and servers, or to integrate OPC UA-based
	  communication into existing applications.

	  http://open62541.org


config BR2_PACKAGE_OPEN62541_EXAMPLES
	depends on BR2_PACKAGE_LIBOPEN62541
	bool "open62541-examples"
	help
	  open62541 is an open source and free implementation of OPC UA (OPC
	  Unified Architecture). open62541 is a C-based library (linking with
	  C++ projects is possible) with all necessary tools to implement
	  dedicated OPC UA clients and servers, or to integrate OPC UA-based
	  communication into existing applications.

	  http://open62541.org
```

## openil-package/nodejs-lbt/Config.in
```kconfig
config BR2_PACKAGE_NODEJS_LBT
	bool "nodejs-lbt"
	depends on BR2_PACKAGE_NODEJS
	select BR2_PACKAGE_PERL_FEEDGNUPLOT
	select BR2_PACKAGE_PRL
	help
	  Latency and Bandwidth Tester is a web application for generating and
	  plotting iPerf and ping traffic, used for the NXP LS1021A-TSN demos.
```

## openil-package/openil-rcw/Config.in
```kconfig
config BR2_PACKAGE_OPENIL_RCW
	bool "rcw image"
	help
	The reset configuration word for NXP Layerscape platforms

if BR2_PACKAGE_OPENIL_RCW
config BR2_PACKAGE_OPENIL_RCW_BIN
	string "Custom RCW"
endif
```

## openil-package/perl-feedgnuplot/Config.in
```kconfig
config BR2_PACKAGE_PERL_FEEDGNUPLOT
	bool "perl-feedgnuplot"
	depends on !BR2_STATIC_LIBS
	select BR2_PACKAGE_GNUPLOT
	select BR2_PACKAGE_PERL_LIST_MOREUTILS
	select BR2_PACKAGE_PERL_EXPORTER_TINY
	help
	  General purpose pipe-oriented plotting tool

	  https://github.com/dkogan/feedgnuplot

comment "perl-feedgnuplot needs a toolchain w/ dynamic library"
	depends on BR2_STATIC_LIBS
```

## openil-package/perl-list-moreutils/Config.in
```kconfig
config BR2_PACKAGE_PERL_LIST_MOREUTILS
	bool "perl-list-moreutils"
	help
	  List::MoreUtils provides some trivial but commonly needed
	  functionality on lists which is not going to go into List::Util.

	  https://metacpan.org/release/List-MoreUtils
```

## openil-package/ppa/Config.in
```kconfig
config BR2_PACKAGE_PPA
	bool "ppa"
	select BR2_PACKAGE_HOST_UBOOT_TOOLS
	select BR2_PACKAGE_HOST_UBOOT_TOOLS_FIT_SUPPORT
	help
	Primary Protected Application (PPA), a resident EL3 firmware.

	Services provided:
		EL3 initialization
			v8 cores
			GIC
			Interconnect
			SoC
		Secure Monitor gateway
		PSCI v0.2
		Aarch32 kernel support

	Devices Supported:
		LS1012A
		LS1028A
		LS1043A
		LS1046A
		LS1088A
		LS2080A
		LS2088A
		LA1575
		LA17XX
		LX2169

if BR2_PACKAGE_PPA
config BR2_PACKAGE_PPA_PLATFORM
	string
	default "ls1012" if BR2_TARGET_UBOOT_BOARDNAME="ls1012ardb_qspi"
	default "ls1028" if BR2_TARGET_UBOOT_BOARDNAME="ls1028ardb_sdcard"
	default "ls1028" if BR2_TARGET_UBOOT_BOARDNAME="ls1028ardb_emmc"
	default "ls1028" if BR2_TARGET_UBOOT_BOARDNAME="ls1028ardb_sdcard_baremetal"
	default "ls1043" if BR2_TARGET_UBOOT_BOARDNAME="ls1043ardb_sdcard"
	default "ls1043" if BR2_TARGET_UBOOT_BOARDNAME="ls1043ardb_sdcard_baremetal"
	default "ls1046" if BR2_TARGET_UBOOT_BOARDNAME="ls1046ardb_sdcard"
	default "ls1046" if BR2_TARGET_UBOOT_BOARDNAME="ls1046ardb_sdcard_baremetal"
	default "ls1046" if BR2_TARGET_UBOOT_BOARDNAME="ls1046ardb_qspi"
	default "ls1046" if BR2_TARGET_UBOOT_BOARDNAME="ls1046ardb_qspi_SECURE_BOOT"
endif
```

## openil-package/prl/Config.in
```kconfig
config BR2_PACKAGE_PRL
	bool "prl"
	help
	  PRL (Pipe Rate Limiter) is a C program for pipeline manipulation
	  that filters stdin per line, and rate limits stdout to a given rate,
	  dropping excess lines.
```

## openil-package/qoriq-edgescale-eds/Config.in
```kconfig
config BR2_PACKAGE_QORIQ_EDGESCALE_EDS
	bool "qorio edgescale eds"
	help
	  The qoriq edgescale eds. 

	  https://bitbucket.sw.nxp.com/projects/DCCA/repos/qoriq-edgescale-eds/browse
```
