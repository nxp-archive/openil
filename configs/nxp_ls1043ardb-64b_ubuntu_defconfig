## configs/nxp_ls1043ardb-64b_ubuntu_defconfig
```kconfig
# Architecture
BR2_aarch64=y

# Filesystem
BR2_TARGET_ROOTFS_EXT2=y
BR2_TARGET_ROOTFS_EXT2_4=y
BR2_TARGET_ROOTFS_EXT2_GZIP=y
BR2_ROOTFS_SKELETON_CUSTOM=y
BR2_ROOTFS_SKELETON_CUSTOM_SITE="http://cdimage.ubuntu.com/ubuntu-base/releases/xenial/release"
BR2_ROOTFS_SKELETON_CUSTOM_SOURCE="ubuntu-base-16.04.3-base-arm64.tar.gz"
BR2_ROOTFS_SKELETON_CUSTOM_SITE_METHOD="wget"
BR2_ROOTFS_SKELETON_CUSTOM_EXTRACT="tar zxvf"
BR2_ROOTFS_SKELETON_CUSTOM_EXTRACT_IGNORE_ERROR=y
BR2_ROOTFS_POST_CUSTOM_SKELETON_SCRIPT="board/nxp/common/post-custom-skeleton-ubuntu-base-16.04.sh"
BR2_INIT_SYSTEMD=y

# system issue
BR2_TARGET_GENERIC_ISSUE="Welcome to OpenIL"

# Linux headers same as kernel
BR2_PACKAGE_HOST_LINUX_HEADERS_CUSTOM_4_14=y

# toolchain
BR2_TOOLCHAIN_EXTERNAL=y

# bootloader
BR2_TARGET_UBOOT=y
BR2_TARGET_UBOOT_BOARDNAME="ls1043ardb_tfa"
BR2_TARGET_UBOOT_CUSTOM_GIT=y
BR2_TARGET_UBOOT_CUSTOM_REPO_URL="https://github.com/openil/u-boot.git"
BR2_TARGET_UBOOT_CUSTOM_REPO_VERSION="OpenIL-v1.7-u-boot-202001"
BR2_TARGET_UBOOT_NEEDS_DTC=y
BR2_TARGET_UBOOT_FORMAT_BIN=n
BR2_TARGET_UBOOT_FORMAT_CUSTOM=y
BR2_TARGET_UBOOT_FORMAT_CUSTOM_NAME="u-boot-dtb.bin"
BR2_PACKAGE_UBOOT_TOOLS_MKIMAGE=y
BR2_TARGET_UBOOT_ENVIMAGE=y
BR2_TARGET_UBOOT_ENVIMAGE_SOURCE="board/nxp/ls1043ardb/u-boot-environment-64b.txt"
BR2_TARGET_UBOOT_ENVIMAGE_SIZE="0x2000"

# Kernel
BR2_LINUX_KERNEL=y
BR2_LINUX_KERNEL_CUSTOM_GIT=y
BR2_LINUX_KERNEL_CUSTOM_REPO_URL="https://github.com/openil/linux.git"
BR2_LINUX_KERNEL_CUSTOM_REPO_VERSION="OpenIL-v1.7-linux-202001"
BR2_LINUX_KERNEL_USE_ARCH_DEFAULT_CONFIG=y
BR2_LINUX_KERNEL_CONFIG_FRAGMENT_FILES="$(LINUX_DIR)/arch/arm64/configs/lsdk.config board/nxp/common/linux-4_9-selinux.config board/nxp/common/linux-4_9-docker.config board/nxp/common/linux-4_9-dmcrypt.config board/nxp/common/linux-4_9-xenomai.config"
BR2_LINUX_KERNEL_DTS_SUPPORT=y
BR2_LINUX_KERNEL_INTREE_DTS_NAME="freescale/fsl-ls1043a-rdb-sdk"
BR2_LINUX_KERNEL_IMAGE_TARGET_CUSTOM=y
BR2_LINUX_KERNEL_IMAGE_TARGET_NAME="Image"
#BR2_LINUX_KERNEL_UIMAGE=y
#BR2_LINUX_KERNEL_UIMAGE_LOADADDR="0x80008000"
# Serial port config
BR2_TARGET_GENERIC_GETTY=n
# BR2_TARGET_GENERIC_GETTY_PORT="ttyS0"

# required tools to create the microSD image
BR2_PACKAGE_HOST_DOSFSTOOLS=y
BR2_PACKAGE_HOST_GENIMAGE=y
BR2_PACKAGE_HOST_MTOOLS=y
BR2_ROOTFS_POST_BUILD_SCRIPT="board/nxp/common/post-build-ubuntu-base-16.04.sh"
BR2_ROOTFS_POST_IMAGE_SCRIPT="board/nxp/ls1043ardb/post-image-64b-ubuntu.sh"
BR2_ROOTFS_POST_SCRIPT_ARGS="$(LINUX_DIR) $(TOPDIR) $(UBOOT_DIR)"

# Add ota overlay
BR2_ROOTFS_OVERLAY="board/nxp/common/ota_overlay board/nxp/common/systemd_init_overlay"

# extend the partition size
BR2_TARGET_ROOTFS_EXT2_EXTRA_BLOCKS=102400
BR2_TARGET_ROOTFS_EXT2_EXTRA_INODES=102400

# busybox setting disable
BR2_PACKAGE_BUSYBOX=n

#
# Networking applications
#
BR2_PACKAGE_DHCP=y
BR2_PACKAGE_DHCP_CLIENT=y

#
# System tools
#
BR2_PACKAGE_PSMISC=y

# RCW
BR2_PACKAGE_RCW=y
BR2_PACKAGE_RCW_BIN="ls1043ardb/RR_FQPP_1455/rcw_1600_sdboot.bin"

# packages for fman and fmc
BR2_PACKAGE_FMLIB=y
BR2_PACKAGE_FMUCODE=y
BR2_PACKAGE_FMUCODE_BIN="fsl_fman_ucode_ls1043_r1.1_108_4_9.bin"
BR2_PACKAGE_FMC=y

# dhcpd/net/ip packages
BR2_PACKAGE_DHCPCD=y
BR2_PACKAGE_NET_TOOLS=y
BR2_PACKAGE_IPUTILS=y
BR2_PACKAGE_OPENSSL=y

# wget package
BR2_PACKAGE_WGET=y

# Text editors
BR2_PACKAGE_NANO=y

# IGH ETHERCAT
BR2_PACKAGE_IGH_ETHERCAT=y

#
# Edge-scale service
#
BR2_PACKAGE_QORIQ_EDGESCALE_EDS=y
BR2_PACKAGE_QORIQ_EDS_KUBELET=y
BR2_PACKAGE_QORIQ_EDS_BOOTSTRAP=y

BR2_PACKAGE_ETHTOOL=y
BR2_PACKAGE_COLLECTD_CURL=y
BR2_PACKAGE_COLLECTD_CURL_JSON=y
BR2_PACKAGE_COLLECTD_CURL_XML=y
BR2_PACKAGE_LIBCURL=y
BR2_PACKAGE_CURL=y
BR2_PACKAGE_LIBCURL_VERBOSE=y
BR2_PACKAGE_FLICKCURL=y

BR2_PACKAGE_FLICKCURL_UTILS=y
BR2_PACKAGE_VIM=y
BR2_PACKAGE_VIM_RUNTIME=y

#
# sqlcipher conflicts with sqlite
#
BR2_PACKAGE_SQLITE=y

BR2_PACKAGE_IPROUTE2=y
BR2_PACKAGE_IPTABLES=y

BR2_PACKAGE_DOCKER_ENGINE=y
BR2_PACKAGE_DOCKER_ENGINE_DAEMON=y

BR2_PACKAGE_PYTHON=y
BR2_PACKAGE_PYTHON_PYC_ONLY=y

#
# core python modules
#

BR2_PACKAGE_PYTHON_UNICODEDATA=y
BR2_PACKAGE_PYTHON_UCS2=y

#
# External python modules
#
BR2_PACKAGE_PYTHON_NUMPY_ARCH_SUPPORTS=y

BR2_PACKAGE_LIBFFI=y

# TFA support
BR2_PACKAGE_TFA=y
```

## configs/nxp_ls1043ardb_baremetal-64b_defconfig
```kconfig
# Architecture
BR2_aarch64=y
BR2_cortex_a53=y

# Filesystem
BR2_TARGET_ROOTFS_EXT2=y
BR2_TARGET_ROOTFS_EXT2_4=y
BR2_TARGET_ROOTFS_EXT2_LABEL="root"

# Hostname and issue
BR2_TARGET_GENERIC_HOSTNAME="LS1043ARDB"
BR2_TARGET_GENERIC_ISSUE="Welcome to OpenIL"

# toolchain
BR2_TOOLCHAIN_EXTERNAL=y
BR2_TOOLCHAIN_EXTERNAL_ARM_AARCH64=y
BR2_TOOLCHAIN_USES_GLIBC=y
BR2_TOOLCHAIN_EXTERNAL_GLIBC=y

# Linux headers same as kernel
BR2_PACKAGE_HOST_LINUX_HEADERS_CUSTOM_5_4=y

# bootloader
BR2_TARGET_UBOOT=y
BR2_TARGET_UBOOT_BOARDNAME="ls1043ardb_tfa_baremetal"
BR2_TARGET_UBOOT_CUSTOM_GIT=y
BR2_TARGET_UBOOT_NEEDS_DTC=y
BR2_TARGET_UBOOT_FORMAT_BIN=n
BR2_TARGET_UBOOT_FORMAT_CUSTOM=y
BR2_TARGET_UBOOT_FORMAT_CUSTOM_NAME="u-boot-dtb.bin"
BR2_PACKAGE_UBOOT_TOOLS_MKIMAGE=y
BR2_TARGET_UBOOT_ENVIMAGE=y
BR2_TARGET_UBOOT_ENVIMAGE_SOURCE="board/nxp/ls1043ardb/u-boot-environment-baremetal.txt"
BR2_TARGET_UBOOT_ENVIMAGE_SIZE="0x2000"

# Baremetal u-boot package
BR2_PACKAGE_QORIQ_BM_UBOOT=y
BR2_PACKAGE_QORIQ_BM_UBOOT_DEFCONFIG="ls1043ardb_defconfig"

# Kernel
BR2_LINUX_KERNEL=y
BR2_LINUX_KERNEL_CUSTOM_GIT=y
BR2_LINUX_KERNEL_USE_ARCH_DEFAULT_CONFIG=y
BR2_LINUX_KERNEL_CONFIG_FRAGMENT_FILES="$(LINUX_DIR)/arch/arm64/configs/lsdk.config board/nxp/common/ls/linux-baremetal.config"
BR2_LINUX_KERNEL_DTS_SUPPORT=y
BR2_LINUX_KERNEL_INTREE_DTS_NAME="freescale/fsl-ls1043a-rdb-sdk-bm"
BR2_LINUX_KERNEL_IMAGE_TARGET_CUSTOM=y
BR2_LINUX_KERNEL_IMAGE_TARGET_NAME="Image"
BR2_LINUX_KERNEL_NEEDS_HOST_OPENSSL=y

# Serial port config
BR2_TARGET_GENERIC_GETTY=y
BR2_TARGET_GENERIC_GETTY_PORT="ttyS0"

# required tools to create the microSD image
BR2_PACKAGE_HOST_DOSFSTOOLS=y
BR2_PACKAGE_HOST_GENIMAGE=y
BR2_PACKAGE_HOST_MTOOLS=y
BR2_ROOTFS_POST_IMAGE_SCRIPT="board/nxp/ls1043ardb/post-image-baremetal.sh"
BR2_ROOTFS_POST_SCRIPT_ARGS="$(LINUX_DIR) $(TOPDIR) $(UBOOT_DIR)"

# busybox setting
BR2_PACKAGE_BUSYBOX_CONFIG_FRAGMENT_FILES="board/nxp/common/ls/busybox.config"
BR2_PACKAGE_BUSYBOX_SHOW_OTHERS=y

# packages for rcw
BR2_PACKAGE_HOST_QORIQ_RCW=y
BR2_PACKAGE_HOST_QORIQ_RCW_BOOT_MODE="sd"
BR2_PACKAGE_HOST_QORIQ_RCW_BIN="ls1043ardb/RR_FQPP_1455/rcw_1600_sdboot.bin"

# packages for fman and fmc
BR2_PACKAGE_FMLIB=y
BR2_PACKAGE_FMC=y
BR2_PACKAGE_QORIQ_FMUCODE=y
BR2_PACKAGE_QORIQ_FMUCODE_BIN="fsl_fman_ucode_ls1043_r1.1_108_4_9.bin"

#eudev support
BR2_ROOTFS_DEVICE_CREATION_DYNAMIC_EUDEV=y
BR2_ROOTFS_OVERLAY="board/nxp/common/ls/busybox_rootfs_resize_overlay board/nxp/common/ls/busybox_init_overlay"

# Arm-Trusted-Firmware
BR2_TARGET_ARM_TRUSTED_FIRMWARE=y
BR2_TARGET_ARM_TRUSTED_FIRMWARE_FIP=y
BR2_TARGET_ARM_TRUSTED_FIRMWARE_UBOOT_AS_BL33=y
BR2_TARGET_ARM_TRUSTED_FIRMWARE_UBOOT_BL33_IMAGE="u-boot-dtb.bin"
BR2_TARGET_ARM_TRUSTED_FIRMWARE_CUSTOM_GIT=y
BR2_TARGET_ARM_TRUSTED_FIRMWARE_CUSTOM_REPO_URL="https://source.codeaurora.org/external/qoriq/qoriq-components/atf"
BR2_TARGET_ARM_TRUSTED_FIRMWARE_PLATFORM="ls1043ardb"
BR2_TARGET_ARM_TRUSTED_FIRMWARE_IMAGES="fip.bin bl2_sd.pbl"
BR2_TARGET_ARM_TRUSTED_FIRMWARE_ADDITIONAL_TARGETS="pbl"
BR2_TARGET_ARM_TRUSTED_FIRMWARE_ADDITIONAL_DEPENDENCIES="host-qoriq-rcw"
BR2_TARGET_ARM_TRUSTED_FIRMWARE_ADDITIONAL_VARIABLES="BOOT_MODE=sd RCW=$(BINARIES_DIR)/rcw_1600_sdboot.bin"

# qoriq-ptp4l package
BR2_PACKAGE_QORIQ_PTP4L=y

# icc package for baremetal
BR2_PACKAGE_QORIQ_ICC=y
BR2_PACKAGE_QORIQ_ICC_GIC_OFFSET_ALIGN=y
BR2_PACKAGE_QORIQ_ICC_MAX_CPUS=4

# basic packages and tools
BR2_PACKAGE_MTD=y
BR2_PACKAGE_MTD_MTD_DEBUG=y
BR2_PACKAGE_SYSSTAT=y
BR2_PACKAGE_E2FSPROGS=y
BR2_PACKAGE_RT_TESTS=y
BR2_PACKAGE_OPENSSH=y
BR2_PACKAGE_OPENSSL=y
BR2_PACKAGE_WGET=y

# ca-certs packages
BR2_PACKAGE_CA_CERTIFICATES=y

# dhcpd package
BR2_PACKAGE_DHCPCD=y

# resize2fs package
BR2_PACKAGE_E2FSPROGS_RESIZE2FS=y

# Text editors
BR2_PACKAGE_NANO=y

# IGH ETHERCAT
BR2_PACKAGE_IGH_ETHERCAT=y

#iproute2
BR2_PACKAGE_IPROUTE2=y

#netperf
BR2_PACKAGE_NETPERF=y

BR2_PACKAGE_ETHTOOL=y
BR2_PACKAGE_COLLECTD_CURL=y
BR2_PACKAGE_COLLECTD_CURL_JSON=y
BR2_PACKAGE_COLLECTD_CURL_XML=y
BR2_PACKAGE_LIBCURL=y
BR2_PACKAGE_LIBCURL_CURL=y
BR2_PACKAGE_LIBCURL_VERBOSE=y
BR2_PACKAGE_FLICKCURL=y
BR2_PACKAGE_FLICKCURL_UTILS=y
BR2_PACKAGE_BASH=y
BR2_SYSTEM_BIN_SH_BASH=y
BR2_SYSTEM_BIN_SH="bash"

# haveged
BR2_PACKAGE_HAVEGED=y

#avahi
BR2_PACKAGE_AVAHI=y
BR2_PACKAGE_AVAHI_AUTOIPD=y
BR2_PACKAGE_AVAHI_DAEMON=y
BR2_PACKAGE_AVAHI_LIBDNSSD_COMPATIBILITY=y
BR2_PACKAGE_NSS_MDNS=y

# i2c-tools
BR2_PACKAGE_I2C_TOOLS=y

BR2_USE_MMU=y
BR2_USE_WCHAR=y
BR2_PACKAGE_VIM=y

BR2_INSTALL_LIBSTDCPP=y
BR2_PACKAGE_IPERF=y

BR2_TOOLCHAIN_HAS_THREADS=y
BR2_PACKAGE_IPERF3=y
BR2_PACKAGE_TCPDUMP=y
```

## configs/nxp_ls1046ardb-32b_defconfig
```kconfig
# Architecture
BR2_aarch64=y
BR2_cortex_a72=y

# toolchain
BR2_TOOLCHAIN_EXTERNAL=y

# bootloader
BR2_TARGET_UBOOT=y
BR2_TARGET_UBOOT_BOARDNAME="ls1046ardb_tfa"
BR2_TARGET_UBOOT_CUSTOM_GIT=y
BR2_TARGET_UBOOT_CUSTOM_REPO_URL="https://github.com/openil/u-boot.git"
BR2_TARGET_UBOOT_CUSTOM_REPO_VERSION="OpenIL-v1.7-u-boot-202001"
BR2_TARGET_UBOOT_NEEDS_DTC=y
BR2_TARGET_UBOOT_FORMAT_BIN=n
BR2_TARGET_UBOOT_FORMAT_CUSTOM=y
BR2_TARGET_UBOOT_FORMAT_CUSTOM_NAME="u-boot-dtb.bin"
BR2_PACKAGE_UBOOT_TOOLS_MKIMAGE=y
BR2_TARGET_UBOOT_ENVIMAGE=y
BR2_TARGET_UBOOT_ENVIMAGE_SOURCE="board/nxp/ls1046ardb/u-boot-environment.txt"
BR2_TARGET_UBOOT_ENVIMAGE_SIZE="0x2000"

# Kernel
BR2_LINUX_KERNEL=y
BR2_LINUX_KERNEL_CUSTOM_GIT=y
BR2_LINUX_KERNEL_CUSTOM_REPO_URL="https://github.com/openil/linux.git"
BR2_LINUX_KERNEL_CUSTOM_REPO_VERSION="OpenIL-v1.7-linux-202001"
BR2_LINUX_KERNEL_USE_ARCH_DEFAULT_CONFIG=y
BR2_LINUX_KERNEL_CONFIG_FRAGMENT_FILES="$(LINUX_DIR)/arch/arm64/configs/lsdk.config"
BR2_LINUX_KERNEL_DTS_SUPPORT=y
BR2_LINUX_KERNEL_INTREE_DTS_NAME="freescale/fsl-ls1046a-rdb-sdk"
# Linux headers same as kernel
BR2_PACKAGE_HOST_LINUX_HEADERS_CUSTOM_4_14=y

BR2_INIT_NONE=n
BR2_PACKAGE_BUSYBOX=n
BR2_TARGET_ROOTFS_TAR=n

# RCW
BR2_PACKAGE_RCW=y
BR2_PACKAGE_RCW_BIN="ls1046ardb/RR_FFSSPPPH_1133_5559/rcw_1800_sdboot.bin"

BR2_ROOTFS_POST_IMAGE_SCRIPT="board/nxp/ls1046ardb/ls1046ardb-32b.sh"
BR2_ROOTFS_POST_SCRIPT_ARGS="$(UBOOT_DIR) $(TOPDIR)"

# Text editors
BR2_PACKAGE_NANO=y

# TFA support
BR2_PACKAGE_TFA=y
```

## configs/nxp_ls1046ardb-64b_qspi-sb_defconfig
```kconfig
# Architecture
BR2_aarch64=y
BR2_cortex_a72=y

# Filesystem
BR2_TARGET_ROOTFS_CPIO=y
BR2_TARGET_ROOTFS_CPIO_GZIP=y
BR2_TARGET_ROOTFS_CPIO_UIMAGE=y
BR2_TARGET_ROOTFS_EXT2=y
BR2_TARGET_ROOTFS_EXT2_4=y
BR2_TARGET_ROOTFS_EXT2_GZIP=y

# Hostname and issue
BR2_TARGET_GENERIC_HOSTNAME="OpenIL"
BR2_TARGET_GENERIC_ISSUE="Welcome to OpenIL"

# Linux headers same as kernel
BR2_PACKAGE_HOST_LINUX_HEADERS_CUSTOM_4_14=y

# toolchain
BR2_TOOLCHAIN_EXTERNAL=y

# bootloader
BR2_TARGET_UBOOT=y
BR2_TARGET_UBOOT_BOARDNAME="ls1046ardb_tfa_SECURE_BOOT"
BR2_TARGET_UBOOT_CUSTOM_GIT=y
BR2_TARGET_UBOOT_CUSTOM_REPO_URL="https://github.com/openil/u-boot.git"
BR2_TARGET_UBOOT_CUSTOM_REPO_VERSION="OpenIL-v1.7-u-boot-202001"
BR2_TARGET_UBOOT_NEEDS_DTC=y
BR2_TARGET_UBOOT_FORMAT_BIN=n
BR2_TARGET_UBOOT_FORMAT_CUSTOM=y
BR2_TARGET_UBOOT_FORMAT_CUSTOM_NAME="u-boot-dtb.bin"
BR2_PACKAGE_UBOOT_TOOLS_MKIMAGE=y
BR2_TARGET_UBOOT_ENVIMAGE=y
BR2_TARGET_UBOOT_ENVIMAGE_SOURCE="board/nxp/ls1046ardb/u-boot-environment-64b-qspi.txt"
BR2_TARGET_UBOOT_ENVIMAGE_SIZE="0x2000"

# Kernel
BR2_LINUX_KERNEL=y
BR2_LINUX_KERNEL_CUSTOM_GIT=y
BR2_LINUX_KERNEL_CUSTOM_REPO_URL="https://github.com/openil/linux.git"
BR2_LINUX_KERNEL_CUSTOM_REPO_VERSION="OpenIL-v1.7-linux-202001"
BR2_LINUX_KERNEL_USE_ARCH_DEFAULT_CONFIG=y
BR2_LINUX_KERNEL_CONFIG_FRAGMENT_FILES="$(LINUX_DIR)/arch/arm64/configs/lsdk.config"
BR2_LINUX_KERNEL_DTS_SUPPORT=y
BR2_LINUX_KERNEL_INTREE_DTS_NAME="freescale/fsl-ls1046a-rdb-sdk"
BR2_LINUX_KERNEL_IMAGE_TARGET_CUSTOM=y
BR2_LINUX_KERNEL_IMAGE_TARGET_NAME="Image.gz"
#BR2_LINUX_KERNEL_UIMAGE=y
#BR2_LINUX_KERNEL_UIMAGE_LOADADDR="0x80008000"
# Serial port config
BR2_TARGET_GENERIC_GETTY=n
# BR2_TARGET_GENERIC_GETTY_PORT="ttyS0"

# BASH
BR2_SYSTEM_BIN_SH_BASH=y

# required tools to create the microSD image
BR2_PACKAGE_HOST_DOSFSTOOLS=y
BR2_PACKAGE_HOST_GENIMAGE=y
BR2_PACKAGE_HOST_MTOOLS=y
BR2_ROOTFS_POST_IMAGE_SCRIPT="board/nxp/ls1046ardb/post-image-64b-qspi-sb.sh"
BR2_ROOTFS_POST_SCRIPT_ARGS="$(LINUX_DIR) $(TOPDIR) $(UBOOT_DIR)"

# busybox setting
BR2_PACKAGE_BUSYBOX_CONFIG_FRAGMENT_FILES="board/nxp/common/openil-busybox.config"
BR2_PACKAGE_BUSYBOX_SHOW_OTHERS=y

# packages for rcw
BR2_PACKAGE_RCW=y
BR2_PACKAGE_RCW_BIN="ls1046ardb/RR_FFSSPPPH_1133_5559/rcw_1800_qspiboot.bin"

# Add ota overlay
BR2_ROOTFS_OVERLAY="board/nxp/common/ota_overlay board/nxp/common/busybox_init_overlay"

# packages for fman and fmc
BR2_PACKAGE_FMLIB=y
BR2_PACKAGE_FMUCODE=y
BR2_PACKAGE_FMUCODE_BIN="fsl_fman_ucode_ls1046_r1.0_106_4_18.bin"
BR2_PACKAGE_FMC=y

# basic packages and tools
BR2_PACKAGE_MTD=y
BR2_PACKAGE_MTD_MTD_DEBUG=y
BR2_PACKAGE_SYSSTAT=y
BR2_PACKAGE_E2FSPROGS=y
BR2_PACKAGE_RT_TESTS=y
BR2_PACKAGE_OPENSSH=y
BR2_PACKAGE_OPENSSL=y
BR2_PACKAGE_OPENSSL_BIN=y
BR2_PACKAGE_OPENSSL_ENGINES=y
BR2_PACKAGE_WGET=y

# for secure boot tool
BR2_PACKAGE_HOST_CST=y
BR2_PACKAGE_HOST_CST_CORE_HOLDOFF=y

# dhcpd package
BR2_PACKAGE_DHCPCD=y

# resize2fs package
BR2_PACKAGE_E2FSPROGS_RESIZE2FS=y

# python package
BR2_PACKAGE_PYTHON=y

# libest package
BR2_PACKAGE_LIBEST=y

# sudo,gzip,tar packages
BR2_PACKAGE_SUDO=y
BR2_PACKAGE_GZIP=y
BR2_PACKAGE_TAR=y

# Text editors
BR2_PACKAGE_NANO=y

# IGH ETHERCAT
BR2_PACKAGE_IGH_ETHERCAT=y

# TFA support
BR2_PACKAGE_TFA=y
```
