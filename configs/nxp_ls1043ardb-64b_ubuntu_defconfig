## configs/nxp_ls1046ardb-64b_ubuntu_defconfig
```kconfig
# Architecture
BR2_aarch64=y

# Filesystem
BR2_TARGET_ROOTFS_EXT2=y
BR2_TARGET_ROOTFS_EXT2_4=y
BR2_TARGET_ROOTFS_EXT2_GZIP=y
BR2_ROOTFS_SKELETON_CUSTOM=y
BR2_ROOTFS_SKELETON_CUSTOM_PATH="system/custom-skeleton/ubuntu-base-16.04.2-arm64"
BR2_INIT_SYSTEMD=y

# system issue
BR2_TARGET_GENERIC_ISSUE="Welcome to OpenIL"

# Linux headers same as kernel, a 4.1 series
BR2_PACKAGE_HOST_LINUX_HEADERS_CUSTOM_4_1=y

# toolchain
BR2_TOOLCHAIN_BUILDROOT_GLIBC=y
BR2_TOOLCHAIN_BUILDROOT_CXX=y

# bootloader
BR2_TARGET_UBOOT=y
BR2_TARGET_UBOOT_BOARDNAME="ls1046ardb_sdcard"
BR2_TARGET_UBOOT_CUSTOM_GIT=y
BR2_TARGET_UBOOT_CUSTOM_REPO_URL="https://github.com/openil/u-boot.git"
BR2_TARGET_UBOOT_CUSTOM_REPO_VERSION="master"
BR2_TARGET_UBOOT_NEEDS_DTC=y
BR2_TARGET_UBOOT_FORMAT_BIN=n
BR2_TARGET_UBOOT_FORMAT_CUSTOM=y
BR2_TARGET_UBOOT_FORMAT_CUSTOM_NAME="u-boot-with-spl-pbl.bin"
BR2_PACKAGE_UBOOT_TOOLS_MKIMAGE=y
BR2_TARGET_UBOOT_ENVIMAGE=y
BR2_TARGET_UBOOT_ENVIMAGE_SOURCE="board/nxp/ls1046ardb/u-boot-environment-64b.txt"
BR2_TARGET_UBOOT_ENVIMAGE_SIZE="0x2000"

# Kernel
BR2_LINUX_KERNEL=y
BR2_LINUX_KERNEL_CUSTOM_GIT=y
BR2_LINUX_KERNEL_CUSTOM_REPO_URL="https://github.com/openil/linux.git"
BR2_LINUX_KERNEL_CUSTOM_REPO_VERSION="master"
BR2_LINUX_KERNEL_USE_ARCH_DEFAULT_CONFIG=y
BR2_LINUX_KERNEL_CONFIG_FRAGMENT_FILES="$(LINUX_DIR)/arch/arm64/configs/freescale.config board/nxp/common/linux-4_1-docker.config board/nxp/common/linux-4_1-selinux.config"
BR2_LINUX_KERNEL_DTS_SUPPORT=y
BR2_LINUX_KERNEL_INTREE_DTS_NAME="freescale/fsl-ls1046a-rdb"
BR2_LINUX_KERNEL_IMAGE_TARGET_CUSTOM=y
BR2_LINUX_KERNEL_IMAGE_TARGET_NAME="Image.gz"
#BR2_LINUX_KERNEL_UIMAGE=y
#BR2_LINUX_KERNEL_UIMAGE_LOADADDR="0x80008000"
# Serial port config
BR2_TARGET_GENERIC_GETTY=n
# BR2_TARGET_GENERIC_GETTY_PORT="ttyS0"

# required tools to create the microSD image
BR2_PACKAGE_HOST_DOSFSTOOLS=y
BR2_PACKAGE_HOST_GENIMAGE=y
BR2_PACKAGE_HOST_MTOOLS=y
BR2_ROOTFS_POST_IMAGE_SCRIPT="board/nxp/ls1046ardb/post-image-64b-ubuntu.sh"
BR2_ROOTFS_POST_SCRIPT_ARGS="$(LINUX_DIR) $(TOPDIR) $(UBOOT_DIR)"

# extend the partition size
BR2_TARGET_ROOTFS_EXT2_EXTRA_BLOCKS=102400
BR2_TARGET_ROOTFS_EXT2_EXTRA_INODES=102400

# busybox setting disable
BR2_PACKAGE_BUSYBOX=n

# packages for fman and fmc
BR2_PACKAGE_FMLIB=y
BR2_PACKAGE_FMUCODE=y
BR2_PACKAGE_FMC=y

# dhcpd/net/ip packages
BR2_PACKAGE_DHCPCD=y
BR2_PACKAGE_NET_TOOLS=y
BR2_PACKAGE_IPUTILS=y
# wget package
BR2_PACKAGE_WGET=y
```

## configs/nxp_lx2160ardb-64b_ubuntu_defconfig
```kconfig
# Architecture
BR2_aarch64=y
BR2_cortex_a72=y

# Filesystem
BR2_TARGET_ROOTFS_EXT2=y
BR2_TARGET_ROOTFS_EXT2_4=y
BR2_TARGET_ROOTFS_EXT2_GZIP=y
BR2_ROOTFS_SKELETON_CUSTOM=y
BR2_ROOTFS_SKELETON_CUSTOM_SITE="http://cdimage.ubuntu.com/ubuntu-base/releases/xenial/release"
BR2_ROOTFS_SKELETON_CUSTOM_SOURCE="ubuntu-base-16.04.3-base-arm64.tar.gz"
BR2_ROOTFS_SKELETON_CUSTOM_SITE_METHOD="wget"
BR2_ROOTFS_SKELETON_CUSTOM_EXTRACT="tar zxvf"
BR2_ROOTFS_SKELETON_CUSTOM_EXTRACT_IGNORE_ERROR=y
BR2_ROOTFS_POST_CUSTOM_SKELETON_SCRIPT="board/nxp/lx2160ardb/post-custom-skeleton-ubuntu-base-16.04.sh"
BR2_INIT_SYSTEMD=y

# Hostname and issue
BR2_TARGET_GENERIC_ISSUE="Welcome to OpenIL"

# Linux headers same as kernel
BR2_PACKAGE_HOST_LINUX_HEADERS_CUSTOM_4_14=y

# toolchain
BR2_TOOLCHAIN_EXTERNAL=y

# bootloader
BR2_TARGET_UBOOT=y
BR2_TARGET_UBOOT_BOARDNAME="lx2160ardb_tfa"
BR2_TARGET_UBOOT_CUSTOM_GIT=y
BR2_TARGET_UBOOT_CUSTOM_REPO_URL="https://github.com/openil/u-boot.git"
BR2_TARGET_UBOOT_CUSTOM_REPO_VERSION="OpenIL-v1.7-u-boot-202001"
BR2_TARGET_UBOOT_NEEDS_DTC=y
BR2_TARGET_UBOOT_FORMAT_BIN=n
BR2_TARGET_UBOOT_FORMAT_CUSTOM=y
BR2_TARGET_UBOOT_FORMAT_CUSTOM_NAME="u-boot-dtb.bin"
BR2_PACKAGE_UBOOT_TOOLS_MKIMAGE=y
BR2_TARGET_UBOOT_ENVIMAGE=y
BR2_TARGET_UBOOT_ENVIMAGE_SOURCE="board/nxp/lx2160ardb/u-boot-environment-64b.txt"
BR2_TARGET_UBOOT_ENVIMAGE_SIZE="0x2000"

# Kernel
BR2_LINUX_KERNEL=y
BR2_LINUX_KERNEL_CUSTOM_GIT=y
BR2_LINUX_KERNEL_CUSTOM_REPO_URL="https://github.com/openil/linux.git"
BR2_LINUX_KERNEL_CUSTOM_REPO_VERSION="OpenIL-v1.7-linux-202001"
BR2_LINUX_KERNEL_USE_ARCH_DEFAULT_CONFIG=y
BR2_LINUX_KERNEL_CONFIG_FRAGMENT_FILES="$(LINUX_DIR)/arch/arm64/configs/lsdk.config board/nxp/common/linux-4_9-selinux.config board/nxp/common/linux-4_9-docker.config board/nxp/common/linux-4_9-xenomai.config"
BR2_LINUX_KERNEL_DTS_SUPPORT=y
BR2_LINUX_KERNEL_INTREE_DTS_NAME="freescale/fsl-lx2160a-rdb"
BR2_LINUX_KERNEL_IMAGE_TARGET_CUSTOM=y
BR2_LINUX_KERNEL_IMAGE_TARGET_NAME="Image"

# Serial port config
BR2_TARGET_GENERIC_GETTY=y
BR2_TARGET_GENERIC_GETTY_PORT="ttyAMA0"

# required tools to create the microSD image
BR2_PACKAGE_HOST_DOSFSTOOLS=y
BR2_PACKAGE_HOST_GENIMAGE=y
BR2_PACKAGE_HOST_MTOOLS=y
BR2_ROOTFS_POST_BUILD_SCRIPT="board/nxp/common/post-build-ubuntu-base-16.04.sh"
BR2_ROOTFS_POST_IMAGE_SCRIPT="board/nxp/lx2160ardb/post-image-64b-ubuntu.sh"
BR2_ROOTFS_POST_SCRIPT_ARGS="$(LINUX_DIR) $(TOPDIR) $(UBOOT_DIR)"

# extend the partition size
BR2_TARGET_ROOTFS_EXT2_EXTRA_BLOCKS=102400
BR2_TARGET_ROOTFS_EXT2_EXTRA_INODES=102400

# Add ota overlay
BR2_ROOTFS_OVERLAY="board/nxp/common/ota_overlay board/nxp/common/busybox_init_overlay"

# busybox setting disable
BR2_PACKAGE_BUSYBOX=n

# Networking applications
BR2_PACKAGE_DHCP=y
BR2_PACKAGE_DHCP_CLIENT=y

# packages for rcw
BR2_PACKAGE_RCW=y
BR2_PACKAGE_RCW_BIN="lx2160ardb/XGGFF_PP_HHHH_RR_19_5_2/rcw_2000_700_2900_19_5_2_sd.bin"

# packages for xenomai
BR2_PACKAGE_XENOMAI=y
BR2_PACKAGE_XENOMAI_ARCH_SUPPORTS=y
BR2_PACKAGE_XENOMAI_RTCAN=y
BR2_PACKAGE_XENOMAI_ANALOGY=y
BR2_PACKAGE_XENOMAI_NATIVE_SKIN=y
BR2_PACKAGE_XENOMAI_POSIX_SKIN=y
BR2_PACKAGE_XENOMAI_TESTSUITE=y

# dhcpd package
BR2_PACKAGE_DHCPCD=y

#
# Edge-scale service
#
BR2_PACKAGE_QORIQ_EDGESCALE_EDS=y
BR2_PACKAGE_QORIQ_EDS_KUBELET=y
BR2_PACKAGE_QORIQ_EDS_BOOTSTRAP=y

# haveged
BR2_PACKAGE_HAVEGED=y

#avahi
BR2_PACKAGE_AVAHI=y
BR2_PACKAGE_AVAHI_AUTOIPD=y
BR2_PACKAGE_AVAHI_DAEMON=y
BR2_PACKAGE_AVAHI_LIBDNSSD_COMPATIBILITY=y
BR2_PACKAGE_NSS_MDNS=y

#TFA support
BR2_PACKAGE_TFA=y

# DDR PHY firmware
BR2_PACKAGE_DDR_PHY=y

# ETH PHY firmware
BR2_PACKAGE_ETH_PHY=y

# MC firmware
BR2_PACKAGE_MC_FW=y
BR2_PACKAGE_MC_UTILS=y

# restool
BR2_PACKAGE_RESTOOL=y
```

## configs/nxp_lx2160ardb_rev2-64b-xspi_defconfig
```kconfig
# Architecture
BR2_aarch64=y
BR2_cortex_a72=y

# Filesystem
BR2_TARGET_ROOTFS_CPIO=y
BR2_TARGET_ROOTFS_CPIO_GZIP=y
BR2_TARGET_ROOTFS_CPIO_UIMAGE=y

# Hostname and issue
BR2_TARGET_GENERIC_HOSTNAME="LX2160ARDB"
BR2_TARGET_GENERIC_ISSUE="Welcome to OpenIL"

# toolchain
BR2_TOOLCHAIN_EXTERNAL=y
BR2_TOOLCHAIN_EXTERNAL_ARM_AARCH64=y
BR2_TOOLCHAIN_USES_GLIBC=y
BR2_TOOLCHAIN_EXTERNAL_GLIBC=y

# Linux headers same as kernel
BR2_PACKAGE_HOST_LINUX_HEADERS_CUSTOM_5_4=y

# bootloader
BR2_TARGET_UBOOT=y
BR2_TARGET_UBOOT_BOARDNAME="lx2160ardb_tfa"
BR2_TARGET_UBOOT_CUSTOM_GIT=y
BR2_TARGET_UBOOT_NEEDS_DTC=y
BR2_TARGET_UBOOT_FORMAT_BIN=n
BR2_TARGET_UBOOT_FORMAT_CUSTOM=y
BR2_TARGET_UBOOT_FORMAT_CUSTOM_NAME="u-boot-dtb.bin"
BR2_PACKAGE_UBOOT_TOOLS_MKIMAGE=y
BR2_TARGET_UBOOT_ENVIMAGE=y
BR2_TARGET_UBOOT_ENVIMAGE_SOURCE="board/nxp/lx2160ardb/u-boot-environment-xspi.txt"
BR2_TARGET_UBOOT_ENVIMAGE_SIZE="0x2000"

# Kernel
BR2_LINUX_KERNEL=y
BR2_LINUX_KERNEL_CUSTOM_GIT=y
BR2_LINUX_KERNEL_USE_ARCH_DEFAULT_CONFIG=y
BR2_LINUX_KERNEL_CONFIG_FRAGMENT_FILES="$(LINUX_DIR)/arch/arm64/configs/lsdk.config"
BR2_LINUX_KERNEL_DTS_SUPPORT=y
BR2_LINUX_KERNEL_INTREE_DTS_NAME="freescale/fsl-lx2160a-rdb"
BR2_LINUX_KERNEL_IMAGE_TARGET_CUSTOM=y
BR2_LINUX_KERNEL_IMAGE_TARGET_NAME="Image.gz"
BR2_LINUX_KERNEL_NEEDS_HOST_OPENSSL=y

# Serial port config
BR2_TARGET_GENERIC_GETTY=y
BR2_TARGET_GENERIC_GETTY_PORT="ttyAMA0"

# required tools to create the microSD image
BR2_PACKAGE_HOST_DOSFSTOOLS=y
BR2_PACKAGE_HOST_GENIMAGE=y
BR2_PACKAGE_HOST_MTOOLS=y
BR2_ROOTFS_POST_IMAGE_SCRIPT="board/nxp/lx2160ardb/post-image-spi.sh"
BR2_ROOTFS_POST_SCRIPT_ARGS="$(LINUX_DIR) $(TOPDIR) $(UBOOT_DIR)"

# busybox setting
BR2_PACKAGE_BUSYBOX_CONFIG_FRAGMENT_FILES="board/nxp/common/ls/busybox.config"
BR2_PACKAGE_BUSYBOX_SHOW_OTHERS=y

# packages for rcw
BR2_PACKAGE_HOST_QORIQ_RCW=y
BR2_PACKAGE_HOST_QORIQ_RCW_BOOT_MODE="flexspi_nor"
BR2_PACKAGE_HOST_QORIQ_RCW_VERSION="LSDK-20.04-update-290520"
BR2_PACKAGE_HOST_QORIQ_RCW_BIN="lx2160ardb_rev2/XGGFF_PP_HHHH_RR_19_5_2/rcw_2200_750_3200_19_5_2.bin "

# Add busybox init overlay
BR2_ROOTFS_DEVICE_CREATION_DYNAMIC_EUDEV=y
BR2_ROOTFS_OVERLAY="board/nxp/lx2160ardb/busybox_init_overlay"

# Arm-Trusted-Firmware
BR2_TARGET_ARM_TRUSTED_FIRMWARE=y
BR2_TARGET_ARM_TRUSTED_FIRMWARE_FIP=y
BR2_TARGET_ARM_TRUSTED_FIRMWARE_UBOOT_AS_BL33=y
BR2_TARGET_ARM_TRUSTED_FIRMWARE_UBOOT_BL33_IMAGE="u-boot-dtb.bin"
BR2_TARGET_ARM_TRUSTED_FIRMWARE_CUSTOM_GIT=y
BR2_TARGET_ARM_TRUSTED_FIRMWARE_CUSTOM_REPO_URL="https://source.codeaurora.org/external/qoriq/qoriq-components/atf"
BR2_TARGET_ARM_TRUSTED_FIRMWARE_PLATFORM="lx2160ardb"
BR2_TARGET_ARM_TRUSTED_FIRMWARE_IMAGES="fip.bin bl2_flexspi_nor.pbl"
BR2_TARGET_ARM_TRUSTED_FIRMWARE_ADDITIONAL_TARGETS="pbl"
BR2_TARGET_ARM_TRUSTED_FIRMWARE_ADDITIONAL_DEPENDENCIES="host-qoriq-rcw"
BR2_TARGET_ARM_TRUSTED_FIRMWARE_ADDITIONAL_VARIABLES="BOOT_MODE=flexspi_nor RCW=$(BINARIES_DIR)/rcw_2200_750_3200_19_5_2.bin"

# DDR PHY firmware
BR2_PACKAGE_QORIQ_DDR_PHY=y

# ETH PHY firmware
BR2_PACKAGE_QORIQ_ETH_PHY=y

# MC firmware
BR2_PACKAGE_QORIQ_MC_FW=y
BR2_PACKAGE_QORIQ_MC_UTILS=y

# restool
BR2_PACKAGE_QORIQ_RESTOOL=y

# basic packages and tools
BR2_PACKAGE_MTD=y
BR2_PACKAGE_MTD_MTD_DEBUG=y
BR2_PACKAGE_SYSSTAT=y
BR2_PACKAGE_E2FSPROGS=y
BR2_PACKAGE_RT_TESTS=y
BR2_PACKAGE_OPENSSH=y
BR2_PACKAGE_OPENSSL=y
BR2_PACKAGE_WGET=y

# ca-certs packages
BR2_PACKAGE_CA_CERTIFICATES=y

# dhcpd package
BR2_PACKAGE_DHCPCD=y

# resize2fs package
BR2_PACKAGE_E2FSPROGS_RESIZE2FS=y

# Text editors
BR2_PACKAGE_NANO=y

#iputils
BR2_PACKAGE_IPUTILS=y

#iproute2
BR2_PACKAGE_IPROUTE2=y

#netperf
BR2_PACKAGE_NETPERF=y

BR2_PACKAGE_ETHTOOL=y
BR2_PACKAGE_NET_TOOLS=y
BR2_PACKAGE_COLLECTD_CURL=y
BR2_PACKAGE_COLLECTD_CURL_JSON=y
BR2_PACKAGE_COLLECTD_CURL_XML=y
BR2_PACKAGE_LIBCURL=y
BR2_PACKAGE_LIBCURL_CURL
BR2_PACKAGE_LIBCURL_VERBOSE=y
BR2_PACKAGE_FLICKCURL=y
BR2_PACKAGE_FLICKCURL_UTILS=y
BR2_PACKAGE_BASH=y
BR2_SYSTEM_BIN_SH_BASH=y
BR2_SYSTEM_BIN_SH="bash"

# haveged
BR2_PACKAGE_HAVEGED=y

#avahi
BR2_PACKAGE_AVAHI=y
BR2_PACKAGE_AVAHI_AUTOIPD=y
BR2_PACKAGE_AVAHI_DAEMON=y
BR2_PACKAGE_AVAHI_LIBDNSSD_COMPATIBILITY=y
BR2_PACKAGE_NSS_MDNS=y

# OPC UA tools
BR2_PACKAGE_LIBOPEN62541=y
BR2_PACKAGE_LIBOPEN62541_BUILD_EXAMPLES=y
```

## configs/nxp_lx2160ardb_rev2-64b_ubuntu_full_defconfig
```kconfig
# Architecture
BR2_aarch64=y
BR2_cortex_a72=y

# Filesystem
BR2_TARGET_ROOTFS_EXT2=y
BR2_TARGET_ROOTFS_EXT2_4=y

# custom skeleton
BR2_ROOTFS_SKELETON_UBUNTU=y
BR2_ROOTFS_SKELETON_CUSTOM=y
BR2_ROOTFS_SKELETON_CUSTOM_SITE="http://cdimage.ubuntu.com/ubuntu-base/releases/bionic/release"
BR2_ROOTFS_SKELETON_CUSTOM_SOURCE="ubuntu-base-18.04.4-base-arm64.tar.gz"
BR2_ROOTFS_SKELETON_CUSTOM_SITE_METHOD="wget"
BR2_ROOTFS_SKELETON_CUSTOM_EXTRACT="tar zxvf"
BR2_ROOTFS_SKELETON_CUSTOM_FULL_RFS=y
BR2_ROOTFS_SKELETON_CUSTOM_EXTRACT_IGNORE_ERROR=y
BR2_ROOTFS_POST_BUILD_SCRIPT="board/nxp/common/ls/post-custom-skeleton-ubuntu-base-18.04.sh"
BR2_INIT_NONE=y

BR2_ROOTFS_OVERLAY="board/nxp/common/ls/ubuntu_rootfs_resize_overlay"

# toolchain
BR2_TOOLCHAIN_EXTERNAL=y
BR2_TOOLCHAIN_EXTERNAL_ARM_AARCH64=y
BR2_TOOLCHAIN_USES_GLIBC=y
BR2_TOOLCHAIN_EXTERNAL_GLIBC=y

# Linux headers same as kernel
BR2_PACKAGE_HOST_LINUX_HEADERS_CUSTOM_5_4=y

# bootloader
BR2_TARGET_UBOOT=y
BR2_TARGET_UBOOT_BOARDNAME="lx2160ardb_tfa"
BR2_TARGET_UBOOT_CUSTOM_GIT=y
BR2_TARGET_UBOOT_NEEDS_DTC=y
BR2_TARGET_UBOOT_FORMAT_BIN=n
BR2_TARGET_UBOOT_FORMAT_CUSTOM=y
BR2_TARGET_UBOOT_FORMAT_CUSTOM_NAME="u-boot-dtb.bin"
BR2_PACKAGE_UBOOT_TOOLS_MKIMAGE=y
BR2_TARGET_UBOOT_ENVIMAGE=y
BR2_TARGET_UBOOT_ENVIMAGE_SOURCE="board/nxp/lx2160ardb/u-boot-environment-sd.txt"
BR2_TARGET_UBOOT_ENVIMAGE_SIZE="0x2000"

# Kernel
BR2_LINUX_KERNEL=y
BR2_LINUX_KERNEL_CUSTOM_GIT=y
BR2_LINUX_KERNEL_USE_ARCH_DEFAULT_CONFIG=y
BR2_LINUX_KERNEL_CONFIG_FRAGMENT_FILES="$(LINUX_DIR)/arch/arm64/configs/lsdk.config board/nxp/common/ls/linux-selinux.config board/nxp/common/ls/linux-dmcrypt.config"
BR2_LINUX_KERNEL_DTS_SUPPORT=y
BR2_LINUX_KERNEL_INTREE_DTS_NAME="freescale/fsl-lx2160a-rdb"
BR2_LINUX_KERNEL_IMAGE_TARGET_CUSTOM=y
BR2_LINUX_KERNEL_IMAGE_TARGET_NAME="Image"
BR2_LINUX_KERNEL_NEEDS_HOST_OPENSSL=y

# Serial port config
BR2_TARGET_GENERIC_GETTY=y
BR2_TARGET_GENERIC_GETTY_PORT="ttyAMA0"

# required tools to create the microSD image
BR2_PACKAGE_HOST_DOSFSTOOLS=y
BR2_PACKAGE_HOST_GENIMAGE=y
BR2_PACKAGE_HOST_MTOOLS=y
BR2_ROOTFS_POST_IMAGE_SCRIPT="board/nxp/lx2160ardb/post-image.sh"
BR2_ROOTFS_POST_SCRIPT_ARGS="$(LINUX_DIR) $(TOPDIR) $(UBOOT_DIR)"

# packages for rcw
BR2_PACKAGE_HOST_QORIQ_RCW=y
BR2_PACKAGE_HOST_QORIQ_RCW_BOOT_MODE="sd"
BR2_PACKAGE_HOST_QORIQ_RCW_VERSION="LSDK-20.04-update-290520"
BR2_PACKAGE_HOST_QORIQ_RCW_BIN="lx2160ardb_rev2/XGGFF_PP_HHHH_RR_19_5_2/rcw_2200_750_3200_19_5_2.bin"

# Arm-Trusted-Firmware
BR2_TARGET_ARM_TRUSTED_FIRMWARE=y
BR2_TARGET_ARM_TRUSTED_FIRMWARE_FIP=y
BR2_TARGET_ARM_TRUSTED_FIRMWARE_UBOOT_AS_BL33=y
BR2_TARGET_ARM_TRUSTED_FIRMWARE_UBOOT_BL33_IMAGE="u-boot-dtb.bin"
BR2_TARGET_ARM_TRUSTED_FIRMWARE_CUSTOM_GIT=y
BR2_TARGET_ARM_TRUSTED_FIRMWARE_CUSTOM_REPO_URL="https://source.codeaurora.org/external/qoriq/qoriq-components/atf"
BR2_TARGET_ARM_TRUSTED_FIRMWARE_PLATFORM="lx2160ardb"
BR2_TARGET_ARM_TRUSTED_FIRMWARE_IMAGES="fip.bin bl2_sd.pbl"
BR2_TARGET_ARM_TRUSTED_FIRMWARE_ADDITIONAL_TARGETS="pbl"
BR2_TARGET_ARM_TRUSTED_FIRMWARE_ADDITIONAL_DEPENDENCIES="host-qoriq-rcw"
BR2_TARGET_ARM_TRUSTED_FIRMWARE_ADDITIONAL_VARIABLES="BOOT_MODE=sd RCW=$(BINARIES_DIR)/rcw_2200_750_3200_19_5_2.bin"

# DDR PHY firmware
BR2_PACKAGE_QORIQ_DDR_PHY=y

# ETH PHY firmware
BR2_PACKAGE_QORIQ_ETH_PHY=y

# MC firmware
BR2_PACKAGE_QORIQ_MC_FW=y
BR2_PACKAGE_QORIQ_MC_UTILS=y

# restool
BR2_PACKAGE_QORIQ_RESTOOL=y

BR2_PACKAGE_IPROUTE2=y
BR2_PACKAGE_ETHTOOL=y

# busybox setting disable
BR2_PACKAGE_BUSYBOX=n
```

## openil-package/Config.in
```kconfig
menu "OpenIL additions"

menu "Networking tools"
	source "openil-package/iproute2-next/Config.in"
endmenu
menu "Edge-scale service"
	source "openil-package/qoriq-edgescale-eds/Config.in"
	source "openil-package/qoriq-eds-kubelet/Config.in"
	source "openil-package/qoriq-eds-bootstrap/Config.in"
endmenu
menu "Netconf Supporting"
	source "openil-package/pyang/Config.in"
	source "openil-package/libnetconf/Config.in"
	source "openil-package/netopeer/Config.in"
	source "openil-package/netopeer-client/Config.in"
	source "openil-package/yang-cfginterfaces/Config.in"
	source "openil-package/yang-model/Config.in"
	source "openil-package/transapi/Config.in"
endmenu
menu "Time-Sensitive Networking tools"
	source "openil-package/tsntool/Config.in"
endmenu
menu "OPC UA tools"
	source "openil-package/libopen62541/Config.in"
	source "openil-package/opc-motor-status/Config.in"
endmenu
menu "Fman ucode"
	source "openil-package/fmucode/Config.in"
endmenu
menu "ppfe firmware"
	source "openil-package/ppfe/Config.in"
endmenu
menu "ppa firmware"
	source "openil-package/ppa/Config.in"
endmenu
menu "display port firmware"
	source "openil-package/dp/Config.in"
endmenu
menu "Baremetal"
	source "openil-package/bm-uboot/Config.in"
	source "openil-package/icc/Config.in"
endmenu
menu "felixacl"
	source "openil-package/felixacl/Config.in"
endmenu

endmenu
```

## openil-package/Config.in.host
```kconfig
menu "OpenIL host utilities"

	source "openil-package/cst/Config.in.host"

endmenu
```

## openil-package/aliyun/Config.in
```kconfig
config BR2_PACKAGE_ALIYUN
	bool "Aliyun IoT SDK"
	help
	AliCloud's IoT Connectivity Devkit Running
	on Embedded Devices.
```
